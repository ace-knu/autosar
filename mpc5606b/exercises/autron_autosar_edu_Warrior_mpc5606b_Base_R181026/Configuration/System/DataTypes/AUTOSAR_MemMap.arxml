AUTOSAR XML (schema 4-2-2)
package /AUTOSAR_MemMap/SwAddrMethods  # This ARPackage defines the blueprints for SwAddrMethods which are the basis for the standardized Memory Allocation Keywords in the document SWS_MemoryMapping
  29 x sw addr method:
    VAR: memory-allocation-keyword-policy=ADDR-METHOD-SHORT-NAME-AND-ALIGNMENT, section-type=VAR  # To be used for all global or static variables.
    VAR_FAST: memory-allocation-keyword-policy=ADDR-METHOD-SHORT-NAME-AND-ALIGNMENT, section-type=VAR  # To be used for all global or static variables.
    VAR_SLOW: memory-allocation-keyword-policy=ADDR-METHOD-SHORT-NAME-AND-ALIGNMENT, section-type=VAR  # To be used for all infrequently accessed global or static variables.
    INTERNAL_VAR: memory-allocation-keyword-policy=ADDR-METHOD-SHORT-NAME-AND-ALIGNMENT, section-type=VAR  # To be used for global or static variables those are accessible from a calibration tool.
    VAR_SAVED_ZONE: memory-allocation-keyword-policy=ADDR-METHOD-SHORT-NAME-AND-ALIGNMENT, section-initialization-policy=NO-INIT, section-type=VAR  # To be used for RAM buffers of variables saved in non volatile memory.
    CONST_SAVED_RECOVERY_ZONE: memory-allocation-keyword-policy=ADDR-METHOD-SHORT-NAME-AND-ALIGNMENT, section-type=CONST  # To be used for ROM buffers of variables saved in non volatile memory.
    CONST: memory-allocation-keyword-policy=ADDR-METHOD-SHORT-NAME-AND-ALIGNMENT, section-type=CONST  # To be used for global or static constants.
    CALIB: memory-allocation-keyword-policy=ADDR-METHOD-SHORT-NAME-AND-ALIGNMENT, section-type=CALPRM  # To be used for calibration constants.
    CODE: section-type=CODE  # To be used for mapping code to application block, boot block, external flash etc.
    CONFIG_DATA: memory-allocation-keyword-policy=ADDR-METHOD-SHORT-NAME-AND-ALIGNMENT, section-type=CONFIG-DATA  # Constants with attributes that show that they reside in one segment for module configuration.
    CALLOUT_CODE: section-type=CODE  # To be used for mapping callouts of the BSW Modules which shall typically use the global linker settings for callouts.
    CALLOUT_CODE2: section-type=CODE  # To be used for mapping callouts of the BSW Modules.
    CODE_FAST: section-type=CODE  # To be used for code that shall go into fast code memory segments.
    CODE_SLOW: section-type=CODE  # To be used for code that shall go into slow code memory segments.
    VAR_NO_INIT_16: memory-allocation-keyword-policy=ADDR-METHOD-SHORT-NAME-AND-ALIGNMENT, section-type=VAR-NO-INIT  # To be used for all global or static variables.
    VAR_NO_INIT_32: memory-allocation-keyword-policy=ADDR-METHOD-SHORT-NAME-AND-ALIGNMENT, section-type=VAR-NO-INIT  # To be used for all global or static variables.
    VAR_NO_INIT_8: memory-allocation-keyword-policy=ADDR-METHOD-SHORT-NAME-AND-ALIGNMENT, section-type=VAR-NO-INIT  # To be used for all global or static variables.
    VAR_NO_INIT_UNSPECIFIED: memory-allocation-keyword-policy=ADDR-METHOD-SHORT-NAME-AND-ALIGNMENT, section-type=VAR-NO-INIT  # To be used for all global or static variables.
    VAR_INIT_16: memory-allocation-keyword-policy=ADDR-METHOD-SHORT-NAME-AND-ALIGNMENT, section-type=VAR  # To be used for all global or static variables.
    VAR_INIT_32: memory-allocation-keyword-policy=ADDR-METHOD-SHORT-NAME-AND-ALIGNMENT, section-type=VAR  # To be used for all global or static variables.
    VAR_INIT_8: memory-allocation-keyword-policy=ADDR-METHOD-SHORT-NAME-AND-ALIGNMENT, section-type=VAR  # To be used for all global or static variables.
    VAR_INIT_BOOLEAN: memory-allocation-keyword-policy=ADDR-METHOD-SHORT-NAME-AND-ALIGNMENT, section-type=VAR  # To be used for all global or static variables.
    VAR_INIT_UNSPECIFIED: memory-allocation-keyword-policy=ADDR-METHOD-SHORT-NAME-AND-ALIGNMENT, section-type=VAR  # To be used for all global or static variables.
    RAMCODE: section-type=CODE  # To be used for mapping code to application block, boot block, external flash etc.
    CODE_AC: section-type=CODE  # To be used for mapping code to application block, boot block, external flash etc.
    CONFIG_DATA_8: memory-allocation-keyword-policy=ADDR-METHOD-SHORT-NAME-AND-ALIGNMENT, section-type=CONFIG-DATA  # Constants with attributes that show that they reside in one segment for module configuration.
    CONFIG_DATA_UNSPECIFIED: memory-allocation-keyword-policy=ADDR-METHOD-SHORT-NAME-AND-ALIGNMENT, section-type=CONFIG-DATA  # Constants with attributes that show that they reside in one segment for module configuration.
    CONST_32: memory-allocation-keyword-policy=ADDR-METHOD-SHORT-NAME-AND-ALIGNMENT, section-type=CONST  # To be used for ROM buffers of variables saved in non volatile memory.
    CONST_UNSPECIFIED: memory-allocation-keyword-policy=ADDR-METHOD-SHORT-NAME-AND-ALIGNMENT, section-type=CONST  # To be used for ROM buffers of variables saved in non volatile memory.
