AUTOSAR XML (schema 4-0-3)
package /AUTOSAR_Gpt/BswModuleDescriptions
  bsw module description Gpt: module-id=100
    provided-entrys:
      Gpt_CheckWakeup
      Gpt_DeInit
      Gpt_DisableNotification
      Gpt_DisableWakeup
      Gpt_EnableNotification
      Gpt_EnableWakeup
      Gpt_GetTimeElapsed
      Gpt_GetTimeRemaining
      Gpt_GetVersionInfo
      Gpt_Init
      Gpt_SetMode
      Gpt_StartTimer
      Gpt_StopTimer
      Gpt_PIT_TIMER_{0..7}_ISR
      Gpt_RTC_Ch_0_ISR
      Gpt_STM_0_Ch_{0..3}_ISR
      Gpt_STM_1_Ch_{0..3}_ISR
      Gpt_STM_2_Ch_{0..3}_ISR
    bsw internal behavior InternalBehavior_Gpt
      65 x exclusive area:
        GPT_EXCLUSIVE_AREA_{00..64}
      13 x bsw called entity:
        Gpt_CheckWakeup: implemented-entry=Gpt_CheckWakeup
        Gpt_DeInit: implemented-entry=Gpt_DeInit
        Gpt_DisableNotification: implemented-entry=Gpt_DisableNotification
        Gpt_DisableWakeup: implemented-entry=Gpt_DisableWakeup
        Gpt_EnableNotification: implemented-entry=Gpt_EnableNotification
        Gpt_EnableWakeup: implemented-entry=Gpt_EnableWakeup
        Gpt_GetTimeElapsed: implemented-entry=Gpt_GetTimeElapsed
        Gpt_GetTimeRemaining: implemented-entry=Gpt_GetTimeRemaining
        Gpt_GetVersionInfo: implemented-entry=Gpt_GetVersionInfo
        Gpt_Init: can-enter-exclusive-area=[GPT_EXCLUSIVE_AREA_00, GPT_EXCLUSIVE_AREA_01, GPT_EXCLUSIVE_AREA_02, GPT_EXCLUSIVE_AREA_03, GPT_EXCLUSIVE_AREA_04, GPT_EXCLUSIVE_AREA_05, GPT_EXCLUSIVE_AREA_06, GPT_EXCLUSIVE_AREA_07, GPT_EXCLUSIVE_AREA_08, GPT_EXCLUSIVE_AREA_09, GPT_EXCLUSIVE_AREA_10, GPT_EXCLUSIVE_AREA_11, GPT_EXCLUSIVE_AREA_12, GPT_EXCLUSIVE_AREA_13, GPT_EXCLUSIVE_AREA_14, GPT_EXCLUSIVE_AREA_15, GPT_EXCLUSIVE_AREA_16, GPT_EXCLUSIVE_AREA_17, GPT_EXCLUSIVE_AREA_18, GPT_EXCLUSIVE_AREA_19, GPT_EXCLUSIVE_AREA_20, GPT_EXCLUSIVE_AREA_21, GPT_EXCLUSIVE_AREA_22, GPT_EXCLUSIVE_AREA_23, GPT_EXCLUSIVE_AREA_24, GPT_EXCLUSIVE_AREA_25, GPT_EXCLUSIVE_AREA_26, GPT_EXCLUSIVE_AREA_27, GPT_EXCLUSIVE_AREA_28, GPT_EXCLUSIVE_AREA_29, GPT_EXCLUSIVE_AREA_30, GPT_EXCLUSIVE_AREA_31, GPT_EXCLUSIVE_AREA_32, GPT_EXCLUSIVE_AREA_33, GPT_EXCLUSIVE_AREA_34, GPT_EXCLUSIVE_AREA_35, GPT_EXCLUSIVE_AREA_36, GPT_EXCLUSIVE_AREA_37, GPT_EXCLUSIVE_AREA_38, GPT_EXCLUSIVE_AREA_39, GPT_EXCLUSIVE_AREA_40, GPT_EXCLUSIVE_AREA_41, GPT_EXCLUSIVE_AREA_42, GPT_EXCLUSIVE_AREA_43, GPT_EXCLUSIVE_AREA_44, GPT_EXCLUSIVE_AREA_45, GPT_EXCLUSIVE_AREA_46, GPT_EXCLUSIVE_AREA_47, GPT_EXCLUSIVE_AREA_48, GPT_EXCLUSIVE_AREA_49, GPT_EXCLUSIVE_AREA_50, GPT_EXCLUSIVE_AREA_51, GPT_EXCLUSIVE_AREA_52, GPT_EXCLUSIVE_AREA_53, GPT_EXCLUSIVE_AREA_54, GPT_EXCLUSIVE_AREA_55, GPT_EXCLUSIVE_AREA_56, GPT_EXCLUSIVE_AREA_57, GPT_EXCLUSIVE_AREA_58, GPT_EXCLUSIVE_AREA_59, GPT_EXCLUSIVE_AREA_60, GPT_EXCLUSIVE_AREA_61, GPT_EXCLUSIVE_AREA_62, GPT_EXCLUSIVE_AREA_63, GPT_EXCLUSIVE_AREA_64], implemented-entry=Gpt_Init
        Gpt_SetMode: implemented-entry=Gpt_SetMode
        Gpt_StartTimer: implemented-entry=Gpt_StartTimer
        Gpt_StopTimer: implemented-entry=Gpt_StopTimer
      21 x bsw interrupt entity, all with interrupt-category=CAT-2, interrupt-source=Hardware:
        Gpt_PIT_TIMER_{0..7}_ISR: implemented-entry=Gpt_PIT_TIMER_{0..7}_ISR
        Gpt_RTC_Ch_0_ISR: implemented-entry=Gpt_RTC_Ch_0_ISR
        Gpt_STM_0_Ch_{0..3}_ISR: implemented-entry=Gpt_STM_0_Ch_{0..3}_ISR
        Gpt_STM_1_Ch_{0..3}_ISR: implemented-entry=Gpt_STM_1_Ch_{0..3}_ISR
        Gpt_STM_2_Ch_{0..3}_ISR: implemented-entry=Gpt_STM_2_Ch_{0..3}_ISR
package /AUTOSAR_Gpt/BswModuleEntrys
  34 x bsw module entry, all with is-synchronous=true, sw-service-impl-policy=STANDARD:
    Gpt_CheckWakeup: service-id=0x0c, is-reentrant=true, call-type=REGULAR, execution-context=UNSPECIFIED
    Gpt_DeInit: service-id=0x02, is-reentrant=true, call-type=REGULAR, execution-context=UNSPECIFIED
    Gpt_DisableNotification: service-id=0x08, is-reentrant=true, call-type=REGULAR, execution-context=UNSPECIFIED
    Gpt_DisableWakeup: service-id=0x0a, is-reentrant=true, call-type=REGULAR, execution-context=UNSPECIFIED
    Gpt_EnableNotification: service-id=0x07, is-reentrant=true, call-type=REGULAR, execution-context=UNSPECIFIED
    Gpt_EnableWakeup: service-id=0x0b, is-reentrant=true, call-type=REGULAR, execution-context=UNSPECIFIED
    Gpt_GetTimeElapsed: service-id=0x03, is-reentrant=true, call-type=REGULAR, execution-context=UNSPECIFIED
    Gpt_GetTimeRemaining: service-id=0x04, is-reentrant=true, call-type=REGULAR, execution-context=UNSPECIFIED
    Gpt_GetVersionInfo: service-id=0x00, is-reentrant=true, call-type=REGULAR, execution-context=UNSPECIFIED
    Gpt_Init: service-id=0x01, is-reentrant=false, call-type=REGULAR, execution-context=UNSPECIFIED
    Gpt_SetMode: service-id=0x09, is-reentrant=false, call-type=REGULAR, execution-context=UNSPECIFIED
    Gpt_StartTimer: service-id=0x05, is-reentrant=true, call-type=REGULAR, execution-context=UNSPECIFIED
    Gpt_StopTimer: service-id=0x06, is-reentrant=true, call-type=REGULAR, execution-context=UNSPECIFIED
    Gpt_PIT_TIMER_{0..7}_ISR: service-id=0, is-reentrant=false, call-type=INTERRUPT, execution-context=INTERRUPT-CAT-2
    Gpt_RTC_Ch_0_ISR: service-id=0, is-reentrant=false, call-type=INTERRUPT, execution-context=INTERRUPT-CAT-2
    Gpt_STM_0_Ch_{0..3}_ISR: service-id=0, is-reentrant=false, call-type=INTERRUPT, execution-context=INTERRUPT-CAT-2
    Gpt_STM_1_Ch_{0..3}_ISR: service-id=0, is-reentrant=false, call-type=INTERRUPT, execution-context=INTERRUPT-CAT-2
    Gpt_STM_2_Ch_{0..3}_ISR: service-id=0, is-reentrant=false, call-type=INTERRUPT, execution-context=INTERRUPT-CAT-2
package /Gpt_T2D13M10I1R0/Implementations
  bsw implementation BswImplementation_Gpt: programming-language=C, sw-version=1.0.1, vendor-id=43, ar-release-version=4.0.3, behavior=InternalBehavior_Gpt, vendor-specific-module-def=Gpt
    code-descriptors:
      code Files
        artifact-descriptors:
          short-label=config::Gpt.xdm, category=SWCFG
          short-label=doc::AUTOSAR_MCAL_GPT_IM.pdf, category=SWDOC
          short-label=doc::AUTOSAR_MCAL_GPT_UM.pdf, category=SWDOC
          short-label=include::Gpt.h, category=SWHDR
          short-label=include::Gpt_eMIOS_LLD.h, category=SWHDR
          short-label=include::Gpt_eMIOS_LLD_CfgEx.h, category=SWHDR
          short-label=include::Gpt_LLD.h, category=SWHDR
          short-label=include::Gpt_NonASR.h, category=SWHDR
          short-label=include::Gpt_Pit_LLD.h, category=SWHDR
          short-label=include::Gpt_Pit_LLD_CfgEx.h, category=SWHDR
          short-label=include::Gpt_Rtc_LLD.h, category=SWHDR
          short-label=include::Gpt_Rtc_LLD_CfgEx.h, category=SWHDR
          short-label=include::Gpt_Stm_LLD.h, category=SWHDR
          short-label=include::Gpt_Stm_LLD_CfgEx.h, category=SWHDR
          short-label=include::Reg_eSys_eMIOS.h, category=SWHDR
          short-label=include::Reg_eSys_eMIOS_CfgEx.h, category=SWHDR
          short-label=include::Reg_eSys_Pit.h, category=SWHDR
          short-label=include::Reg_eSys_Rtc.h, category=SWHDR
          short-label=include::Reg_eSys_Stm.h, category=SWHDR
          short-label=src::Gpt.c, category=SWSRC
          short-label=src::Gpt_eMIOS_Irq.c, category=SWSRC
          short-label=src::Gpt_eMIOS_LLD.c, category=SWSRC
          short-label=src::Gpt_Irq.c, category=SWSRC
          short-label=src::Gpt_LLD.c, category=SWSRC
          short-label=src::Gpt_NonASR.c, category=SWSRC
          short-label=src::Gpt_Pit_LLD.c, category=SWSRC
          short-label=src::Gpt_Pit_LLD_Irq.c, category=SWSRC
          short-label=src::Gpt_Rtc_LLD.c, category=SWSRC
          short-label=src::Gpt_Rtc_LLD_Irq.c, category=SWSRC
          short-label=src::Gpt_Stm_LLD.c, category=SWSRC
          short-label=src::Gpt_Stm_LLD_Irq.c, category=SWSRC
          short-label=src::Reg_eSys_eMIOS_Gpt.c, category=SWSRC
    4 x compiler:
      CW_Compiler:
        name=CodeWarrior for MPC5xxx
        options=-proc Zen -lang c -opt all -common off -sdatathreshold 0 -sdata2threshold 0 -vle -use_lmw_stmw on -ppc_asm_to_vle -Cpp_exceptions off -func_align 4 -sym dwarf-2,full -gdwarf-2 -w on -r -w undefmacro -char unsigned -nosyspath -fp none -DAUTOSAR_OS_NOT_USED -DMWERKS
        vendor=Freescale Semiconductor
        version=Freescale CodeWarrior for MPC5xxx v2.10 - compiler Version 4.3 build 224
      HT_Compiler: name=Hi-Tech C Compiler, options=-Os -msdata=eabi -G1000 -fshort-double -mno-spe -mregnames -g3 -Wall -mvle --mcpu=z425n3 -DAUTOSAR_OS_NOT_USED -DUSE_SW_VECTOR_MODE, vendor=HiTech, version=HighTec v4.6.4.0, Compiler gcc v4.6.3
      DIAB_Compiler:
        name=Windriver Diab
        options=-Xdialect-ansi -XO -g -Xsize-opt -Xsmall-data=0 -Xaddr-sconst=0x11 -Xaddr-sdata=0x11 -Xno-common -Xnested-interrupts -Xdebug-dwarf2 -Xdebug-local-all -Xdebug-local-cie -Xdebug-struct-all -Xforce-declarations -ee1481 -Xmacro-undefined-warn -W:as:,-l -Wa,-Xisa-vle -DAUTOSAR_OS_NOT_USED -DDIAB -Xforce-prototypes -tPPCE200Z0VEN:simple
        vendor=Windriver
        version=Windriver DIAB Rel DIAB_5_9_2_0-FCS_20120725_234511
      GHS_Compiler: name=Green Hills, options=-cpu=ppc560xb -ansi -noSPE -Ospace -sda=0 -vle -dual_debug -G --no_exceptions -Wundef -Wimplicit-int -Wshadow -Wtrigraphs --prototype_errors --incorrect_pragma_warnings -noslashcomment -preprocess_assembly_files --short_enum --no_commons -c -DAUTOSAR_OS_NOT_USED -DUSE_SW_VECTOR_MODE -DDISABLE_MCAL_INTERMODULE_ASR_CHECK -DGHS, vendor=Green Hills, version=Green Hills MULTI v6.1.4
    generated-artifacts:
      dependency on artifact Gpt_PBcfg_c: artifact-descriptor={short-label=generate_PB::src::Gpt_PBcfg.c, category=SWSRC}, usages=COMPILE
      dependency on artifact Gpt_Cfg_h: artifact-descriptor={short-label=generate_PC::include::Gpt_Cfg.h, category=SWHDR}, usages=COMPILE
      dependency on artifact Gpt_Cfg_c: artifact-descriptor={short-label=generate_PC::src::Gpt_Cfg.c, category=SWSRC}, usages=COMPILE
    4 x linker:
      CW_Linker: name=CodeWarrior for MPC5xxx, options=-proc Zen -code_merging all -far_near_addressing -vle_enhance_merging -listdwarf -sym dwarf-2,full -char unsigned, vendor=Freescale Semiconductor, version=Freescale CodeWarrior for MPC5xxx v2.10 - compiler Version 4.3 build 224
      HT_Linker: name=Hi-Tech C Compiler, options=-N --no-undefined --warn-common --error-unresolved-symbols -nocrt0 -nostartfiles -Wl --no-warn-flags -T, vendor=HiTech, version=HighTec v4.6.4.0, Compiler gcc v4.6.3
      DIAB_Linker: name=Windriver Diab, options=-tPPCE200Z0VEN:simple -Xelf -m6 -lc -Xlibc-old, vendor=Windriver, version=Windriver DIAB Rel DIAB_5_9_2_0-FCS_20120725_234511
      GHS_Linker: name=Green Hills, options=-cpu=ppc560xb -nostartfiles -vle -linker_warnings, vendor=Green Hills, version=Green Hills MULTI v6.1.4
    resource consumption ResourceConsumption
      8 x memory section:
        GPT_CODE: alignment=UNSPECIFIED, sw-addrmethod=CODE, symbol=CODE
        GPT_CONFIG_DATA_UNSPECIFIED: alignment=UNSPECIFIED, sw-addrmethod=CONFIG_DATA_UNSPECIFIED, symbol=CONFIG_DATA_UNSPECIFIED
        GPT_CONST_32: alignment=32, sw-addrmethod=CONST_32, symbol=CONST_32
        GPT_CONST_UNSPECIFIED: alignment=UNSPECIFIED, sw-addrmethod=CONST_UNSPECIFIED, symbol=CONST_UNSPECIFIED
        GPT_VAR_INIT_UNSPECIFIED: alignment=UNSPECIFIED, sw-addrmethod=VAR_INIT_UNSPECIFIED, symbol=VAR_INIT_UNSPECIFIED
        GPT_VAR_NO_INIT_32: alignment=32, sw-addrmethod=VAR_NO_INIT_32, symbol=VAR_NO_INIT_32
        GPT_VAR_NO_INIT_8: alignment=8, sw-addrmethod=VAR_NO_INIT_8, symbol=VAR_NO_INIT_8
        GPT_VAR_NO_INIT_UNSPECIFIED: alignment=UNSPECIFIED, sw-addrmethod=VAR_NO_INIT_UNSPECIFIED, symbol=VAR_NO_INIT_UNSPECIFIED
