AUTOSAR XML (schema 4-0-3)
package /AUTOSAR_Pwm/BswModuleDescriptions
  bsw module description Pwm: module-id=121
    provided-entrys:
      Pwm_DeInit
      Pwm_DisableNotification
      Pwm_eMIOS_LLD_ComputeDutycycle
      Pwm_eMIOS_LLD_DeInit
      Pwm_eMIOS_LLD_DisableNotification
      Pwm_eMIOS_LLD_EnableNotification
      Pwm_eMIOS_LLD_GetCounterBusPeriod
      Pwm_eMIOS_LLD_GetOutputState
      Pwm_eMIOS_LLD_Init
      Pwm_eMIOS_LLD_ProcessInterrupt
      Pwm_eMIOS_LLD_SelectPrescaler
      Pwm_eMIOS_LLD_SetChannelOutput
      Pwm_eMIOS_LLD_SetCounterBus
      Pwm_eMIOS_LLD_SetDutyCycle
      Pwm_eMIOS_LLD_SetOutputToIdle
      Pwm_eMIOS_LLD_SetPeriodAndDuty
      Pwm_eMIOS_LLD_UpdateChannel_AB
      Pwm_eMIOS_LLD_UpdateChannel_B
      Pwm_EnableNotification
      Pwm_GetOutputState
      Pwm_GetVersionInfo
      Pwm_Init
      Pwm_SetDutyCycle
      Pwm_SetOutputToIdle
      Pwm_SetPeriodAndDuty
    bsw internal behavior InternalBehavior_Pwm_43
      65 x exclusive area:
        PWM_EXCLUSIVE_AREA_{00..64}
      25 x bsw called entity:
        Pwm_DeInit: implemented-entry=Pwm_DeInit
        Pwm_DisableNotification: implemented-entry=Pwm_DisableNotification
        Pwm_eMIOS_LLD_ComputeDutycycle: implemented-entry=Pwm_eMIOS_LLD_ComputeDutycycle
        Pwm_eMIOS_LLD_DeInit: implemented-entry=Pwm_eMIOS_LLD_DeInit
        Pwm_eMIOS_LLD_DisableNotification: implemented-entry=Pwm_eMIOS_LLD_DisableNotification
        Pwm_eMIOS_LLD_EnableNotification: implemented-entry=Pwm_eMIOS_LLD_EnableNotification
        Pwm_eMIOS_LLD_GetCounterBusPeriod: implemented-entry=Pwm_eMIOS_LLD_GetCounterBusPeriod
        Pwm_eMIOS_LLD_GetOutputState: implemented-entry=Pwm_eMIOS_LLD_GetOutputState
        Pwm_eMIOS_LLD_Init: implemented-entry=Pwm_eMIOS_LLD_Init
        Pwm_eMIOS_LLD_ProcessInterrupt: implemented-entry=Pwm_eMIOS_LLD_ProcessInterrupt
        Pwm_eMIOS_LLD_SelectPrescaler: implemented-entry=Pwm_eMIOS_LLD_SelectPrescaler
        Pwm_eMIOS_LLD_SetChannelOutput: implemented-entry=Pwm_eMIOS_LLD_SetChannelOutput
        Pwm_eMIOS_LLD_SetCounterBus: implemented-entry=Pwm_eMIOS_LLD_SetCounterBus
        Pwm_eMIOS_LLD_SetDutyCycle: implemented-entry=Pwm_eMIOS_LLD_SetDutyCycle
        Pwm_eMIOS_LLD_SetOutputToIdle: implemented-entry=Pwm_eMIOS_LLD_SetOutputToIdle
        Pwm_eMIOS_LLD_SetPeriodAndDuty: implemented-entry=Pwm_eMIOS_LLD_SetPeriodAndDuty
        Pwm_eMIOS_LLD_UpdateChannel_AB: implemented-entry=Pwm_eMIOS_LLD_UpdateChannel_AB
        Pwm_eMIOS_LLD_UpdateChannel_B: implemented-entry=Pwm_eMIOS_LLD_UpdateChannel_B
        Pwm_EnableNotification: implemented-entry=Pwm_EnableNotification
        Pwm_GetOutputState: implemented-entry=Pwm_GetOutputState
        Pwm_GetVersionInfo: implemented-entry=Pwm_GetVersionInfo
        Pwm_Init: can-enter-exclusive-area=[PWM_EXCLUSIVE_AREA_00, PWM_EXCLUSIVE_AREA_01, PWM_EXCLUSIVE_AREA_02, PWM_EXCLUSIVE_AREA_03, PWM_EXCLUSIVE_AREA_04, PWM_EXCLUSIVE_AREA_05, PWM_EXCLUSIVE_AREA_06, PWM_EXCLUSIVE_AREA_07, PWM_EXCLUSIVE_AREA_08, PWM_EXCLUSIVE_AREA_09, PWM_EXCLUSIVE_AREA_10, PWM_EXCLUSIVE_AREA_11, PWM_EXCLUSIVE_AREA_12, PWM_EXCLUSIVE_AREA_13, PWM_EXCLUSIVE_AREA_14, PWM_EXCLUSIVE_AREA_15, PWM_EXCLUSIVE_AREA_16, PWM_EXCLUSIVE_AREA_17, PWM_EXCLUSIVE_AREA_18, PWM_EXCLUSIVE_AREA_19, PWM_EXCLUSIVE_AREA_20, PWM_EXCLUSIVE_AREA_21, PWM_EXCLUSIVE_AREA_22, PWM_EXCLUSIVE_AREA_23, PWM_EXCLUSIVE_AREA_24, PWM_EXCLUSIVE_AREA_25, PWM_EXCLUSIVE_AREA_26, PWM_EXCLUSIVE_AREA_27, PWM_EXCLUSIVE_AREA_28, PWM_EXCLUSIVE_AREA_29, PWM_EXCLUSIVE_AREA_30, PWM_EXCLUSIVE_AREA_31, PWM_EXCLUSIVE_AREA_32, PWM_EXCLUSIVE_AREA_33, PWM_EXCLUSIVE_AREA_34, PWM_EXCLUSIVE_AREA_35, PWM_EXCLUSIVE_AREA_36, PWM_EXCLUSIVE_AREA_37, PWM_EXCLUSIVE_AREA_38, PWM_EXCLUSIVE_AREA_39, PWM_EXCLUSIVE_AREA_40, PWM_EXCLUSIVE_AREA_41, PWM_EXCLUSIVE_AREA_42, PWM_EXCLUSIVE_AREA_43, PWM_EXCLUSIVE_AREA_44, PWM_EXCLUSIVE_AREA_45, PWM_EXCLUSIVE_AREA_46, PWM_EXCLUSIVE_AREA_47, PWM_EXCLUSIVE_AREA_48, PWM_EXCLUSIVE_AREA_49, PWM_EXCLUSIVE_AREA_50, PWM_EXCLUSIVE_AREA_51, PWM_EXCLUSIVE_AREA_52, PWM_EXCLUSIVE_AREA_53, PWM_EXCLUSIVE_AREA_54, PWM_EXCLUSIVE_AREA_55, PWM_EXCLUSIVE_AREA_56, PWM_EXCLUSIVE_AREA_57, PWM_EXCLUSIVE_AREA_58, PWM_EXCLUSIVE_AREA_59, PWM_EXCLUSIVE_AREA_60, PWM_EXCLUSIVE_AREA_61, PWM_EXCLUSIVE_AREA_62, PWM_EXCLUSIVE_AREA_63, PWM_EXCLUSIVE_AREA_64], implemented-entry=Pwm_Init
        Pwm_SetDutyCycle: implemented-entry=Pwm_SetDutyCycle
        Pwm_SetOutputToIdle: implemented-entry=Pwm_SetOutputToIdle
        Pwm_SetPeriodAndDuty: implemented-entry=Pwm_SetPeriodAndDuty
package /AUTOSAR_Pwm/BswModuleEntrys
  25 x bsw module entry, all with is-synchronous=true, call-type=REGULAR, execution-context=UNSPECIFIED, sw-service-impl-policy=STANDARD:
    Pwm_DeInit: service-id=0x01, is-reentrant=false
    Pwm_DisableNotification: service-id=0x06, is-reentrant=true
    Pwm_eMIOS_LLD_ComputeDutycycle: service-id=0, is-reentrant=false
    Pwm_eMIOS_LLD_DeInit: service-id=0, is-reentrant=false
    Pwm_eMIOS_LLD_DisableNotification: service-id=0, is-reentrant=false
    Pwm_eMIOS_LLD_EnableNotification: service-id=0, is-reentrant=false
    Pwm_eMIOS_LLD_GetCounterBusPeriod: service-id=0, is-reentrant=false
    Pwm_eMIOS_LLD_GetOutputState: service-id=0, is-reentrant=false
    Pwm_eMIOS_LLD_Init: service-id=0, is-reentrant=false
    Pwm_eMIOS_LLD_ProcessInterrupt: service-id=0, is-reentrant=false
    Pwm_eMIOS_LLD_SelectPrescaler: service-id=0, is-reentrant=false
    Pwm_eMIOS_LLD_SetChannelOutput: service-id=0, is-reentrant=false
    Pwm_eMIOS_LLD_SetCounterBus: service-id=0, is-reentrant=false
    Pwm_eMIOS_LLD_SetDutyCycle: service-id=0, is-reentrant=false
    Pwm_eMIOS_LLD_SetOutputToIdle: service-id=0, is-reentrant=false
    Pwm_eMIOS_LLD_SetPeriodAndDuty: service-id=0, is-reentrant=false
    Pwm_eMIOS_LLD_UpdateChannel_AB: service-id=0, is-reentrant=false
    Pwm_eMIOS_LLD_UpdateChannel_B: service-id=0, is-reentrant=false
    Pwm_EnableNotification: service-id=0x07, is-reentrant=true
    Pwm_GetOutputState: service-id=0x05, is-reentrant=true
    Pwm_GetVersionInfo: service-id=0x08, is-reentrant=true
    Pwm_Init: service-id=0x00, is-reentrant=false
    Pwm_SetDutyCycle: service-id=0x02, is-reentrant=true
    Pwm_SetOutputToIdle: service-id=0x04, is-reentrant=true
    Pwm_SetPeriodAndDuty: service-id=0x03, is-reentrant=true
package /Pwm_T2D13M10I1R0/Implementations
  bsw implementation BswImplementation_Pwm_43: programming-language=C, sw-version=1.0.1, vendor-id=43, ar-release-version=4.0.3, behavior=InternalBehavior_Pwm_43, vendor-specific-module-def=Pwm
    code-descriptors:
      code Files
        artifact-descriptors:
          short-label=config::Pwm.xdm, category=SWCFG
          short-label=doc::AUTOSAR_MCAL_PWM_IM.pdf, category=SWDOC
          short-label=doc::AUTOSAR_MCAL_PWM_UM.pdf, category=SWDOC
          short-label=include::Pwm.h, category=SWHDR
          short-label=include::Pwm_eMIOS_LLD.h, category=SWHDR
          short-label=include::Pwm_eMIOS_LLD_CfgEx.h, category=SWHDR
          short-label=include::Pwm_LLD.h, category=SWHDR
          short-label=include::Pwm_NonASR.h, category=SWHDR
          short-label=include::Reg_eSys_eMIOS.h, category=SWHDR
          short-label=include::Reg_eSys_eMIOS_CfgEx.h, category=SWHDR
          short-label=src::Pwm.c, category=SWSRC
          short-label=src::Pwm_eMIOS_Irq.c, category=SWSRC
          short-label=src::Pwm_eMIOS_LLD.c, category=SWSRC
          short-label=src::Pwm_NonASR.c, category=SWSRC
          short-label=src::Pwm_Reg_eSys_eMIOS.c, category=SWSRC
    4 x compiler:
      CW_Compiler:
        name=CodeWarrior for MPC5xxx
        options=-proc Zen -lang c -opt all -common off -sdatathreshold 0 -sdata2threshold 0 -vle -use_lmw_stmw on -ppc_asm_to_vle -Cpp_exceptions off -func_align 4 -sym dwarf-2,full -gdwarf-2 -w on -r -w undefmacro -char unsigned -nosyspath -fp none -DAUTOSAR_OS_NOT_USED -DMWERKS
        vendor=Freescale Semiconductor
        version=Freescale CodeWarrior for MPC5xxx v2.10 - compiler Version 4.3 build 224
      HT_Compiler: name=Hi-Tech C Compiler, options=-Os -msdata=eabi -G1000 -fshort-double -mno-spe -mregnames -g3 -Wall -mvle --mcpu=z425n3 -DAUTOSAR_OS_NOT_USED -DUSE_SW_VECTOR_MODE, vendor=HiTech, version=HighTec v4.6.4.0, Compiler gcc v4.6.3
      DIAB_Compiler:
        name=Windriver Diab
        options=-Xdialect-ansi -XO -g -Xsize-opt -Xsmall-data=0 -Xaddr-sconst=0x11 -Xaddr-sdata=0x11 -Xno-common -Xnested-interrupts -Xdebug-dwarf2 -Xdebug-local-all -Xdebug-local-cie -Xdebug-struct-all -Xforce-declarations -ee1481 -Xmacro-undefined-warn -W:as:,-l -Wa,-Xisa-vle -DAUTOSAR_OS_NOT_USED -DDIAB -Xforce-prototypes -tPPCE200Z0VEN:simple
        vendor=Windriver
        version=Windriver DIAB Rel DIAB_5_9_2_0-FCS_20120725_234511
      GHS_Compiler: name=Green Hills, options=-cpu=ppc560xb -ansi -noSPE -Ospace -sda=0 -vle -dual_debug -G --no_exceptions -Wundef -Wimplicit-int -Wshadow -Wtrigraphs --prototype_errors --incorrect_pragma_warnings -noslashcomment -preprocess_assembly_files --short_enum --no_commons -c -DAUTOSAR_OS_NOT_USED -DUSE_SW_VECTOR_MODE -DDISABLE_MCAL_INTERMODULE_ASR_CHECK -DGHS, vendor=Green Hills, version=Green Hills MULTI v6.1.4
    generated-artifacts:
      dependency on artifact Pwm_PBcfg_c: artifact-descriptor={short-label=generate_PB::src::Pwm_PBcfg.c, category=SWSRC}, usages=COMPILE
      dependency on artifact Pwm_Cfg_h: artifact-descriptor={short-label=generate_PC::include::Pwm_Cfg.h, category=SWHDR}, usages=COMPILE
      dependency on artifact Pwm_Cfg_c: artifact-descriptor={short-label=generate_PC::src::Pwm_Cfg.c, category=SWSRC}, usages=COMPILE
    4 x linker:
      CW_Linker: name=CodeWarrior for MPC5xxx, options=-proc Zen -code_merging all -far_near_addressing -vle_enhance_merging -listdwarf -sym dwarf-2,full -char unsigned, vendor=Freescale Semiconductor, version=Freescale CodeWarrior for MPC5xxx v2.10 - compiler Version 4.3 build 224
      HT_Linker: name=Hi-Tech C Compiler, options=-N --no-undefined --warn-common --error-unresolved-symbols -nocrt0 -nostartfiles -Wl --no-warn-flags -T, vendor=HiTech, version=HighTec v4.6.4.0, Compiler gcc v4.6.3
      DIAB_Linker: name=Windriver Diab, options=-tPPCE200Z0VEN:simple -Xelf -m6 -lc -Xlibc-old, vendor=Windriver, version=Windriver DIAB Rel DIAB_5_9_2_0-FCS_20120725_234511
      GHS_Linker: name=Green Hills, options=-cpu=ppc560xb -nostartfiles -vle -linker_warnings, vendor=Green Hills, version=Green Hills MULTI v6.1.4
    resource consumption ResourceConsumption
      7 x memory section:
        PWM_CODE: alignment=UNSPECIFIED, sw-addrmethod=CODE, symbol=CODE
        PWM_CONFIG_DATA_UNSPECIFIED: alignment=UNSPECIFIED, sw-addrmethod=CONFIG_DATA_UNSPECIFIED, symbol=CONFIG_DATA_UNSPECIFIED
        PWM_VAR_INIT_UNSPECIFIED: alignment=UNSPECIFIED, sw-addrmethod=VAR_INIT_UNSPECIFIED, symbol=VAR_INIT_UNSPECIFIED
        PWM_VAR_NO_INIT_16: alignment=16, sw-addrmethod=VAR_NO_INIT_16, symbol=VAR_NO_INIT_16
        PWM_VAR_NO_INIT_32: alignment=32, sw-addrmethod=VAR_NO_INIT_32, symbol=VAR_NO_INIT_32
        PWM_VAR_NO_INIT_8: alignment=8, sw-addrmethod=VAR_NO_INIT_8, symbol=VAR_NO_INIT_8
        PWM_VAR_NO_INIT_UNSPECIFIED: alignment=UNSPECIFIED, sw-addrmethod=VAR_NO_INIT_UNSPECIFIED, symbol=VAR_NO_INIT_UNSPECIFIED
