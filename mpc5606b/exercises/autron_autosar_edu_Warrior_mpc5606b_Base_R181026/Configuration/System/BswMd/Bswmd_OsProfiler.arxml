AUTOSAR XML (schema 4-0-3)
package /ArPackage_OsProfiler
  bsw module description OsProfiler: module-id=255
    bsw internal behavior BswInternalBehavior_OsProfiler
  bsw implementation BswImplementation_OsProfiler: sw-version=1.0.0, vendor-id=76, ar-release-version=4.0.3, behavior=BswInternalBehavior_OsProfiler
