AUTOSAR XML (schema 4-0-3)
package /Bsw_Os
  bsw implementation BswImplementation_Os: sw-version=2.0.4, vendor-id=76, ar-release-version=4.0.3, behavior=BswInternalBehavior_Os
  bsw module description Os: module-id=1
    required-mode-groups:
      mode declaration group prototype Os_EM_R: type=EcuMode
    bsw internal behavior BswInternalBehavior_Os
      bsw schedulable entity BswSE_Os_MeasureCPULoadRun: accessed-mode-groups=Os_EM_R, implemented-entry=Os_MeasureCPULoadRun
      bsw timing event BswTE_Os_MeasureCPULoadRun: disabled-in-mode=[Os_EM_R.ECUM_STATE_STARTUP_ONE, Os_EM_R.ECUM_STATE_STARTUP_TWO], starts-on-event=BswSE_Os_MeasureCPULoadRun, period=0.01
  bsw module entry Os_MeasureCPULoadRun: service-id=1, is-reentrant=false, is-synchronous=true, call-type=SCHEDULED, execution-context=TASK, sw-service-impl-policy=STANDARD
