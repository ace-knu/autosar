AUTOSAR XML (schema 4-0-3)
package /Bsw_NvM
  bsw implementation BswImplementation_NvM: programming-language=C, sw-version=1.3.1, swc-bsw-mapping=SwcBswMapping_NvM, vendor-id=76, ar-release-version=4.0.3, behavior=BswInternalBehavior_NvM, vendor-specific-module-def=NvM
  bsw module description NvM: module-id=20
    provided-mode-groups:
      mode declaration group prototype MemCyclicMode: type=MemCyclicMode
    required-mode-groups:
      mode declaration group prototype MemCyclicMode_R: type=MemCyclicMode
    required-triggers:
      trigger RequiredTrigger_FromDem: sw-impl-policy=QUEUED
    bsw internal behavior BswInternalBehavior_NvM: data-type-mapping=MemCyclicMode, bsw-mode-sender-policy{enhanced-mode-api=false, provided-mode-group=MemCyclicMode, queue-length=1}, bsw-mode-receiver-policy{enhanced-mode-api=false, required-mode-group=MemCyclicMode_R, supports-asynchronous-mode-switch=true}
      exclusive area RAM_INDEX
      exclusive area RAM_STATUS_PROTECTION
      bsw internal triggering point BITP_CallCyclicMemFunction: sw-impl-policy=QUEUED
      bsw schedulable entity BSE_NvM: can-enter-exclusive-area=[RAM_INDEX, RAM_STATUS_PROTECTION], accessed-mode-groups=MemCyclicMode_R, implemented-entry=NvM_MainFunction
      bsw schedulable entity BSE_Call_MemMainFunctions: implemented-entry=NvM_Call_MemMainFunctions, managed-mode-groups=MemCyclicMode
      bsw interrupt entity BIE_CallCyclicMemFunction: activation-points=BITP_CallCyclicMemFunction, implemented-entry=NvM_Call_NvM_BITP_MainFunction, interrupt-category=CAT-2
      bsw timing event BTE_NvM: disabled-in-mode=[MemCyclicMode_R.IDLEEXECUTE, MemCyclicMode_R.NONEEEXECUTE], starts-on-event=BSE_NvM, period=0.005
      bsw internal trigger occurred event BITOE_MemMemFunction: starts-on-event=BSE_Call_MemMainFunctions, event-source=BITP_CallCyclicMemFunction
      bsw external trigger occurred event BETOE_CallCyclicMemFunction: starts-on-event=BSE_Call_MemMainFunctions, trigger=RequiredTrigger_FromDem
  4 x bsw module entry, all with is-synchronous=false, sw-service-impl-policy=STANDARD:
    NvM_MainFunction: service-id=14, is-reentrant=false, call-type=SCHEDULED, execution-context=TASK
    NvM_EcuMode: is-reentrant=true, call-type=SCHEDULED, execution-context=TASK
    NvM_Call_MemMainFunctions: is-reentrant=false, call-type=SCHEDULED, execution-context=TASK
    NvM_Call_NvM_BITP_MainFunction: is-reentrant=false, call-type=INTERRUPT, execution-context=INTERRUPT-CAT-2
package /Bsw_NvM/ModeDeclarationGroup
  mode declaration group MemCyclicMode: category=EXPLICIT_ORDER, initial-mode=NONEEEXECUTE, on-transition-value=255
    mode NONEEEXECUTE: value=0
    mode IDLEEXECUTE: value=1
    mode TASKEXECUTE: value=2
package /Bsw_NvM/DataTypeMappingSet
  data type mapping set MemCyclicMode: mode-request-type-map{implementation-data-type=uint8, mode-group=MemCyclicMode}
