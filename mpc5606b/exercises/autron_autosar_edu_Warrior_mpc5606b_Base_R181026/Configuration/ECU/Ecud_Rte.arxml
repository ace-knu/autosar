AUTOSAR XML (schema 4-0-3)
package /AUTOSAR
  module config Rte: implementation-config-variant=VARIANT-PRE-COMPILE
    CommonPublishedInformation0 (CommonPublishedInformation): ArReleaseVersion=4.0.3, ModuleId=2, SwVersion=4.4.0, VendorId=76
    RteBswGeneral0 (RteBswGeneral): RteSchMVersionInfoApi=0, RteUseComShadowSignalApi=0
    28 x RteBswModuleInstance:
      BswInstance_Adc: category=TOOL_CONFIGURED, RteBswImplementationRef=BswImplementation_Adc, RteBswModuleConfigurationRef=Adc
        27 x RteBswExclusiveAreaImpl, all with category=TOOL_CONFIGURED, RteExclusiveAreaImplMechanism=ALL_INTERRUPT_BLOCKING:
          ADC_EXCLUSIVE_AREA_RteBswExclusiveAreaImpl{00..26}: RteBswExclusiveAreaRef=ADC_EXCLUSIVE_AREA_{00..26}
      BswInstance_BswM: category=TOOL_CONFIGURED, RteBswImplementationRef=BswImplementation_BswM, RteBswModuleConfigurationRef=BswM
        RteBswEventToTaskMapping_TimingEvent (RteBswEventToTaskMapping):
          category = TOOL_CONFIGURED
          RteBswImmediateRestart = 0
          RteBswPositionInTask = 3
          RteBswEventRef = BswTE_BswM_MainFunction
          RteBswMappedToTaskRef = OsTask_BSW_FG1_10ms
          RteBswUsedOsAlarmRef = OsAlarm_BSW_10ms
        3 x RteBswExclusiveAreaImpl, all with category=TOOL_CONFIGURED, RteExclusiveAreaImplMechanism=ALL_INTERRUPT_BLOCKING:
          DATA_PROTECTION_RteBswExclusiveAreaImpl: RteBswExclusiveAreaRef=DATA_PROTECTION
          RULEPREVRESULT_PROTECTION_RteBswExclusiveAreaImpl: RteBswExclusiveAreaRef=RULEPREVRESULT_PROTECTION
          RULESTATUS_PROTECTION_RteBswExclusiveAreaImpl: RteBswExclusiveAreaRef=RULESTATUS_PROTECTION
        modeNotificationPort_DcmEcuReset (RteBswRequiredModeGroupConnection):
          category = TOOL_CONFIGURED
          RteBswProvidedModeGroupRef = DcmEcuReset
          RteBswRequiredModeGroupRef = modeNotificationPort_DcmEcuReset
          RteBswProvidedModeGrpModInstRef = BswInstance_Dcm
        modeNotificationPort_DcmDiagnosticSessionControl (RteBswRequiredModeGroupConnection):
          category = TOOL_CONFIGURED
          RteBswProvidedModeGroupRef = DcmDiagnosticSessionControl
          RteBswRequiredModeGroupRef = modeNotificationPort_DcmDiagnosticSessionControl
          RteBswProvidedModeGrpModInstRef = BswInstance_Dcm
      BswInstance_Can: category=TOOL_CONFIGURED, RteBswImplementationRef=BswImplementation_Can, RteBswModuleConfigurationRef=Can
        7 x RteBswExclusiveAreaImpl, all with category=TOOL_CONFIGURED, RteExclusiveAreaImplMechanism=ALL_INTERRUPT_BLOCKING:
          CAN_EXCLUSIVE_AREA_RteBswExclusiveAreaImpl{00..06}: RteBswExclusiveAreaRef=CAN_EXCLUSIVE_AREA_{00..06}
      BswInstance_CanIf: category=TOOL_CONFIGURED, RteBswImplementationRef=BswImplementation_CanIf, RteBswModuleConfigurationRef=CanIf
        7 x RteBswExclusiveAreaImpl, all with category=TOOL_CONFIGURED, RteExclusiveAreaImplMechanism=ALL_INTERRUPT_BLOCKING:
          ExclusiveArea_0_RteBswExclusiveAreaImpl: RteBswExclusiveAreaRef=ExclusiveArea_0
          MODE_STATUS_PROTECTION_RteBswExclusiveAreaImpl: RteBswExclusiveAreaRef=MODE_STATUS_PROTECTION
          RX_DATA_PROTECTION_RteBswExclusiveAreaImpl: RteBswExclusiveAreaRef=RX_DATA_PROTECTION
          RX_NOTIFSTATUS_PROTECTION_RteBswExclusiveAreaImpl: RteBswExclusiveAreaRef=RX_NOTIFSTATUS_PROTECTION
          TX_DYNCANID_PROTECTION_RteBswExclusiveAreaImpl: RteBswExclusiveAreaRef=TX_DYNCANID_PROTECTION
          TX_NOTIFSTATUS_PROTECTION_RteBswExclusiveAreaImpl: RteBswExclusiveAreaRef=TX_NOTIFSTATUS_PROTECTION
          TX_QUEUE_PROTECTION_RteBswExclusiveAreaImpl: RteBswExclusiveAreaRef=TX_QUEUE_PROTECTION
      BswInstance_CanSM: category=TOOL_CONFIGURED, RteBswImplementationRef=BswImplementation_CanSM, RteBswModuleConfigurationRef=CanSM
        BswSchedulableEntity_0_RteBswEventToTaskMapping (RteBswEventToTaskMapping):
          category = TOOL_CONFIGURED
          RteBswImmediateRestart = 0
          RteBswPositionInTask = 11
          RteBswEventRef = BswTE_CanSM_MainFunction
          RteBswMappedToTaskRef = OsTask_BSW_FG1_5ms_Com
          RteBswUsedOsAlarmRef = OsAlarm_BSW_5ms_Com
        MODE_STATUS_PROTECTION_RteBswExclusiveAreaImpl (RteBswExclusiveAreaImpl): category=TOOL_CONFIGURED, RteExclusiveAreaImplMechanism=ALL_INTERRUPT_BLOCKING, RteBswExclusiveAreaRef=MODE_STATUS_PROTECTION
        SchM_Exit_CanSM_BUSOFF_STATUS_PROTECTION_RteBswExclusiveAreaImpl (RteBswExclusiveAreaImpl): category=TOOL_CONFIGURED, RteExclusiveAreaImplMechanism=ALL_INTERRUPT_BLOCKING, RteBswExclusiveAreaRef=BUSOFF_STATUS_PROTECTION
      BswInstance_CanTp: category=TOOL_CONFIGURED, RteBswImplementationRef=BswImplementation_CanTp, RteBswModuleConfigurationRef=CanTp
        BswSchedulableEntity_0_RteBswEventToTaskMapping (RteBswEventToTaskMapping):
          category = TOOL_CONFIGURED
          RteBswImmediateRestart = 0
          RteBswPositionInTask = 21
          RteBswEventRef = BswTE_CanTp_MainFunction
          RteBswMappedToTaskRef = OsTask_BSW_FG1_5ms_Com
          RteBswUsedOsAlarmRef = OsAlarm_BSW_5ms_Com
        TIMER_PROTECTION (RteBswExclusiveAreaImpl):
          category = TOOL_CONFIGURED
          RteExclusiveAreaImplMechanism = ALL_INTERRUPT_BLOCKING
          RteBswExclusiveAreaRef = TIMER_PROTECTION
          RteBswExclusiveAreaOsResourceRef = OsResource_FG1
      BswInstance_Com: category=TOOL_CONFIGURED, RteBswImplementationRef=BswImplementation_Com, RteBswModuleConfigurationRef=Com
        3 x RteBswEventToTaskMapping, all with category=TOOL_CONFIGURED, RteBswImmediateRestart=0, RteBswMappedToTaskRef=OsTask_BSW_FG1_5ms_Com, RteBswUsedOsAlarmRef=OsAlarm_BSW_5ms_Com:
          BswTE_Com_MainFunctionRx: RteBswPositionInTask=17, RteBswEventRef=BswTE_Com_MainFunctionRx
          BswTE_Com_MainFunctionTx: RteBswPositionInTask=19, RteBswEventRef=BswTE_Com_MainFunctionTx
          RteBswEventToTaskMapping0: RteBswPositionInTask=28, RteBswEventRef=BswTE_Com_MainFunctionRouteSignals
        21 x RteBswExclusiveAreaImpl, all with category=TOOL_CONFIGURED, RteExclusiveAreaImplMechanism=ALL_INTERRUPT_BLOCKING:
          IPDU_COUNTER_PROTECTION_RteBswExclusiveAreaImpl: RteBswExclusiveAreaRef=IPDU_COUNTER_PROTECTION
          IPDU_GROUP_STATUS_PROTECTION_RteBswExclusiveAreaImpl: RteBswExclusiveAreaRef=IPDU_GROUP_STATUS_PROTECTION
          IPDU_GRP_STS_PROTECTION_RteBswExclusiveAreaImpl: RteBswExclusiveAreaRef=IPDU_GRP_STS_PROTECTION
          IPDU_STS_PROTECTION_RteBswExclusiveAreaImpl: RteBswExclusiveAreaRef=IPDU_STS_PROTECTION
          RX_DM_STS_PROTECTION_AREA_RteBswExclusiveAreaImpl: RteBswExclusiveAreaRef=RX_DM_STS_PROTECTION_AREA
          RX_EXT_SIG_DATA_PROTECTION_AREA_RteBswExclusiveAreaImpl: RteBswExclusiveAreaRef=RX_EXT_SIG_DATA_PROTECTION_AREA
          RX_FIFO_PROTECTION_AREA_RteBswExclusiveAreaImpl: RteBswExclusiveAreaRef=RX_FIFO_PROTECTION_AREA
          RX_GW_STS_PROTECTION_AREA_RteBswExclusiveAreaImpl: RteBswExclusiveAreaRef=RX_GW_STS_PROTECTION_AREA
          RX_IPDU_DATA_PROTECTION_AREA_RteBswExclusiveAreaImpl: RteBswExclusiveAreaRef=RX_IPDU_DATA_PROTECTION_AREA
          RX_IPDU_STATUS_PROTECTION_AREA_RteBswExclusiveAreaImpl: RteBswExclusiveAreaRef=RX_IPDU_STATUS_PROTECTION_AREA
          RX_IPDU_STS_PROTECTION_AREA_RteBswExclusiveAreaImpl: RteBswExclusiveAreaRef=RX_IPDU_STS_PROTECTION_AREA
          RX_SIG_DATA_PROTECTION_AREA_RteBswExclusiveAreaImpl: RteBswExclusiveAreaRef=RX_SIG_DATA_PROTECTION_AREA
          SIG_DATA_PROTECTION_AREA_RteBswExclusiveAreaImpl: RteBswExclusiveAreaRef=SIG_DATA_PROTECTION_AREA
          TX_DM_STS_PROTECTION_AREA_RteBswExclusiveAreaImpl: RteBswExclusiveAreaRef=TX_DM_STS_PROTECTION_AREA
          TX_EXT_SIG_DATA_PROTECTION_AREA_RteBswExclusiveAreaImpl: RteBswExclusiveAreaRef=TX_EXT_SIG_DATA_PROTECTION_AREA
          TX_IPDU_BUFFER_PROTECTION_AREA_RteBswExclusiveAreaImpl: RteBswExclusiveAreaRef=TX_IPDU_BUFFER_PROTECTION_AREA
          TX_IPDU_DATA_PROTECTION_RteBswExclusiveAreaImpl: RteBswExclusiveAreaRef=TX_IPDU_DATA_PROTECTION
          TX_IPDU_STATUS_PROTECTION_AREA_RteBswExclusiveAreaImpl: RteBswExclusiveAreaRef=TX_IPDU_STATUS_PROTECTION_AREA
          TX_MDT_PROTECTION_AREA_RteBswExclusiveAreaImpl: RteBswExclusiveAreaRef=TX_MDT_PROTECTION_AREA
          TX_MDT_STS_PROTECTION_AREA_RteBswExclusiveAreaImpl: RteBswExclusiveAreaRef=TX_MDT_STS_PROTECTION_AREA
          TX_TMS_STATUS_PROTECTION_AREA_RteBswExclusiveAreaImpl: RteBswExclusiveAreaRef=TX_TMS_STATUS_PROTECTION_AREA
      BswInstance_ComM: category=TOOL_CONFIGURED, RteBswImplementationRef=BswImplementation_ComM, RteBswModuleConfigurationRef=ComM
        BswSchedulableEntity_0_RteBswEventToTaskMapping (RteBswEventToTaskMapping):
          category = TOOL_CONFIGURED
          RteBswImmediateRestart = 0
          RteBswPositionInTask = 1
          RteBswEventRef = BswTE_ComM_MainFunction0
          RteBswMappedToTaskRef = OsTask_BSW_FG1_5ms_Com
          RteBswUsedOsAlarmRef = OsAlarm_BSW_5ms_Com
        8 x RteBswExclusiveAreaImpl, all with category=TOOL_CONFIGURED, RteExclusiveAreaImplMechanism=ALL_INTERRUPT_BLOCKING:
          CURRENT_MODE_PROTECTION_RteBswExclusiveAreaImpl: RteBswExclusiveAreaRef=CURRENT_MODE_PROTECTION
          DCM_DIAGNOSTIC_PROTECTION_RteBswExclusiveAreaImpl: RteBswExclusiveAreaRef=DCM_DIAGNOSTIC_PROTECTION
          ECUM_WAKEUP_IND_RteBswExclusiveAreaImpl: RteBswExclusiveAreaRef=ECUM_WAKEUP_IND
          INHIBIT_CNT_PROTECTION_RteBswExclusiveAreaImpl: RteBswExclusiveAreaRef=INHIBIT_CNT_PROTECTION
          NM_INDICATION_PROTECTION_RteBswExclusiveAreaImpl: RteBswExclusiveAreaRef=NM_INDICATION_PROTECTION
          PNC_PREPARE_TIMER_RteBswExclusiveAreaImpl: RteBswExclusiveAreaRef=PNC_PREPARE_TIMER
          PNC_WAKEUP_IND_RteBswExclusiveAreaImpl: RteBswExclusiveAreaRef=PNC_WAKEUP_IND
          REQ_MODECNT_PROTECTION_RteBswExclusiveAreaImpl: RteBswExclusiveAreaRef=REQ_MODECNT_PROTECTION
      BswInstance_Dcm: category=TOOL_CONFIGURED, RteBswImplementationRef=BswImplementation_Dcm, RteBswModuleConfigurationRef=Dcm
        BswSchedulableEntity_0_RteBswEventToTaskMapping (RteBswEventToTaskMapping):
          category = TOOL_CONFIGURED
          RteBswImmediateRestart = 0
          RteBswPositionInTask = 20
          RteBswEventRef = BswTE_Dcm_MainFunction
          RteBswMappedToTaskRef = OsTask_BSW_FG1_5ms_Com
          RteBswUsedOsAlarmRef = OsAlarm_BSW_5ms_Com
        5 x RteBswExclusiveAreaImpl, all with category=TOOL_CONFIGURED, RteExclusiveAreaImplMechanism=ALL_INTERRUPT_BLOCKING, RteBswExclusiveAreaOsResourceRef=OsResource_FG1:
          ProtclProtection: RteBswExclusiveAreaRef=ProtclProtection
          RxLengthProtection: RteBswExclusiveAreaRef=RxLengthProtection
          RxPduIdProtection: RteBswExclusiveAreaRef=RxPduIdProtection
          SIGNAL_DATA_PROTECTION_AREA: RteBswExclusiveAreaRef=SIGNAL_DATA_PROTECTION_AREA
          TimerProtection: RteBswExclusiveAreaRef=TimerProtection
      BswInstance_Dem: category=TOOL_CONFIGURED, RteBswImplementationRef=BswImplementation_Dem, RteBswModuleConfigurationRef=Dem
        RteBswEventToTaskMapping0 (RteBswEventToTaskMapping):
          category = TOOL_CONFIGURED
          RteBswImmediateRestart = 0
          RteBswPositionInTask = 0
          RteBswEventRef = BswTE_Dem_MainFunction
          RteBswMappedToTaskRef = OsTask_BSW_FG1_5ms_Mem
          RteBswUsedOsAlarmRef = OsAlarm_BSW_5ms_Mem
        RteBswExternalTriggerConfig0 (RteBswExternalTriggerConfig): category=TOOL_CONFIGURED, RteBswTriggerSourceQueueLength=1, RteBswTriggerSourceRef=ReleasedTrigger_ToNvM
        9 x RteBswExclusiveAreaImpl, all with category=TOOL_CONFIGURED, RteExclusiveAreaImplMechanism=ALL_INTERRUPT_BLOCKING, RteBswExclusiveAreaOsResourceRef=OsResource_FG1:
          CAPTURE_OBD_DATA: RteBswExclusiveAreaRef=CAPTURE_OBD_DATA
          REQUEST_BUFFER_PROTECTION: RteBswExclusiveAreaRef=REQUEST_BUFFER_PROTECTION
          REQUEST_DATA_PROTECTION: RteBswExclusiveAreaRef=REQUEST_DATA_PROTECTION
          REQUEST_DEBOUNCETIMEBASED: RteBswExclusiveAreaRef=REQUEST_DEBOUNCETIMEBASED
          REQUEST_NVDATA_PROTECTION: RteBswExclusiveAreaRef=REQUEST_NVDATA_PROTECTION
          REQUEST_OCCTIME_PROTECTION: RteBswExclusiveAreaRef=REQUEST_OCCTIME_PROTECTION
          REQUEST_OCC_PROTECTION: RteBswExclusiveAreaRef=REQUEST_OCC_PROTECTION
          REQUEST_RECORD_PROTECTION: RteBswExclusiveAreaRef=REQUEST_RECORD_PROTECTION
          REQUEST_STATUS_PROTECTION: RteBswExclusiveAreaRef=REQUEST_STATUS_PROTECTION
      BswInstance_Det: category=TOOL_CONFIGURED, RteBswImplementationRef=BswImplementation_Det, RteBswModuleConfigurationRef=Det
        DATA_PROTECTION_AREA (RteBswExclusiveAreaImpl): category=TOOL_CONFIGURED, RteExclusiveAreaImplMechanism=ALL_INTERRUPT_BLOCKING, RteBswExclusiveAreaRef=RAM_DATA_PROTECTION
      BswInstance_Dio: category=TOOL_CONFIGURED, RteBswImplementationRef=BswImplementation_Dio, RteBswModuleConfigurationRef=Dio
        DIO_EXCLUSIVE_AREA_RteBswExclusiveAreaImpl00 (RteBswExclusiveAreaImpl): category=TOOL_CONFIGURED, RteExclusiveAreaImplMechanism=ALL_INTERRUPT_BLOCKING, RteBswExclusiveAreaRef=DIO_EXCLUSIVE_AREA_00
      BswInstance_EcuM: category=TOOL_CONFIGURED, RteBswImplementationRef=BswImplementation_EcuM, RteBswModuleConfigurationRef=EcuM
        RteBswEventToTaskMapping_EcuM_LoopDetection (RteBswEventToTaskMapping):
          category = TOOL_CONFIGURED
          RteBswImmediateRestart = 0
          RteBswPositionInTask = 4
          RteBswEventRef = BswTE_EcuM_LoopDetection
          RteBswMappedToTaskRef = OsTask_BSW_FG1_10ms
          RteBswUsedOsAlarmRef = OsAlarm_BSW_10ms
        RteBswEventToTaskMapping_EcuM_MainFunction (RteBswEventToTaskMapping):
          category = TOOL_CONFIGURED
          RteBswImmediateRestart = 0
          RteBswPositionInTask = 2
          RteBswEventRef = BswTE_EcuM_MainFunction
          RteBswMappedToTaskRef = OsTask_BSW_FG1_10ms
          RteBswUsedOsAlarmRef = OsAlarm_BSW_10ms
        7 x RteBswExclusiveAreaImpl, all with category=TOOL_CONFIGURED, RteExclusiveAreaImplMechanism=ALL_INTERRUPT_BLOCKING:
          ALARM_TIME_PROTECTION_RteBswExclusiveAreaImpl: RteBswExclusiveAreaRef=ALARM_TIME_PROTECTION
          BOOT_TARGET_PROTECTION_RteBswExclusiveAreaImpl: RteBswExclusiveAreaRef=BOOT_TARGET_PROTECTION
          SHUTDOWN_CAUSE_RteBswExclusiveAreaImpl: RteBswExclusiveAreaRef=SHUTDOWN_CAUSE
          SHUTDOWN_OR_SLEEP_FLAG_PROTECTION_RteBswExclusiveAreaImpl: RteBswExclusiveAreaRef=SHUTDOWN_OR_SLEEP_FLAG_PROTECTION
          SHUTDOWN_TARGET_PROTECTION_RteBswExclusiveAreaImpl: RteBswExclusiveAreaRef=SHUTDOWN_TARGET_PROTECTION
          STATE_PROTECTION_RteBswExclusiveAreaImpl: RteBswExclusiveAreaRef=STATE_PROTECTION
          WAKEUP_STATUS_PROTECTION_RteBswExclusiveAreaImpl: RteBswExclusiveAreaRef=WAKEUP_STATUS_PROTECTION
      BswInstance_FiM: category=TOOL_CONFIGURED, RteBswImplementationRef=BswImplementation_FiM, RteBswModuleConfigurationRef=FiM
        REQUEST_EVENTID_PROTECTION (RteBswExclusiveAreaImpl): category=TOOL_CONFIGURED, RteExclusiveAreaImplMechanism=ALL_INTERRUPT_BLOCKING, RteBswExclusiveAreaRef=REQUEST_EVENTID_PROTECTION
        REQUEST_FID_PROTECTION (RteBswExclusiveAreaImpl): category=TOOL_CONFIGURED, RteExclusiveAreaImplMechanism=ALL_INTERRUPT_BLOCKING, RteBswExclusiveAreaRef=REQUEST_FID_PROTECTION
      BswInstance_Fls: category=TOOL_CONFIGURED, RteBswImplementationRef=BswImplementation_Fls, RteBswModuleConfigurationRef=Fls
        10 x RteBswExclusiveAreaImpl, all with category=TOOL_CONFIGURED, RteExclusiveAreaImplMechanism=ALL_INTERRUPT_BLOCKING:
          FLS_EXCLUSIVE_AREA_RteBswExclusiveAreaImpl{00..08}: RteBswExclusiveAreaRef=FLS_EXCLUSIVE_AREA_{00..08}
          FLS_EXCLUSIVE_AREA_RteBswExclusiveAreaImpl10: RteBswExclusiveAreaRef=FLS_EXCLUSIVE_AREA_10
      BswInstance_Gpt: category=TOOL_CONFIGURED, RteBswImplementationRef=BswImplementation_Gpt, RteBswModuleConfigurationRef=Gpt
        65 x RteBswExclusiveAreaImpl, all with category=TOOL_CONFIGURED, RteExclusiveAreaImplMechanism=ALL_INTERRUPT_BLOCKING:
          GPT_EXCLUSIVE_AREA_RteBswExclusiveAreaImpl{00..60}: RteBswExclusiveAreaRef=GPT_EXCLUSIVE_AREA_{00..60}
          GPT_EXCLUSIVE_AREA_RteBswExclusiveAreaImpll61: RteBswExclusiveAreaRef=GPT_EXCLUSIVE_AREA_61
          GPT_EXCLUSIVE_AREA_RteBswExclusiveAreaImpl{62..64}: RteBswExclusiveAreaRef=GPT_EXCLUSIVE_AREA_{62..64}
      BswInstance_Icu_43: category=TOOL_CONFIGURED, RteBswImplementationRef=BswImplementation_Icu_43, RteBswModuleConfigurationRef=Icu
        22 x RteBswExclusiveAreaImpl, all with category=TOOL_CONFIGURED, RteExclusiveAreaImplMechanism=ALL_INTERRUPT_BLOCKING:
          ICU_EXCLUSIVE_AREA_RteBswExclusiveAreaImpl{00..21}: RteBswExclusiveAreaRef=ICU_EXCLUSIVE_AREA_{00..21}
      BswInstance_IoHwAb: category=TOOL_CONFIGURED, RteBswImplementationRef=BswImplementation_IoHwAb, RteBswModuleConfigurationRef=IoHwAb
        RteBswEventToTaskMapping_TE_IOM_10ms (RteBswEventToTaskMapping):
          category = TOOL_CONFIGURED
          RteBswImmediateRestart = 0
          RteBswPositionInTask = 0
          RteBswEventRef = BswTE_IoHwAb_IOM_10ms
          RteBswMappedToTaskRef = OsTask_BSW_FG1_10ms
          RteBswUsedOsAlarmRef = OsAlarm_BSW_10ms
        RteBswExclusiveAreaImpl_IoHwAbProtection (RteBswExclusiveAreaImpl): category=TOOL_CONFIGURED, RteExclusiveAreaImplMechanism=ALL_INTERRUPT_BLOCKING, RteBswExclusiveAreaRef=IoHwAbProtection
        RteBswRequiredModeGroupConnection0 (RteBswRequiredModeGroupConnection): RteBswProvidedModeGroupRef=modeSwitchPort_EcuMode, RteBswRequiredModeGroupRef=IoHwAb_EM_R, RteBswProvidedModeGrpModInstRef=BswInstance_BswM
        BswTE_IoHwAb_IOM_5ms (RteBswEventToTaskMapping):
          category = TOOL_CONFIGURED
          RteBswImmediateRestart = false
          RteBswPositionInTask = 0
          RteBswEventRef = BswTE_IoHwAb_IOM_5ms
          RteBswMappedToTaskRef = OsTask_BSW_FG1_5ms_Com
          RteBswUsedOsAlarmRef = OsAlarm_BSW_5ms_Com
      BswInstance_Mcu: category=TOOL_CONFIGURED, RteBswImplementationRef=BswImplementation_Mcu, RteBswModuleConfigurationRef=Mcu
        4 x RteBswExclusiveAreaImpl, all with category=TOOL_CONFIGURED, RteExclusiveAreaImplMechanism=ALL_INTERRUPT_BLOCKING:
          MCU_EXCLUSIVE_AREA_RteBswExclusiveAreaImpl{00..03}: RteBswExclusiveAreaRef=MCU_EXCLUSIVE_AREA_{00..03}
      BswInstance_NvM: category=TOOL_CONFIGURED, RteBswImplementationRef=BswImplementation_NvM, RteBswModuleConfigurationRef=NvM
        3 x RteBswEventToTaskMapping, all with category=TOOL_CONFIGURED, RteBswImmediateRestart=0:
          RteBswEventToTaskMapping0: RteBswPositionInTask=1, RteBswEventRef=BTE_NvM, RteBswMappedToTaskRef=OsTask_BSW_FG1_5ms_Mem, RteBswUsedOsAlarmRef=OsAlarm_BSW_5ms_Mem
          RteBswEventToTaskMapping1: RteBswPositionInTask=2, RteBswEventRef=BETOE_CallCyclicMemFunction, RteBswMappedToTaskRef=OsTask_BSW_Mem_Process
          RteBswEventToTaskMapping_Cycle: RteBswPositionInTask=1, RteBswEventRef=BITOE_MemMemFunction, RteBswMappedToTaskRef=OsTask_BSW_Mem_Process
        RteBswInternalTriggerConfig0 (RteBswInternalTriggerConfig): category=TOOL_CONFIGURED, RteBswTriggerSourceQueueLength=1, RteBswTriggerSourceRef=BITP_CallCyclicMemFunction
        RAM_INDEX (RteBswExclusiveAreaImpl): category=TOOL_CONFIGURED, RteExclusiveAreaImplMechanism=ALL_INTERRUPT_BLOCKING, RteBswExclusiveAreaRef=RAM_INDEX
        RAM_STATUS_PROTECTION (RteBswExclusiveAreaImpl): category=TOOL_CONFIGURED, RteExclusiveAreaImplMechanism=ALL_INTERRUPT_BLOCKING, RteBswExclusiveAreaRef=RAM_STATUS_PROTECTION
        RteBswRequiredModeGroupConnection0 (RteBswRequiredModeGroupConnection):
          category = TOOL_CONFIGURED
          RteBswProvidedModeGroupRef = MemCyclicMode
          RteBswRequiredModeGroupRef = MemCyclicMode_R
          RteBswProvidedModeGrpModInstRef = BswInstance_NvM
        RequiredTrigger_FromDem (RteBswRequiredTriggerConnection):
          category = TOOL_CONFIGURED
          RteBswReleasedTriggerRef = ReleasedTrigger_ToNvM
          RteBswRequiredTriggerRef = RequiredTrigger_FromDem
          RteBswReleasedTriggerModInstRef = BswInstance_Dem
      BswInstance_PduR: category=TOOL_CONFIGURED, RteBswImplementationRef=BswImplementation_PduR, RteBswModuleConfigurationRef=PduR
        4 x RteBswExclusiveAreaImpl, all with category=TOOL_CONFIGURED, RteExclusiveAreaImplMechanism=ALL_INTERRUPT_BLOCKING:
          PDUR_DATA_BUFFER_PROTECTION_AREA_RteBswExclusiveAreaImpl: RteBswExclusiveAreaRef=DATA_BUFFER_PROTECTION_AREA
          PDUR_FIFO_STATUS_PROTECTION_AREA_RteBswExclusiveAreaImpl: RteBswExclusiveAreaRef=FIFO_STATUS_PROTECTION_AREA
          PDUR_GROUP_STATUS_PROTECTION_AREA_RteBswExclusiveAreaImpl: RteBswExclusiveAreaRef=GROUP_STATUS_PROTECTION_AREA
          PDUR_TP_TX_PROTECTION_AREA_RteBswExclusiveAreaImpl: RteBswExclusiveAreaRef=TP_TX_PROTECTION_AREA
      BswInstance_Port: category=TOOL_CONFIGURED, RteBswImplementationRef=BswImplementation_Port, RteBswModuleConfigurationRef=Port
        PORT_EXCLUSIVE_AREA_RteBswExclusiveAreaImpl00 (RteBswExclusiveAreaImpl): category=TOOL_CONFIGURED, RteExclusiveAreaImplMechanism=ALL_INTERRUPT_BLOCKING, RteBswExclusiveAreaRef=PORT_EXCLUSIVE_AREA_00
        PORT_EXCLUSIVE_AREA_RteBswExclusiveAreaImpl01 (RteBswExclusiveAreaImpl): category=TOOL_CONFIGURED, RteExclusiveAreaImplMechanism=ALL_INTERRUPT_BLOCKING, RteBswExclusiveAreaRef=PORT_EXCLUSIVE_AREA_01
      BswInstance_Pwm_43: category=TOOL_CONFIGURED, RteBswImplementationRef=BswImplementation_Pwm_43, RteBswModuleConfigurationRef=Pwm
        65 x RteBswExclusiveAreaImpl, all with category=TOOL_CONFIGURED, RteExclusiveAreaImplMechanism=ALL_INTERRUPT_BLOCKING:
          PWM_EXCLUSIVE_AREA_RteBswExclusiveAreaImpl{00..60}: RteBswExclusiveAreaRef=PWM_EXCLUSIVE_AREA_{00..60}
          PWM_EXCLUSIVE_AREA_RteBswExclusiveAreaImpll61: RteBswExclusiveAreaRef=PWM_EXCLUSIVE_AREA_61
          PWM_EXCLUSIVE_AREA_RteBswExclusiveAreaImpl{62..64}: RteBswExclusiveAreaRef=PWM_EXCLUSIVE_AREA_{62..64}
      BswInstance_Spi: category=TOOL_CONFIGURED, RteBswImplementationRef=BswImplementation_Spi, RteBswModuleConfigurationRef=Spi
        6 x RteBswExclusiveAreaImpl, all with category=TOOL_CONFIGURED, RteExclusiveAreaImplMechanism=ALL_INTERRUPT_BLOCKING:
          SPI_EXCLUSIVE_AREA_RteBswExclusiveAreaImpl{01..06}: RteBswExclusiveAreaRef=SPI_EXCLUSIVE_AREA_{01..06}
      BswInstance_Wdg: category=TOOL_CONFIGURED, RteBswImplementationRef=BswImplementation_Wdg_43, RteBswModuleConfigurationRef=Wdg
        WDG_EXCLUSIVE_AREA_RteBswExclusiveAreaImpl00 (RteBswExclusiveAreaImpl): category=TOOL_CONFIGURED, RteExclusiveAreaImplMechanism=ALL_INTERRUPT_BLOCKING, RteBswExclusiveAreaRef=WDG_EXCLUSIVE_AREA_00
      BswInstance_WdgIf: RteBswImplementationRef=BswImplementation_WdgIf, RteBswModuleConfigurationRef=WdgIf
      BswInstance_WdgM: category=TOOL_CONFIGURED, RteBswImplementationRef=BswImplementation_WdgM, RteBswModuleConfigurationRef=WdgM
        RteBswEventToTaskMapping:
          category = TOOL_CONFIGURED
          RteBswImmediateRestart = 0
          RteBswPositionInTask = 1
          RteBswEventRef = BswTE_WdgM_MainFunction
          RteBswMappedToTaskRef = OsTask_BSW_FG1_10ms
          RteBswUsedOsAlarmRef = OsAlarm_BSW_10ms
        RteBswExclusiveAreaImpl_GLOBALSUPVSNSTATUS_PROTECTION (RteBswExclusiveAreaImpl): category=TOOL_CONFIGURED, RteExclusiveAreaImplMechanism=ALL_INTERRUPT_BLOCKING, RteBswExclusiveAreaRef=GLOBALSUPVSNSTATUS_PROTECTION
        RteBswRequiredModeGroupConnection0 (RteBswRequiredModeGroupConnection):
          category = TOOL_CONFIGURED
          RteBswProvidedModeGroupRef = modeSwitchPort_EcuMode
          RteBswRequiredModeGroupRef = modeNotificationPort_EcuMode
          RteBswProvidedModeGrpModInstRef = BswInstance_BswM
      BswInstance_Os: category=TOOL_CONFIGURED, RteBswImplementationRef=BswImplementation_Os, RteBswModuleConfigurationRef=Os
        RteBswEventToTaskMapping0 (RteBswEventToTaskMapping):
          category = TOOL_CONFIGURED
          RteBswImmediateRestart = 0
          RteBswPositionInTask = 7
          RteBswEventRef = BswTE_Os_MeasureCPULoadRun
          RteBswMappedToTaskRef = OsTask_BSW_FG1_10ms
          RteBswUsedOsAlarmRef = OsAlarm_BSW_10ms
        RteBswRequiredModeGroupConnection0 (RteBswRequiredModeGroupConnection): RteBswProvidedModeGroupRef=modeSwitchPort_EcuMode, RteBswRequiredModeGroupRef=Os_EM_R, RteBswProvidedModeGrpModInstRef=BswInstance_BswM
    RteGeneration0 (RteGeneration):
      RteCalibrationSupport = INITIALIZED_RAM
      RteDevErrorDetect = 0
      RteDevErrorDetectUninit = 0
      RteGenerationMode = COMPATIBILITY_MODE
      RteIocInteractionReturnValue = RTE_IOC
      RteMeasurementSupport = 0
      RteOptimizationMode = RUNTIME
      RteValueRangeCheckEnabled = 0
      RteVfbTraceEnabled = 0
      RteCodeVendorId = (unset)
    RteOsInteraction0 (RteOsInteraction): SynchronizedActivateOffset=1, RteSynchronizedOsCounterRef=OsCounter_0
      5 x RteUsedOsActivation, all with AlarmSetMethodIsRelative=1:
        RteUsedOsActivation_BSW_5ms_Mem: RteExpectedActivationOffset=0.0025, RteExpectedActivationPosition=0, RteActivationOsAlarmRef=OsAlarm_BSW_5ms_Mem
        RteUsedOsActivation_BSW_5ms_Com: RteExpectedActivationOffset=0.0025, RteExpectedActivationPosition=1, RteActivationOsAlarmRef=OsAlarm_BSW_5ms_Com
        RteUsedOsActivation_BSW_10ms: RteExpectedActivationOffset=0.005, RteExpectedActivationPosition=2, RteActivationOsAlarmRef=OsAlarm_BSW_10ms
        RteUsedOsActivation_ASW_10ms: RteExpectedActivationOffset=0.00375, RteExpectedActivationPosition=3, RteActivationOsAlarmRef=OsAlarm_ASW_10ms
        RteUsedOsActivation_ASW_100ms: RteExpectedActivationOffset=0.01875, RteExpectedActivationPosition=4, RteActivationOsAlarmRef=OsAlarm_ASW_100ms
    RtePostBuildVariantConfiguration
    16 x RteSwComponentInstance, all with category=TOOL_CONFIGURED:
      SwcInstance_BswM: RteSoftwareComponentInstanceRef=BswM
        RteEventToTaskMapping_DRE_BswM_Immediate_SwcModeRequest_AppMode_modeRequestPort_AppMode_AppMode (RteEventToTaskMapping):
          category = TOOL_CONFIGURED
          RteImmediateRestart = 0
          RtePositionInTask = 0
          RteEventRef = DRE_BswM_Immediate_SwcModeRequest_AppMode_modeRequestPort_AppMode_AppMode
          RteMappedToTaskRef = OsTask_BSW_AppModeRequest
        RteEventToTaskMapping_DRE_BswM_Immediate_SwcModeRequest_ComMMode_Project_modeRequestPort_ComMMode_Project_ComMMode_Project (RteEventToTaskMapping):
          category = TOOL_CONFIGURED
          RteImmediateRestart = 0
          RtePositionInTask = 0
          RteEventRef = DRE_BswM_Immediate_SwcModeRequest_ComMMode_Project_modeRequestPort_ComMMode_Project_ComMMode_Project
          RteMappedToTaskRef = OsTask_BSW_ComMModeRequest
      SwcInstance_ComM: RteSoftwareComponentInstanceRef=ComM
        22 x RteEventToTaskMapping, all with category=TOOL_CONFIGURED, RteImmediateRestart=0:
          RteEventToTaskMapping_OIE_GetCurrentComMode_UR000: RteEventRef=OIE_GetCurrentComMode_UR000
          RteEventToTaskMapping_OIE_GetCurrentComMode_UR001: RteEventRef=OIE_GetCurrentComMode_UR001
          RteEventToTaskMapping_OIE_GetInhibitionStatus_CL000: RteEventRef=OIE_GetInhibitionStatus_CL000
          RteEventToTaskMapping_OIE_GetInhibitionStatus_CL001: RteEventRef=OIE_GetInhibitionStatus_CL001
          RteEventToTaskMapping_OIE_GetRequestedComMode_UR000: RteEventRef=OIE_GetRequestedComMode_UR000
          RteEventToTaskMapping_OIE_GetRequestedComMode_UR001: RteEventRef=OIE_GetRequestedComMode_UR001
          RteEventToTaskMapping_OIE_GetState_CL000: RteEventRef=OIE_GetState_CL000
          RteEventToTaskMapping_OIE_GetState_CL001: RteEventRef=OIE_GetState_CL001
          RteEventToTaskMapping_OIE_GetStatus_ML: RteEventRef=OIE_GetStatus_ML
          RteEventToTaskMapping_OIE_LimitChannelToNoComMode_CL000: RteEventRef=OIE_LimitChannelToNoComMode_CL000
          RteEventToTaskMapping_OIE_LimitChannelToNoComMode_CL001: RteEventRef=OIE_LimitChannelToNoComMode_CL001
          RteEventToTaskMapping_OIE_LimitECUToNoComMode_ML: RteEventRef=OIE_LimitECUToNoComMode_ML
          RteEventToTaskMapping_OIE_PreventWakeup_CL000: RteEventRef=OIE_PreventWakeup_CL000
          RteEventToTaskMapping_OIE_PreventWakeup_CL001: RteEventRef=OIE_PreventWakeup_CL001
          RteEventToTaskMapping_OIE_ReadInhibitCounter_ML: RteEventRef=OIE_ReadInhibitCounter_ML
          RteEventToTaskMapping_OIE_RequestComMode_UR000: RteEventRef=OIE_RequestComMode_UR000
          RteEventToTaskMapping_OIE_RequestComMode_UR001: RteEventRef=OIE_RequestComMode_UR001
          RteEventToTaskMapping_OIE_ResetInhibitCounter_ML: RteEventRef=OIE_ResetInhibitCounter_ML
          RteEventToTaskMapping_OIE_SetECUGroupClassification_ML: RteEventRef=OIE_SetECUGroupClassification_ML
          RteEventToTaskMapping_OperationInvokedEvent_GetCurrentComMode_ComMChannel_Project: RteEventRef=OperationInvokedEvent_GetCurrentComMode_ComMChannel_Project
          RteEventToTaskMapping_OperationInvokedEvent_GetRequestedComMode_ComMChannel_Project: RteEventRef=OperationInvokedEvent_GetRequestedComMode_ComMChannel_Project
          RteEventToTaskMapping_OperationInvokedEvent_RequestComMode_ComMChannel_Project: RteEventRef=OperationInvokedEvent_RequestComMode_ComMChannel_Project
      SwcInstance_Dcm: RteSoftwareComponentInstanceRef=Dcm
        5 x RteEventToTaskMapping, all with category=TOOL_CONFIGURED:
          RteEventToTaskMapping_OIE_DCMServices_GetActiveProtocol: RteImmediateRestart=0, RteEventRef=OIE_DCMServices_GetActiveProtocol
          RteEventToTaskMapping_OIE_DCMServices_GetSecurityLevel: RteImmediateRestart=0, RteEventRef=OIE_DCMServices_GetSecurityLevel
          RteEventToTaskMapping_OIE_DCMServices_GetSesCtrlType: RteImmediateRestart=0, RteEventRef=OIE_DCMServices_GetSesCtrlType
          RteEventToTaskMapping_OIE_DCMServices_ResetToDefaultSession: RteImmediateRestart=0, RteEventRef=OIE_DCMServices_ResetToDefaultSession
          RteEventToTaskMapping_OIE_DCMServices_GetCertificationInfo: RteImmediateRestart=false, RteEventRef=OIE_DCMServices_GetCertificationInfo
      SwcInstance_Dem: RteSoftwareComponentInstanceRef=Dem
        514 x RteEventToTaskMapping, all with category=TOOL_CONFIGURED:
          RteEventToTaskMapping_OIE_EnableCond_DemEnableCondition_SetEnableCondition: RteImmediateRestart=0, RteEventRef=OIE_EnableCond_DemEnableCondition_SetEnableCondition
          RteEventToTaskMapping_OIE_EventInfo_ADC_E_TIMEOUT_GetDTCOfEvent: RteImmediateRestart=0, RteEventRef=OIE_EventInfo_ADC_E_TIMEOUT_GetDTCOfEvent
          RteEventToTaskMapping_OIE_EventInfo_ADC_E_TIMEOUT_GetEventExtendedDataRecord: RteImmediateRestart=0, RteEventRef=OIE_EventInfo_ADC_E_TIMEOUT_GetEventExtendedDataRecord
          RteEventToTaskMapping_OIE_EventInfo_ADC_E_TIMEOUT_GetEventFailed: RteImmediateRestart=0, RteEventRef=OIE_EventInfo_ADC_E_TIMEOUT_GetEventFailed
          RteEventToTaskMapping_OIE_EventInfo_ADC_E_TIMEOUT_GetEventFreezeFrameData: RteImmediateRestart=0, RteEventRef=OIE_EventInfo_ADC_E_TIMEOUT_GetEventFreezeFrameData
          RteEventToTaskMapping_OIE_EventInfo_ADC_E_TIMEOUT_GetEventStatus: RteImmediateRestart=0, RteEventRef=OIE_EventInfo_ADC_E_TIMEOUT_GetEventStatus
          RteEventToTaskMapping_OIE_EventInfo_ADC_E_TIMEOUT_GetEventTested: RteImmediateRestart=0, RteEventRef=OIE_EventInfo_ADC_E_TIMEOUT_GetEventTested
          RteEventToTaskMapping_OIE_EventInfo_ADC_E_TIMEOUT_GetFaultDetectionCounter: RteImmediateRestart=0, RteEventRef=OIE_EventInfo_ADC_E_TIMEOUT_GetFaultDetectionCounter
          RteEventToTaskMapping_OIE_EventInfo_CANSM_E_BUS_OFF_GetDTCOfEvent: RteImmediateRestart=0, RteEventRef=OIE_EventInfo_CANSM_E_BUS_OFF_GetDTCOfEvent
          RteEventToTaskMapping_OIE_EventInfo_CANSM_E_BUS_OFF_GetEventExtendedDataRecord: RteImmediateRestart=0, RteEventRef=OIE_EventInfo_CANSM_E_BUS_OFF_GetEventExtendedDataRecord
          RteEventToTaskMapping_OIE_EventInfo_CANSM_E_BUS_OFF_GetEventFailed: RteImmediateRestart=0, RteEventRef=OIE_EventInfo_CANSM_E_BUS_OFF_GetEventFailed
          RteEventToTaskMapping_OIE_EventInfo_CANSM_E_BUS_OFF_GetEventFreezeFrameData: RteImmediateRestart=0, RteEventRef=OIE_EventInfo_CANSM_E_BUS_OFF_GetEventFreezeFrameData
          RteEventToTaskMapping_OIE_EventInfo_CANSM_E_BUS_OFF_GetEventStatus: RteImmediateRestart=0, RteEventRef=OIE_EventInfo_CANSM_E_BUS_OFF_GetEventStatus
          RteEventToTaskMapping_OIE_EventInfo_CANSM_E_BUS_OFF_GetEventTested: RteImmediateRestart=0, RteEventRef=OIE_EventInfo_CANSM_E_BUS_OFF_GetEventTested
          RteEventToTaskMapping_OIE_EventInfo_CANSM_E_BUS_OFF_GetFaultDetectionCounter: RteImmediateRestart=0, RteEventRef=OIE_EventInfo_CANSM_E_BUS_OFF_GetFaultDetectionCounter
          RteEventToTaskMapping_OIE_EventInfo_DEM_E_TEST_EVENT1_GetDTCOfEvent: RteImmediateRestart=0, RteEventRef=OIE_EventInfo_DEM_E_TEST_EVENT1_GetDTCOfEvent
          RteEventToTaskMapping_OIE_EventInfo_DEM_E_TEST_EVENT1_GetEventExtendedDataRecord: RteImmediateRestart=0, RteEventRef=OIE_EventInfo_DEM_E_TEST_EVENT1_GetEventExtendedDataRecord
          RteEventToTaskMapping_OIE_EventInfo_DEM_E_TEST_EVENT1_GetEventFailed: RteImmediateRestart=0, RteEventRef=OIE_EventInfo_DEM_E_TEST_EVENT1_GetEventFailed
          RteEventToTaskMapping_OIE_EventInfo_DEM_E_TEST_EVENT1_GetEventFreezeFrameData: RteImmediateRestart=0, RteEventRef=OIE_EventInfo_DEM_E_TEST_EVENT1_GetEventFreezeFrameData
          RteEventToTaskMapping_OIE_EventInfo_DEM_E_TEST_EVENT1_GetEventStatus: RteImmediateRestart=0, RteEventRef=OIE_EventInfo_DEM_E_TEST_EVENT1_GetEventStatus
          RteEventToTaskMapping_OIE_EventInfo_DEM_E_TEST_EVENT1_GetEventTested: RteImmediateRestart=0, RteEventRef=OIE_EventInfo_DEM_E_TEST_EVENT1_GetEventTested
          RteEventToTaskMapping_OIE_EventInfo_DEM_E_TEST_EVENT1_GetFaultDetectionCounter: RteImmediateRestart=0, RteEventRef=OIE_EventInfo_DEM_E_TEST_EVENT1_GetFaultDetectionCounter
          RteEventToTaskMapping_OIE_EventInfo_DEM_E_TEST_EVENT2_GetDTCOfEvent: RteImmediateRestart=0, RteEventRef=OIE_EventInfo_DEM_E_TEST_EVENT2_GetDTCOfEvent
          RteEventToTaskMapping_OIE_EventInfo_DEM_E_TEST_EVENT2_GetEventExtendedDataRecord: RteImmediateRestart=0, RteEventRef=OIE_EventInfo_DEM_E_TEST_EVENT2_GetEventExtendedDataRecord
          RteEventToTaskMapping_OIE_EventInfo_DEM_E_TEST_EVENT2_GetEventFailed: RteImmediateRestart=0, RteEventRef=OIE_EventInfo_DEM_E_TEST_EVENT2_GetEventFailed
          RteEventToTaskMapping_OIE_EventInfo_DEM_E_TEST_EVENT2_GetEventFreezeFrameData: RteImmediateRestart=0, RteEventRef=OIE_EventInfo_DEM_E_TEST_EVENT2_GetEventFreezeFrameData
          RteEventToTaskMapping_OIE_EventInfo_DEM_E_TEST_EVENT2_GetEventStatus: RteImmediateRestart=0, RteEventRef=OIE_EventInfo_DEM_E_TEST_EVENT2_GetEventStatus
          RteEventToTaskMapping_OIE_EventInfo_DEM_E_TEST_EVENT2_GetEventTested: RteImmediateRestart=0, RteEventRef=OIE_EventInfo_DEM_E_TEST_EVENT2_GetEventTested
          RteEventToTaskMapping_OIE_EventInfo_DEM_E_TEST_EVENT2_GetFaultDetectionCounter: RteImmediateRestart=0, RteEventRef=OIE_EventInfo_DEM_E_TEST_EVENT2_GetFaultDetectionCounter
          RteEventToTaskMapping_OIE_EventInfo_DEM_E_TEST_EVENT3_GetDTCOfEvent: RteImmediateRestart=0, RteEventRef=OIE_EventInfo_DEM_E_TEST_EVENT3_GetDTCOfEvent
          RteEventToTaskMapping_OIE_EventInfo_DEM_E_TEST_EVENT3_GetEventExtendedDataRecord: RteImmediateRestart=0, RteEventRef=OIE_EventInfo_DEM_E_TEST_EVENT3_GetEventExtendedDataRecord
          RteEventToTaskMapping_OIE_EventInfo_DEM_E_TEST_EVENT3_GetEventFailed: RteImmediateRestart=0, RteEventRef=OIE_EventInfo_DEM_E_TEST_EVENT3_GetEventFailed
          RteEventToTaskMapping_OIE_EventInfo_DEM_E_TEST_EVENT3_GetEventFreezeFrameData: RteImmediateRestart=0, RteEventRef=OIE_EventInfo_DEM_E_TEST_EVENT3_GetEventFreezeFrameData
          RteEventToTaskMapping_OIE_EventInfo_DEM_E_TEST_EVENT3_GetEventStatus: RteImmediateRestart=0, RteEventRef=OIE_EventInfo_DEM_E_TEST_EVENT3_GetEventStatus
          RteEventToTaskMapping_OIE_EventInfo_DEM_E_TEST_EVENT3_GetEventTested: RteImmediateRestart=0, RteEventRef=OIE_EventInfo_DEM_E_TEST_EVENT3_GetEventTested
          RteEventToTaskMapping_OIE_EventInfo_DEM_E_TEST_EVENT3_GetFaultDetectionCounter: RteImmediateRestart=0, RteEventRef=OIE_EventInfo_DEM_E_TEST_EVENT3_GetFaultDetectionCounter
          RteEventToTaskMapping_OIE_EventInfo_DEM_E_TEST_EVENT4_GetDTCOfEvent: RteImmediateRestart=0, RteEventRef=OIE_EventInfo_DEM_E_TEST_EVENT4_GetDTCOfEvent
          RteEventToTaskMapping_OIE_EventInfo_DEM_E_TEST_EVENT4_GetEventExtendedDataRecord: RteImmediateRestart=0, RteEventRef=OIE_EventInfo_DEM_E_TEST_EVENT4_GetEventExtendedDataRecord
          RteEventToTaskMapping_OIE_EventInfo_DEM_E_TEST_EVENT4_GetEventFailed: RteImmediateRestart=0, RteEventRef=OIE_EventInfo_DEM_E_TEST_EVENT4_GetEventFailed
          RteEventToTaskMapping_OIE_EventInfo_DEM_E_TEST_EVENT4_GetEventFreezeFrameData: RteImmediateRestart=0, RteEventRef=OIE_EventInfo_DEM_E_TEST_EVENT4_GetEventFreezeFrameData
          RteEventToTaskMapping_OIE_EventInfo_DEM_E_TEST_EVENT4_GetEventStatus: RteImmediateRestart=0, RteEventRef=OIE_EventInfo_DEM_E_TEST_EVENT4_GetEventStatus
          RteEventToTaskMapping_OIE_EventInfo_DEM_E_TEST_EVENT4_GetEventTested: RteImmediateRestart=0, RteEventRef=OIE_EventInfo_DEM_E_TEST_EVENT4_GetEventTested
          RteEventToTaskMapping_OIE_EventInfo_DEM_E_TEST_EVENT4_GetFaultDetectionCounter: RteImmediateRestart=0, RteEventRef=OIE_EventInfo_DEM_E_TEST_EVENT4_GetFaultDetectionCounter
          RteEventToTaskMapping_OIE_EventInfo_DEM_E_TEST_EVENT5_GetDTCOfEvent: RteImmediateRestart=0, RteEventRef=OIE_EventInfo_DEM_E_TEST_EVENT5_GetDTCOfEvent
          RteEventToTaskMapping_OIE_EventInfo_DEM_E_TEST_EVENT5_GetEventExtendedDataRecord: RteImmediateRestart=0, RteEventRef=OIE_EventInfo_DEM_E_TEST_EVENT5_GetEventExtendedDataRecord
          RteEventToTaskMapping_OIE_EventInfo_DEM_E_TEST_EVENT5_GetEventFailed: RteImmediateRestart=0, RteEventRef=OIE_EventInfo_DEM_E_TEST_EVENT5_GetEventFailed
          RteEventToTaskMapping_OIE_EventInfo_DEM_E_TEST_EVENT5_GetEventFreezeFrameData: RteImmediateRestart=0, RteEventRef=OIE_EventInfo_DEM_E_TEST_EVENT5_GetEventFreezeFrameData
          RteEventToTaskMapping_OIE_EventInfo_DEM_E_TEST_EVENT5_GetEventStatus: RteImmediateRestart=0, RteEventRef=OIE_EventInfo_DEM_E_TEST_EVENT5_GetEventStatus
          RteEventToTaskMapping_OIE_EventInfo_DEM_E_TEST_EVENT5_GetEventTested: RteImmediateRestart=0, RteEventRef=OIE_EventInfo_DEM_E_TEST_EVENT5_GetEventTested
          RteEventToTaskMapping_OIE_EventInfo_DEM_E_TEST_EVENT5_GetFaultDetectionCounter: RteImmediateRestart=0, RteEventRef=OIE_EventInfo_DEM_E_TEST_EVENT5_GetFaultDetectionCounter
          RteEventToTaskMapping_OIE_EventInfo_DEM_E_TEST_EVENT6_GetDTCOfEvent: RteImmediateRestart=0, RteEventRef=OIE_EventInfo_DEM_E_TEST_EVENT6_GetDTCOfEvent
          RteEventToTaskMapping_OIE_EventInfo_DEM_E_TEST_EVENT6_GetEventExtendedDataRecord: RteImmediateRestart=0, RteEventRef=OIE_EventInfo_DEM_E_TEST_EVENT6_GetEventExtendedDataRecord
          RteEventToTaskMapping_OIE_EventInfo_DEM_E_TEST_EVENT6_GetEventFailed: RteImmediateRestart=0, RteEventRef=OIE_EventInfo_DEM_E_TEST_EVENT6_GetEventFailed
          RteEventToTaskMapping_OIE_EventInfo_DEM_E_TEST_EVENT6_GetEventFreezeFrameData: RteImmediateRestart=0, RteEventRef=OIE_EventInfo_DEM_E_TEST_EVENT6_GetEventFreezeFrameData
          RteEventToTaskMapping_OIE_EventInfo_DEM_E_TEST_EVENT6_GetEventStatus: RteImmediateRestart=0, RteEventRef=OIE_EventInfo_DEM_E_TEST_EVENT6_GetEventStatus
          RteEventToTaskMapping_OIE_EventInfo_DEM_E_TEST_EVENT6_GetEventTested: RteImmediateRestart=0, RteEventRef=OIE_EventInfo_DEM_E_TEST_EVENT6_GetEventTested
          RteEventToTaskMapping_OIE_EventInfo_DEM_E_TEST_EVENT6_GetFaultDetectionCounter: RteImmediateRestart=0, RteEventRef=OIE_EventInfo_DEM_E_TEST_EVENT6_GetFaultDetectionCounter
          RteEventToTaskMapping_OIE_EventInfo_ECUM_E_CONFIGURATION_DATA_INCONSISTENT_GetDTCOfEvent: RteImmediateRestart=0, RteEventRef=OIE_EventInfo_ECUM_E_CONFIGURATION_DATA_INCONSISTENT_GetDTCOfEvent
          RteEventToTaskMapping_OIE_EventInfo_ECUM_E_CONFIGURATION_DATA_INCONSISTENT_GetEventExtendedDataRecord: RteImmediateRestart=0, RteEventRef=OIE_EventInfo_ECUM_E_CONFIGURATION_DATA_INCONSISTENT_GetEventExtendedDataRecord
          RteEventToTaskMapping_OIE_EventInfo_ECUM_E_CONFIGURATION_DATA_INCONSISTENT_GetEventFailed: RteImmediateRestart=0, RteEventRef=OIE_EventInfo_ECUM_E_CONFIGURATION_DATA_INCONSISTENT_GetEventFailed
          RteEventToTaskMapping_OIE_EventInfo_ECUM_E_CONFIGURATION_DATA_INCONSISTENT_GetEventFreezeFrameData: RteImmediateRestart=0, RteEventRef=OIE_EventInfo_ECUM_E_CONFIGURATION_DATA_INCONSISTENT_GetEventFreezeFrameData
          RteEventToTaskMapping_OIE_EventInfo_ECUM_E_CONFIGURATION_DATA_INCONSISTENT_GetEventStatus: RteImmediateRestart=0, RteEventRef=OIE_EventInfo_ECUM_E_CONFIGURATION_DATA_INCONSISTENT_GetEventStatus
          RteEventToTaskMapping_OIE_EventInfo_ECUM_E_CONFIGURATION_DATA_INCONSISTENT_GetEventTested: RteImmediateRestart=0, RteEventRef=OIE_EventInfo_ECUM_E_CONFIGURATION_DATA_INCONSISTENT_GetEventTested
          RteEventToTaskMapping_OIE_EventInfo_ECUM_E_CONFIGURATION_DATA_INCONSISTENT_GetFaultDetectionCounter: RteImmediateRestart=0, RteEventRef=OIE_EventInfo_ECUM_E_CONFIGURATION_DATA_INCONSISTENT_GetFaultDetectionCounter
          RteEventToTaskMapping_OIE_EventInfo_ECUM_E_IMPROPER_CALLER_GetDTCOfEvent: RteImmediateRestart=0, RteEventRef=OIE_EventInfo_ECUM_E_IMPROPER_CALLER_GetDTCOfEvent
          RteEventToTaskMapping_OIE_EventInfo_ECUM_E_IMPROPER_CALLER_GetEventExtendedDataRecord: RteImmediateRestart=0, RteEventRef=OIE_EventInfo_ECUM_E_IMPROPER_CALLER_GetEventExtendedDataRecord
          RteEventToTaskMapping_OIE_EventInfo_ECUM_E_IMPROPER_CALLER_GetEventFailed: RteImmediateRestart=0, RteEventRef=OIE_EventInfo_ECUM_E_IMPROPER_CALLER_GetEventFailed
          RteEventToTaskMapping_OIE_EventInfo_ECUM_E_IMPROPER_CALLER_GetEventFreezeFrameData: RteImmediateRestart=0, RteEventRef=OIE_EventInfo_ECUM_E_IMPROPER_CALLER_GetEventFreezeFrameData
          RteEventToTaskMapping_OIE_EventInfo_ECUM_E_IMPROPER_CALLER_GetEventStatus: RteImmediateRestart=0, RteEventRef=OIE_EventInfo_ECUM_E_IMPROPER_CALLER_GetEventStatus
          RteEventToTaskMapping_OIE_EventInfo_ECUM_E_IMPROPER_CALLER_GetEventTested: RteImmediateRestart=0, RteEventRef=OIE_EventInfo_ECUM_E_IMPROPER_CALLER_GetEventTested
          RteEventToTaskMapping_OIE_EventInfo_ECUM_E_IMPROPER_CALLER_GetFaultDetectionCounter: RteImmediateRestart=0, RteEventRef=OIE_EventInfo_ECUM_E_IMPROPER_CALLER_GetFaultDetectionCounter
          RteEventToTaskMapping_OIE_EventInfo_ECUM_E_RAM_CHECK_FAILED_GetDTCOfEvent: RteImmediateRestart=0, RteEventRef=OIE_EventInfo_ECUM_E_RAM_CHECK_FAILED_GetDTCOfEvent
          RteEventToTaskMapping_OIE_EventInfo_ECUM_E_RAM_CHECK_FAILED_GetEventExtendedDataRecord: RteImmediateRestart=0, RteEventRef=OIE_EventInfo_ECUM_E_RAM_CHECK_FAILED_GetEventExtendedDataRecord
          RteEventToTaskMapping_OIE_EventInfo_ECUM_E_RAM_CHECK_FAILED_GetEventFailed: RteImmediateRestart=0, RteEventRef=OIE_EventInfo_ECUM_E_RAM_CHECK_FAILED_GetEventFailed
          RteEventToTaskMapping_OIE_EventInfo_ECUM_E_RAM_CHECK_FAILED_GetEventFreezeFrameData: RteImmediateRestart=0, RteEventRef=OIE_EventInfo_ECUM_E_RAM_CHECK_FAILED_GetEventFreezeFrameData
          RteEventToTaskMapping_OIE_EventInfo_ECUM_E_RAM_CHECK_FAILED_GetEventStatus: RteImmediateRestart=0, RteEventRef=OIE_EventInfo_ECUM_E_RAM_CHECK_FAILED_GetEventStatus
          RteEventToTaskMapping_OIE_EventInfo_ECUM_E_RAM_CHECK_FAILED_GetEventTested: RteImmediateRestart=0, RteEventRef=OIE_EventInfo_ECUM_E_RAM_CHECK_FAILED_GetEventTested
          RteEventToTaskMapping_OIE_EventInfo_ECUM_E_RAM_CHECK_FAILED_GetFaultDetectionCounter: RteImmediateRestart=0, RteEventRef=OIE_EventInfo_ECUM_E_RAM_CHECK_FAILED_GetFaultDetectionCounter
          RteEventToTaskMapping_OIE_EventInfo_FLS_E_COMPARE_FAILED_GetDTCOfEvent: RteImmediateRestart=0, RteEventRef=OIE_EventInfo_FLS_E_COMPARE_FAILED_GetDTCOfEvent
          RteEventToTaskMapping_OIE_EventInfo_FLS_E_COMPARE_FAILED_GetEventExtendedDataRecord: RteImmediateRestart=0, RteEventRef=OIE_EventInfo_FLS_E_COMPARE_FAILED_GetEventExtendedDataRecord
          RteEventToTaskMapping_OIE_EventInfo_FLS_E_COMPARE_FAILED_GetEventFailed: RteImmediateRestart=0, RteEventRef=OIE_EventInfo_FLS_E_COMPARE_FAILED_GetEventFailed
          RteEventToTaskMapping_OIE_EventInfo_FLS_E_COMPARE_FAILED_GetEventFreezeFrameData: RteImmediateRestart=0, RteEventRef=OIE_EventInfo_FLS_E_COMPARE_FAILED_GetEventFreezeFrameData
          RteEventToTaskMapping_OIE_EventInfo_FLS_E_COMPARE_FAILED_GetEventStatus: RteImmediateRestart=0, RteEventRef=OIE_EventInfo_FLS_E_COMPARE_FAILED_GetEventStatus
          RteEventToTaskMapping_OIE_EventInfo_FLS_E_COMPARE_FAILED_GetEventTested: RteImmediateRestart=0, RteEventRef=OIE_EventInfo_FLS_E_COMPARE_FAILED_GetEventTested
          RteEventToTaskMapping_OIE_EventInfo_FLS_E_COMPARE_FAILED_GetFaultDetectionCounter: RteImmediateRestart=0, RteEventRef=OIE_EventInfo_FLS_E_COMPARE_FAILED_GetFaultDetectionCounter
          RteEventToTaskMapping_OIE_EventInfo_FLS_E_ERASE_FAILED_GetDTCOfEvent: RteImmediateRestart=0, RteEventRef=OIE_EventInfo_FLS_E_ERASE_FAILED_GetDTCOfEvent
          RteEventToTaskMapping_OIE_EventInfo_FLS_E_ERASE_FAILED_GetEventExtendedDataRecord: RteImmediateRestart=0, RteEventRef=OIE_EventInfo_FLS_E_ERASE_FAILED_GetEventExtendedDataRecord
          RteEventToTaskMapping_OIE_EventInfo_FLS_E_ERASE_FAILED_GetEventFailed: RteImmediateRestart=0, RteEventRef=OIE_EventInfo_FLS_E_ERASE_FAILED_GetEventFailed
          RteEventToTaskMapping_OIE_EventInfo_FLS_E_ERASE_FAILED_GetEventFreezeFrameData: RteImmediateRestart=0, RteEventRef=OIE_EventInfo_FLS_E_ERASE_FAILED_GetEventFreezeFrameData
          RteEventToTaskMapping_OIE_EventInfo_FLS_E_ERASE_FAILED_GetEventStatus: RteImmediateRestart=0, RteEventRef=OIE_EventInfo_FLS_E_ERASE_FAILED_GetEventStatus
          RteEventToTaskMapping_OIE_EventInfo_FLS_E_ERASE_FAILED_GetEventTested: RteImmediateRestart=0, RteEventRef=OIE_EventInfo_FLS_E_ERASE_FAILED_GetEventTested
          RteEventToTaskMapping_OIE_EventInfo_FLS_E_ERASE_FAILED_GetFaultDetectionCounter: RteImmediateRestart=0, RteEventRef=OIE_EventInfo_FLS_E_ERASE_FAILED_GetFaultDetectionCounter
          RteEventToTaskMapping_OIE_EventInfo_FLS_E_READ_FAILED_GetDTCOfEvent: RteImmediateRestart=0, RteEventRef=OIE_EventInfo_FLS_E_READ_FAILED_GetDTCOfEvent
          RteEventToTaskMapping_OIE_EventInfo_FLS_E_READ_FAILED_GetEventExtendedDataRecord: RteImmediateRestart=0, RteEventRef=OIE_EventInfo_FLS_E_READ_FAILED_GetEventExtendedDataRecord
          RteEventToTaskMapping_OIE_EventInfo_FLS_E_READ_FAILED_GetEventFailed: RteImmediateRestart=0, RteEventRef=OIE_EventInfo_FLS_E_READ_FAILED_GetEventFailed
          RteEventToTaskMapping_OIE_EventInfo_FLS_E_READ_FAILED_GetEventFreezeFrameData: RteImmediateRestart=0, RteEventRef=OIE_EventInfo_FLS_E_READ_FAILED_GetEventFreezeFrameData
          RteEventToTaskMapping_OIE_EventInfo_FLS_E_READ_FAILED_GetEventStatus: RteImmediateRestart=0, RteEventRef=OIE_EventInfo_FLS_E_READ_FAILED_GetEventStatus
          RteEventToTaskMapping_OIE_EventInfo_FLS_E_READ_FAILED_GetEventTested: RteImmediateRestart=0, RteEventRef=OIE_EventInfo_FLS_E_READ_FAILED_GetEventTested
          RteEventToTaskMapping_OIE_EventInfo_FLS_E_READ_FAILED_GetFaultDetectionCounter: RteImmediateRestart=0, RteEventRef=OIE_EventInfo_FLS_E_READ_FAILED_GetFaultDetectionCounter
          RteEventToTaskMapping_OIE_EventInfo_FLS_E_UNEXPECTED_FLASH_ID_GetDTCOfEvent: RteImmediateRestart=0, RteEventRef=OIE_EventInfo_FLS_E_UNEXPECTED_FLASH_ID_GetDTCOfEvent
          RteEventToTaskMapping_OIE_EventInfo_FLS_E_UNEXPECTED_FLASH_ID_GetEventExtendedDataRecord: RteImmediateRestart=0, RteEventRef=OIE_EventInfo_FLS_E_UNEXPECTED_FLASH_ID_GetEventExtendedDataRecord
          RteEventToTaskMapping_OIE_EventInfo_FLS_E_UNEXPECTED_FLASH_ID_GetEventFailed: RteImmediateRestart=0, RteEventRef=OIE_EventInfo_FLS_E_UNEXPECTED_FLASH_ID_GetEventFailed
          RteEventToTaskMapping_OIE_EventInfo_FLS_E_UNEXPECTED_FLASH_ID_GetEventFreezeFrameData: RteImmediateRestart=0, RteEventRef=OIE_EventInfo_FLS_E_UNEXPECTED_FLASH_ID_GetEventFreezeFrameData
          RteEventToTaskMapping_OIE_EventInfo_FLS_E_UNEXPECTED_FLASH_ID_GetEventStatus: RteImmediateRestart=0, RteEventRef=OIE_EventInfo_FLS_E_UNEXPECTED_FLASH_ID_GetEventStatus
          RteEventToTaskMapping_OIE_EventInfo_FLS_E_UNEXPECTED_FLASH_ID_GetEventTested: RteImmediateRestart=0, RteEventRef=OIE_EventInfo_FLS_E_UNEXPECTED_FLASH_ID_GetEventTested
          RteEventToTaskMapping_OIE_EventInfo_FLS_E_UNEXPECTED_FLASH_ID_GetFaultDetectionCounter: RteImmediateRestart=0, RteEventRef=OIE_EventInfo_FLS_E_UNEXPECTED_FLASH_ID_GetFaultDetectionCounter
          RteEventToTaskMapping_OIE_EventInfo_FLS_E_WRITE_FAILED_GetDTCOfEvent: RteImmediateRestart=0, RteEventRef=OIE_EventInfo_FLS_E_WRITE_FAILED_GetDTCOfEvent
          RteEventToTaskMapping_OIE_EventInfo_FLS_E_WRITE_FAILED_GetEventExtendedDataRecord: RteImmediateRestart=0, RteEventRef=OIE_EventInfo_FLS_E_WRITE_FAILED_GetEventExtendedDataRecord
          RteEventToTaskMapping_OIE_EventInfo_FLS_E_WRITE_FAILED_GetEventFailed: RteImmediateRestart=0, RteEventRef=OIE_EventInfo_FLS_E_WRITE_FAILED_GetEventFailed
          RteEventToTaskMapping_OIE_EventInfo_FLS_E_WRITE_FAILED_GetEventFreezeFrameData: RteImmediateRestart=0, RteEventRef=OIE_EventInfo_FLS_E_WRITE_FAILED_GetEventFreezeFrameData
          RteEventToTaskMapping_OIE_EventInfo_FLS_E_WRITE_FAILED_GetEventStatus: RteImmediateRestart=0, RteEventRef=OIE_EventInfo_FLS_E_WRITE_FAILED_GetEventStatus
          RteEventToTaskMapping_OIE_EventInfo_FLS_E_WRITE_FAILED_GetEventTested: RteImmediateRestart=0, RteEventRef=OIE_EventInfo_FLS_E_WRITE_FAILED_GetEventTested
          RteEventToTaskMapping_OIE_EventInfo_FLS_E_WRITE_FAILED_GetFaultDetectionCounter: RteImmediateRestart=0, RteEventRef=OIE_EventInfo_FLS_E_WRITE_FAILED_GetFaultDetectionCounter
          RteEventToTaskMapping_OIE_EventInfo_IOHWAB_E_BUSY_GetDTCOfEvent: RteImmediateRestart=0, RteEventRef=OIE_EventInfo_IOHWAB_E_BUSY_GetDTCOfEvent
          RteEventToTaskMapping_OIE_EventInfo_IOHWAB_E_BUSY_GetEventExtendedDataRecord: RteImmediateRestart=0, RteEventRef=OIE_EventInfo_IOHWAB_E_BUSY_GetEventExtendedDataRecord
          RteEventToTaskMapping_OIE_EventInfo_IOHWAB_E_BUSY_GetEventFailed: RteImmediateRestart=0, RteEventRef=OIE_EventInfo_IOHWAB_E_BUSY_GetEventFailed
          RteEventToTaskMapping_OIE_EventInfo_IOHWAB_E_BUSY_GetEventFreezeFrameData: RteImmediateRestart=0, RteEventRef=OIE_EventInfo_IOHWAB_E_BUSY_GetEventFreezeFrameData
          RteEventToTaskMapping_OIE_EventInfo_IOHWAB_E_BUSY_GetEventStatus: RteImmediateRestart=0, RteEventRef=OIE_EventInfo_IOHWAB_E_BUSY_GetEventStatus
          RteEventToTaskMapping_OIE_EventInfo_IOHWAB_E_BUSY_GetEventTested: RteImmediateRestart=0, RteEventRef=OIE_EventInfo_IOHWAB_E_BUSY_GetEventTested
          RteEventToTaskMapping_OIE_EventInfo_IOHWAB_E_BUSY_GetFaultDetectionCounter: RteImmediateRestart=0, RteEventRef=OIE_EventInfo_IOHWAB_E_BUSY_GetFaultDetectionCounter
          RteEventToTaskMapping_OIE_EventInfo_IOHWAB_E_PROC_FAIL_GetDTCOfEvent: RteImmediateRestart=0, RteEventRef=OIE_EventInfo_IOHWAB_E_PROC_FAIL_GetDTCOfEvent
          RteEventToTaskMapping_OIE_EventInfo_IOHWAB_E_PROC_FAIL_GetEventExtendedDataRecord: RteImmediateRestart=0, RteEventRef=OIE_EventInfo_IOHWAB_E_PROC_FAIL_GetEventExtendedDataRecord
          RteEventToTaskMapping_OIE_EventInfo_IOHWAB_E_PROC_FAIL_GetEventFailed: RteImmediateRestart=0, RteEventRef=OIE_EventInfo_IOHWAB_E_PROC_FAIL_GetEventFailed
          RteEventToTaskMapping_OIE_EventInfo_IOHWAB_E_PROC_FAIL_GetEventFreezeFrameData: RteImmediateRestart=0, RteEventRef=OIE_EventInfo_IOHWAB_E_PROC_FAIL_GetEventFreezeFrameData
          RteEventToTaskMapping_OIE_EventInfo_IOHWAB_E_PROC_FAIL_GetEventStatus: RteImmediateRestart=0, RteEventRef=OIE_EventInfo_IOHWAB_E_PROC_FAIL_GetEventStatus
          RteEventToTaskMapping_OIE_EventInfo_IOHWAB_E_PROC_FAIL_GetEventTested: RteImmediateRestart=0, RteEventRef=OIE_EventInfo_IOHWAB_E_PROC_FAIL_GetEventTested
          RteEventToTaskMapping_OIE_EventInfo_IOHWAB_E_PROC_FAIL_GetFaultDetectionCounter: RteImmediateRestart=0, RteEventRef=OIE_EventInfo_IOHWAB_E_PROC_FAIL_GetFaultDetectionCounter
          RteEventToTaskMapping_OIE_EventInfo_IOHWAB_E_SETUP_FAIL_GetDTCOfEvent: RteImmediateRestart=0, RteEventRef=OIE_EventInfo_IOHWAB_E_SETUP_FAIL_GetDTCOfEvent
          RteEventToTaskMapping_OIE_EventInfo_IOHWAB_E_SETUP_FAIL_GetEventExtendedDataRecord: RteImmediateRestart=0, RteEventRef=OIE_EventInfo_IOHWAB_E_SETUP_FAIL_GetEventExtendedDataRecord
          RteEventToTaskMapping_OIE_EventInfo_IOHWAB_E_SETUP_FAIL_GetEventFailed: RteImmediateRestart=0, RteEventRef=OIE_EventInfo_IOHWAB_E_SETUP_FAIL_GetEventFailed
          RteEventToTaskMapping_OIE_EventInfo_IOHWAB_E_SETUP_FAIL_GetEventFreezeFrameData: RteImmediateRestart=0, RteEventRef=OIE_EventInfo_IOHWAB_E_SETUP_FAIL_GetEventFreezeFrameData
          RteEventToTaskMapping_OIE_EventInfo_IOHWAB_E_SETUP_FAIL_GetEventStatus: RteImmediateRestart=0, RteEventRef=OIE_EventInfo_IOHWAB_E_SETUP_FAIL_GetEventStatus
          RteEventToTaskMapping_OIE_EventInfo_IOHWAB_E_SETUP_FAIL_GetEventTested: RteImmediateRestart=0, RteEventRef=OIE_EventInfo_IOHWAB_E_SETUP_FAIL_GetEventTested
          RteEventToTaskMapping_OIE_EventInfo_IOHWAB_E_SETUP_FAIL_GetFaultDetectionCounter: RteImmediateRestart=0, RteEventRef=OIE_EventInfo_IOHWAB_E_SETUP_FAIL_GetFaultDetectionCounter
          RteEventToTaskMapping_OIE_EventInfo_IOHWAB_E_WRONG_PARAM_GetDTCOfEvent: RteImmediateRestart=0, RteEventRef=OIE_EventInfo_IOHWAB_E_WRONG_PARAM_GetDTCOfEvent
          RteEventToTaskMapping_OIE_EventInfo_IOHWAB_E_WRONG_PARAM_GetEventExtendedDataRecord: RteImmediateRestart=0, RteEventRef=OIE_EventInfo_IOHWAB_E_WRONG_PARAM_GetEventExtendedDataRecord
          RteEventToTaskMapping_OIE_EventInfo_IOHWAB_E_WRONG_PARAM_GetEventFailed: RteImmediateRestart=0, RteEventRef=OIE_EventInfo_IOHWAB_E_WRONG_PARAM_GetEventFailed
          RteEventToTaskMapping_OIE_EventInfo_IOHWAB_E_WRONG_PARAM_GetEventFreezeFrameData: RteImmediateRestart=0, RteEventRef=OIE_EventInfo_IOHWAB_E_WRONG_PARAM_GetEventFreezeFrameData
          RteEventToTaskMapping_OIE_EventInfo_IOHWAB_E_WRONG_PARAM_GetEventStatus: RteImmediateRestart=0, RteEventRef=OIE_EventInfo_IOHWAB_E_WRONG_PARAM_GetEventStatus
          RteEventToTaskMapping_OIE_EventInfo_IOHWAB_E_WRONG_PARAM_GetEventTested: RteImmediateRestart=0, RteEventRef=OIE_EventInfo_IOHWAB_E_WRONG_PARAM_GetEventTested
          RteEventToTaskMapping_OIE_EventInfo_IOHWAB_E_WRONG_PARAM_GetFaultDetectionCounter: RteImmediateRestart=0, RteEventRef=OIE_EventInfo_IOHWAB_E_WRONG_PARAM_GetFaultDetectionCounter
          RteEventToTaskMapping_OIE_EventInfo_IOHWAB_E_WRONG_SETTING_GetDTCOfEvent: RteImmediateRestart=0, RteEventRef=OIE_EventInfo_IOHWAB_E_WRONG_SETTING_GetDTCOfEvent
          RteEventToTaskMapping_OIE_EventInfo_IOHWAB_E_WRONG_SETTING_GetEventExtendedDataRecord: RteImmediateRestart=0, RteEventRef=OIE_EventInfo_IOHWAB_E_WRONG_SETTING_GetEventExtendedDataRecord
          RteEventToTaskMapping_OIE_EventInfo_IOHWAB_E_WRONG_SETTING_GetEventFailed: RteImmediateRestart=0, RteEventRef=OIE_EventInfo_IOHWAB_E_WRONG_SETTING_GetEventFailed
          RteEventToTaskMapping_OIE_EventInfo_IOHWAB_E_WRONG_SETTING_GetEventFreezeFrameData: RteImmediateRestart=0, RteEventRef=OIE_EventInfo_IOHWAB_E_WRONG_SETTING_GetEventFreezeFrameData
          RteEventToTaskMapping_OIE_EventInfo_IOHWAB_E_WRONG_SETTING_GetEventStatus: RteImmediateRestart=0, RteEventRef=OIE_EventInfo_IOHWAB_E_WRONG_SETTING_GetEventStatus
          RteEventToTaskMapping_OIE_EventInfo_IOHWAB_E_WRONG_SETTING_GetEventTested: RteImmediateRestart=0, RteEventRef=OIE_EventInfo_IOHWAB_E_WRONG_SETTING_GetEventTested
          RteEventToTaskMapping_OIE_EventInfo_IOHWAB_E_WRONG_SETTING_GetFaultDetectionCounter: RteImmediateRestart=0, RteEventRef=OIE_EventInfo_IOHWAB_E_WRONG_SETTING_GetFaultDetectionCounter
          RteEventToTaskMapping_OIE_EventInfo_IOHWAB_E_WRONG_STATE_GetDTCOfEvent: RteImmediateRestart=0, RteEventRef=OIE_EventInfo_IOHWAB_E_WRONG_STATE_GetDTCOfEvent
          RteEventToTaskMapping_OIE_EventInfo_IOHWAB_E_WRONG_STATE_GetEventExtendedDataRecord: RteImmediateRestart=0, RteEventRef=OIE_EventInfo_IOHWAB_E_WRONG_STATE_GetEventExtendedDataRecord
          RteEventToTaskMapping_OIE_EventInfo_IOHWAB_E_WRONG_STATE_GetEventFailed: RteImmediateRestart=0, RteEventRef=OIE_EventInfo_IOHWAB_E_WRONG_STATE_GetEventFailed
          RteEventToTaskMapping_OIE_EventInfo_IOHWAB_E_WRONG_STATE_GetEventFreezeFrameData: RteImmediateRestart=0, RteEventRef=OIE_EventInfo_IOHWAB_E_WRONG_STATE_GetEventFreezeFrameData
          RteEventToTaskMapping_OIE_EventInfo_IOHWAB_E_WRONG_STATE_GetEventStatus: RteImmediateRestart=0, RteEventRef=OIE_EventInfo_IOHWAB_E_WRONG_STATE_GetEventStatus
          RteEventToTaskMapping_OIE_EventInfo_IOHWAB_E_WRONG_STATE_GetEventTested: RteImmediateRestart=0, RteEventRef=OIE_EventInfo_IOHWAB_E_WRONG_STATE_GetEventTested
          RteEventToTaskMapping_OIE_EventInfo_IOHWAB_E_WRONG_STATE_GetFaultDetectionCounter: RteImmediateRestart=0, RteEventRef=OIE_EventInfo_IOHWAB_E_WRONG_STATE_GetFaultDetectionCounter
          RteEventToTaskMapping_OIE_EventInfo_MCU_E_CLOCK_FAILURE_GetDTCOfEvent: RteImmediateRestart=0, RteEventRef=OIE_EventInfo_MCU_E_CLOCK_FAILURE_GetDTCOfEvent
          RteEventToTaskMapping_OIE_EventInfo_MCU_E_CLOCK_FAILURE_GetEventExtendedDataRecord: RteImmediateRestart=0, RteEventRef=OIE_EventInfo_MCU_E_CLOCK_FAILURE_GetEventExtendedDataRecord
          RteEventToTaskMapping_OIE_EventInfo_MCU_E_CLOCK_FAILURE_GetEventFailed: RteImmediateRestart=0, RteEventRef=OIE_EventInfo_MCU_E_CLOCK_FAILURE_GetEventFailed
          RteEventToTaskMapping_OIE_EventInfo_MCU_E_CLOCK_FAILURE_GetEventFreezeFrameData: RteImmediateRestart=0, RteEventRef=OIE_EventInfo_MCU_E_CLOCK_FAILURE_GetEventFreezeFrameData
          RteEventToTaskMapping_OIE_EventInfo_MCU_E_CLOCK_FAILURE_GetEventStatus: RteImmediateRestart=0, RteEventRef=OIE_EventInfo_MCU_E_CLOCK_FAILURE_GetEventStatus
          RteEventToTaskMapping_OIE_EventInfo_MCU_E_CLOCK_FAILURE_GetEventTested: RteImmediateRestart=0, RteEventRef=OIE_EventInfo_MCU_E_CLOCK_FAILURE_GetEventTested
          RteEventToTaskMapping_OIE_EventInfo_MCU_E_CLOCK_FAILURE_GetFaultDetectionCounter: RteImmediateRestart=0, RteEventRef=OIE_EventInfo_MCU_E_CLOCK_FAILURE_GetFaultDetectionCounter
          RteEventToTaskMapping_OIE_EventInfo_MCU_E_LOCK_FAILURE_GetDTCOfEvent: RteImmediateRestart=0, RteEventRef=OIE_EventInfo_MCU_E_LOCK_FAILURE_GetDTCOfEvent
          RteEventToTaskMapping_OIE_EventInfo_MCU_E_LOCK_FAILURE_GetEventExtendedDataRecord: RteImmediateRestart=0, RteEventRef=OIE_EventInfo_MCU_E_LOCK_FAILURE_GetEventExtendedDataRecord
          RteEventToTaskMapping_OIE_EventInfo_MCU_E_LOCK_FAILURE_GetEventFailed: RteImmediateRestart=0, RteEventRef=OIE_EventInfo_MCU_E_LOCK_FAILURE_GetEventFailed
          RteEventToTaskMapping_OIE_EventInfo_MCU_E_LOCK_FAILURE_GetEventFreezeFrameData: RteImmediateRestart=0, RteEventRef=OIE_EventInfo_MCU_E_LOCK_FAILURE_GetEventFreezeFrameData
          RteEventToTaskMapping_OIE_EventInfo_MCU_E_LOCK_FAILURE_GetEventStatus: RteImmediateRestart=0, RteEventRef=OIE_EventInfo_MCU_E_LOCK_FAILURE_GetEventStatus
          RteEventToTaskMapping_OIE_EventInfo_MCU_E_LOCK_FAILURE_GetEventTested: RteImmediateRestart=0, RteEventRef=OIE_EventInfo_MCU_E_LOCK_FAILURE_GetEventTested
          RteEventToTaskMapping_OIE_EventInfo_MCU_E_LOCK_FAILURE_GetFaultDetectionCounter: RteImmediateRestart=0, RteEventRef=OIE_EventInfo_MCU_E_LOCK_FAILURE_GetFaultDetectionCounter
          RteEventToTaskMapping_OIE_EventInfo_MCU_E_QUARTZ_FAILURE_GetDTCOfEvent: RteImmediateRestart=0, RteEventRef=OIE_EventInfo_MCU_E_QUARTZ_FAILURE_GetDTCOfEvent
          RteEventToTaskMapping_OIE_EventInfo_MCU_E_QUARTZ_FAILURE_GetEventExtendedDataRecord: RteImmediateRestart=0, RteEventRef=OIE_EventInfo_MCU_E_QUARTZ_FAILURE_GetEventExtendedDataRecord
          RteEventToTaskMapping_OIE_EventInfo_MCU_E_QUARTZ_FAILURE_GetEventFailed: RteImmediateRestart=0, RteEventRef=OIE_EventInfo_MCU_E_QUARTZ_FAILURE_GetEventFailed
          RteEventToTaskMapping_OIE_EventInfo_MCU_E_QUARTZ_FAILURE_GetEventFreezeFrameData: RteImmediateRestart=0, RteEventRef=OIE_EventInfo_MCU_E_QUARTZ_FAILURE_GetEventFreezeFrameData
          RteEventToTaskMapping_OIE_EventInfo_MCU_E_QUARTZ_FAILURE_GetEventStatus: RteImmediateRestart=0, RteEventRef=OIE_EventInfo_MCU_E_QUARTZ_FAILURE_GetEventStatus
          RteEventToTaskMapping_OIE_EventInfo_MCU_E_QUARTZ_FAILURE_GetEventTested: RteImmediateRestart=0, RteEventRef=OIE_EventInfo_MCU_E_QUARTZ_FAILURE_GetEventTested
          RteEventToTaskMapping_OIE_EventInfo_MCU_E_QUARTZ_FAILURE_GetFaultDetectionCounter: RteImmediateRestart=0, RteEventRef=OIE_EventInfo_MCU_E_QUARTZ_FAILURE_GetFaultDetectionCounter
          RteEventToTaskMapping_OIE_EventInfo_MCU_E_TIMEOUT_TRANSITION_GetDTCOfEvent: RteImmediateRestart=0, RteEventRef=OIE_EventInfo_MCU_E_TIMEOUT_TRANSITION_GetDTCOfEvent
          RteEventToTaskMapping_OIE_EventInfo_MCU_E_TIMEOUT_TRANSITION_GetEventExtendedDataRecord: RteImmediateRestart=0, RteEventRef=OIE_EventInfo_MCU_E_TIMEOUT_TRANSITION_GetEventExtendedDataRecord
          RteEventToTaskMapping_OIE_EventInfo_MCU_E_TIMEOUT_TRANSITION_GetEventFailed: RteImmediateRestart=0, RteEventRef=OIE_EventInfo_MCU_E_TIMEOUT_TRANSITION_GetEventFailed
          RteEventToTaskMapping_OIE_EventInfo_MCU_E_TIMEOUT_TRANSITION_GetEventFreezeFrameData: RteImmediateRestart=0, RteEventRef=OIE_EventInfo_MCU_E_TIMEOUT_TRANSITION_GetEventFreezeFrameData
          RteEventToTaskMapping_OIE_EventInfo_MCU_E_TIMEOUT_TRANSITION_GetEventStatus: RteImmediateRestart=0, RteEventRef=OIE_EventInfo_MCU_E_TIMEOUT_TRANSITION_GetEventStatus
          RteEventToTaskMapping_OIE_EventInfo_MCU_E_TIMEOUT_TRANSITION_GetEventTested: RteImmediateRestart=0, RteEventRef=OIE_EventInfo_MCU_E_TIMEOUT_TRANSITION_GetEventTested
          RteEventToTaskMapping_OIE_EventInfo_MCU_E_TIMEOUT_TRANSITION_GetFaultDetectionCounter: RteImmediateRestart=0, RteEventRef=OIE_EventInfo_MCU_E_TIMEOUT_TRANSITION_GetFaultDetectionCounter
          RteEventToTaskMapping_OIE_EventInfo_NVM_E_INTEGRITY_FAILED_GetDTCOfEvent: RteImmediateRestart=0, RteEventRef=OIE_EventInfo_NVM_E_INTEGRITY_FAILED_GetDTCOfEvent
          RteEventToTaskMapping_OIE_EventInfo_NVM_E_INTEGRITY_FAILED_GetEventExtendedDataRecord: RteImmediateRestart=0, RteEventRef=OIE_EventInfo_NVM_E_INTEGRITY_FAILED_GetEventExtendedDataRecord
          RteEventToTaskMapping_OIE_EventInfo_NVM_E_INTEGRITY_FAILED_GetEventFailed: RteImmediateRestart=0, RteEventRef=OIE_EventInfo_NVM_E_INTEGRITY_FAILED_GetEventFailed
          RteEventToTaskMapping_OIE_EventInfo_NVM_E_INTEGRITY_FAILED_GetEventFreezeFrameData: RteImmediateRestart=0, RteEventRef=OIE_EventInfo_NVM_E_INTEGRITY_FAILED_GetEventFreezeFrameData
          RteEventToTaskMapping_OIE_EventInfo_NVM_E_INTEGRITY_FAILED_GetEventStatus: RteImmediateRestart=0, RteEventRef=OIE_EventInfo_NVM_E_INTEGRITY_FAILED_GetEventStatus
          RteEventToTaskMapping_OIE_EventInfo_NVM_E_INTEGRITY_FAILED_GetEventTested: RteImmediateRestart=0, RteEventRef=OIE_EventInfo_NVM_E_INTEGRITY_FAILED_GetEventTested
          RteEventToTaskMapping_OIE_EventInfo_NVM_E_INTEGRITY_FAILED_GetFaultDetectionCounter: RteImmediateRestart=0, RteEventRef=OIE_EventInfo_NVM_E_INTEGRITY_FAILED_GetFaultDetectionCounter
          RteEventToTaskMapping_OIE_EventInfo_NVM_E_LOSS_OF_REDUNDANCY_GetDTCOfEvent: RteImmediateRestart=0, RteEventRef=OIE_EventInfo_NVM_E_LOSS_OF_REDUNDANCY_GetDTCOfEvent
          RteEventToTaskMapping_OIE_EventInfo_NVM_E_LOSS_OF_REDUNDANCY_GetEventExtendedDataRecord: RteImmediateRestart=0, RteEventRef=OIE_EventInfo_NVM_E_LOSS_OF_REDUNDANCY_GetEventExtendedDataRecord
          RteEventToTaskMapping_OIE_EventInfo_NVM_E_LOSS_OF_REDUNDANCY_GetEventFailed: RteImmediateRestart=0, RteEventRef=OIE_EventInfo_NVM_E_LOSS_OF_REDUNDANCY_GetEventFailed
          RteEventToTaskMapping_OIE_EventInfo_NVM_E_LOSS_OF_REDUNDANCY_GetEventFreezeFrameData: RteImmediateRestart=0, RteEventRef=OIE_EventInfo_NVM_E_LOSS_OF_REDUNDANCY_GetEventFreezeFrameData
          RteEventToTaskMapping_OIE_EventInfo_NVM_E_LOSS_OF_REDUNDANCY_GetEventStatus: RteImmediateRestart=0, RteEventRef=OIE_EventInfo_NVM_E_LOSS_OF_REDUNDANCY_GetEventStatus
          RteEventToTaskMapping_OIE_EventInfo_NVM_E_LOSS_OF_REDUNDANCY_GetEventTested: RteImmediateRestart=0, RteEventRef=OIE_EventInfo_NVM_E_LOSS_OF_REDUNDANCY_GetEventTested
          RteEventToTaskMapping_OIE_EventInfo_NVM_E_LOSS_OF_REDUNDANCY_GetFaultDetectionCounter: RteImmediateRestart=0, RteEventRef=OIE_EventInfo_NVM_E_LOSS_OF_REDUNDANCY_GetFaultDetectionCounter
          RteEventToTaskMapping_OIE_EventInfo_NVM_E_QUEUE_OVERFLOW_GetDTCOfEvent: RteImmediateRestart=0, RteEventRef=OIE_EventInfo_NVM_E_QUEUE_OVERFLOW_GetDTCOfEvent
          RteEventToTaskMapping_OIE_EventInfo_NVM_E_QUEUE_OVERFLOW_GetEventExtendedDataRecord: RteImmediateRestart=0, RteEventRef=OIE_EventInfo_NVM_E_QUEUE_OVERFLOW_GetEventExtendedDataRecord
          RteEventToTaskMapping_OIE_EventInfo_NVM_E_QUEUE_OVERFLOW_GetEventFailed: RteImmediateRestart=0, RteEventRef=OIE_EventInfo_NVM_E_QUEUE_OVERFLOW_GetEventFailed
          RteEventToTaskMapping_OIE_EventInfo_NVM_E_QUEUE_OVERFLOW_GetEventFreezeFrameData: RteImmediateRestart=0, RteEventRef=OIE_EventInfo_NVM_E_QUEUE_OVERFLOW_GetEventFreezeFrameData
          RteEventToTaskMapping_OIE_EventInfo_NVM_E_QUEUE_OVERFLOW_GetEventStatus: RteImmediateRestart=0, RteEventRef=OIE_EventInfo_NVM_E_QUEUE_OVERFLOW_GetEventStatus
          RteEventToTaskMapping_OIE_EventInfo_NVM_E_QUEUE_OVERFLOW_GetEventTested: RteImmediateRestart=0, RteEventRef=OIE_EventInfo_NVM_E_QUEUE_OVERFLOW_GetEventTested
          RteEventToTaskMapping_OIE_EventInfo_NVM_E_QUEUE_OVERFLOW_GetFaultDetectionCounter: RteImmediateRestart=0, RteEventRef=OIE_EventInfo_NVM_E_QUEUE_OVERFLOW_GetFaultDetectionCounter
          RteEventToTaskMapping_OIE_EventInfo_NVM_E_REQ_FAILED_GetDTCOfEvent: RteImmediateRestart=0, RteEventRef=OIE_EventInfo_NVM_E_REQ_FAILED_GetDTCOfEvent
          RteEventToTaskMapping_OIE_EventInfo_NVM_E_REQ_FAILED_GetEventExtendedDataRecord: RteImmediateRestart=0, RteEventRef=OIE_EventInfo_NVM_E_REQ_FAILED_GetEventExtendedDataRecord
          RteEventToTaskMapping_OIE_EventInfo_NVM_E_REQ_FAILED_GetEventFailed: RteImmediateRestart=0, RteEventRef=OIE_EventInfo_NVM_E_REQ_FAILED_GetEventFailed
          RteEventToTaskMapping_OIE_EventInfo_NVM_E_REQ_FAILED_GetEventFreezeFrameData: RteImmediateRestart=0, RteEventRef=OIE_EventInfo_NVM_E_REQ_FAILED_GetEventFreezeFrameData
          RteEventToTaskMapping_OIE_EventInfo_NVM_E_REQ_FAILED_GetEventStatus: RteImmediateRestart=0, RteEventRef=OIE_EventInfo_NVM_E_REQ_FAILED_GetEventStatus
          RteEventToTaskMapping_OIE_EventInfo_NVM_E_REQ_FAILED_GetEventTested: RteImmediateRestart=0, RteEventRef=OIE_EventInfo_NVM_E_REQ_FAILED_GetEventTested
          RteEventToTaskMapping_OIE_EventInfo_NVM_E_REQ_FAILED_GetFaultDetectionCounter: RteImmediateRestart=0, RteEventRef=OIE_EventInfo_NVM_E_REQ_FAILED_GetFaultDetectionCounter
          RteEventToTaskMapping_OIE_EventInfo_NVM_E_VERIFY_FAILED_GetDTCOfEvent: RteImmediateRestart=0, RteEventRef=OIE_EventInfo_NVM_E_VERIFY_FAILED_GetDTCOfEvent
          RteEventToTaskMapping_OIE_EventInfo_NVM_E_VERIFY_FAILED_GetEventExtendedDataRecord: RteImmediateRestart=0, RteEventRef=OIE_EventInfo_NVM_E_VERIFY_FAILED_GetEventExtendedDataRecord
          RteEventToTaskMapping_OIE_EventInfo_NVM_E_VERIFY_FAILED_GetEventFailed: RteImmediateRestart=0, RteEventRef=OIE_EventInfo_NVM_E_VERIFY_FAILED_GetEventFailed
          RteEventToTaskMapping_OIE_EventInfo_NVM_E_VERIFY_FAILED_GetEventFreezeFrameData: RteImmediateRestart=0, RteEventRef=OIE_EventInfo_NVM_E_VERIFY_FAILED_GetEventFreezeFrameData
          RteEventToTaskMapping_OIE_EventInfo_NVM_E_VERIFY_FAILED_GetEventStatus: RteImmediateRestart=0, RteEventRef=OIE_EventInfo_NVM_E_VERIFY_FAILED_GetEventStatus
          RteEventToTaskMapping_OIE_EventInfo_NVM_E_VERIFY_FAILED_GetEventTested: RteImmediateRestart=0, RteEventRef=OIE_EventInfo_NVM_E_VERIFY_FAILED_GetEventTested
          RteEventToTaskMapping_OIE_EventInfo_NVM_E_VERIFY_FAILED_GetFaultDetectionCounter: RteImmediateRestart=0, RteEventRef=OIE_EventInfo_NVM_E_VERIFY_FAILED_GetFaultDetectionCounter
          RteEventToTaskMapping_OIE_EventInfo_NVM_E_WRITE_PROTECTED_GetDTCOfEvent: RteImmediateRestart=0, RteEventRef=OIE_EventInfo_NVM_E_WRITE_PROTECTED_GetDTCOfEvent
          RteEventToTaskMapping_OIE_EventInfo_NVM_E_WRITE_PROTECTED_GetEventExtendedDataRecord: RteImmediateRestart=0, RteEventRef=OIE_EventInfo_NVM_E_WRITE_PROTECTED_GetEventExtendedDataRecord
          RteEventToTaskMapping_OIE_EventInfo_NVM_E_WRITE_PROTECTED_GetEventFailed: RteImmediateRestart=0, RteEventRef=OIE_EventInfo_NVM_E_WRITE_PROTECTED_GetEventFailed
          RteEventToTaskMapping_OIE_EventInfo_NVM_E_WRITE_PROTECTED_GetEventFreezeFrameData: RteImmediateRestart=0, RteEventRef=OIE_EventInfo_NVM_E_WRITE_PROTECTED_GetEventFreezeFrameData
          RteEventToTaskMapping_OIE_EventInfo_NVM_E_WRITE_PROTECTED_GetEventStatus: RteImmediateRestart=0, RteEventRef=OIE_EventInfo_NVM_E_WRITE_PROTECTED_GetEventStatus
          RteEventToTaskMapping_OIE_EventInfo_NVM_E_WRITE_PROTECTED_GetEventTested: RteImmediateRestart=0, RteEventRef=OIE_EventInfo_NVM_E_WRITE_PROTECTED_GetEventTested
          RteEventToTaskMapping_OIE_EventInfo_NVM_E_WRITE_PROTECTED_GetFaultDetectionCounter: RteImmediateRestart=0, RteEventRef=OIE_EventInfo_NVM_E_WRITE_PROTECTED_GetFaultDetectionCounter
          RteEventToTaskMapping_OIE_EventInfo_NVM_E_WRONG_BLOCK_ID_GetDTCOfEvent: RteImmediateRestart=0, RteEventRef=OIE_EventInfo_NVM_E_WRONG_BLOCK_ID_GetDTCOfEvent
          RteEventToTaskMapping_OIE_EventInfo_NVM_E_WRONG_BLOCK_ID_GetEventExtendedDataRecord: RteImmediateRestart=0, RteEventRef=OIE_EventInfo_NVM_E_WRONG_BLOCK_ID_GetEventExtendedDataRecord
          RteEventToTaskMapping_OIE_EventInfo_NVM_E_WRONG_BLOCK_ID_GetEventFailed: RteImmediateRestart=0, RteEventRef=OIE_EventInfo_NVM_E_WRONG_BLOCK_ID_GetEventFailed
          RteEventToTaskMapping_OIE_EventInfo_NVM_E_WRONG_BLOCK_ID_GetEventFreezeFrameData: RteImmediateRestart=0, RteEventRef=OIE_EventInfo_NVM_E_WRONG_BLOCK_ID_GetEventFreezeFrameData
          RteEventToTaskMapping_OIE_EventInfo_NVM_E_WRONG_BLOCK_ID_GetEventStatus: RteImmediateRestart=0, RteEventRef=OIE_EventInfo_NVM_E_WRONG_BLOCK_ID_GetEventStatus
          RteEventToTaskMapping_OIE_EventInfo_NVM_E_WRONG_BLOCK_ID_GetEventTested: RteImmediateRestart=0, RteEventRef=OIE_EventInfo_NVM_E_WRONG_BLOCK_ID_GetEventTested
          RteEventToTaskMapping_OIE_EventInfo_NVM_E_WRONG_BLOCK_ID_GetFaultDetectionCounter: RteImmediateRestart=0, RteEventRef=OIE_EventInfo_NVM_E_WRONG_BLOCK_ID_GetFaultDetectionCounter
          RteEventToTaskMapping_OIE_EventInfo_PWM_E_UNEXPECTED_IRQ_GetDTCOfEvent: RteImmediateRestart=0, RteEventRef=OIE_EventInfo_PWM_E_UNEXPECTED_IRQ_GetDTCOfEvent
          RteEventToTaskMapping_OIE_EventInfo_PWM_E_UNEXPECTED_IRQ_GetEventExtendedDataRecord: RteImmediateRestart=0, RteEventRef=OIE_EventInfo_PWM_E_UNEXPECTED_IRQ_GetEventExtendedDataRecord
          RteEventToTaskMapping_OIE_EventInfo_PWM_E_UNEXPECTED_IRQ_GetEventFailed: RteImmediateRestart=0, RteEventRef=OIE_EventInfo_PWM_E_UNEXPECTED_IRQ_GetEventFailed
          RteEventToTaskMapping_OIE_EventInfo_PWM_E_UNEXPECTED_IRQ_GetEventFreezeFrameData: RteImmediateRestart=0, RteEventRef=OIE_EventInfo_PWM_E_UNEXPECTED_IRQ_GetEventFreezeFrameData
          RteEventToTaskMapping_OIE_EventInfo_PWM_E_UNEXPECTED_IRQ_GetEventStatus: RteImmediateRestart=0, RteEventRef=OIE_EventInfo_PWM_E_UNEXPECTED_IRQ_GetEventStatus
          RteEventToTaskMapping_OIE_EventInfo_PWM_E_UNEXPECTED_IRQ_GetEventTested: RteImmediateRestart=0, RteEventRef=OIE_EventInfo_PWM_E_UNEXPECTED_IRQ_GetEventTested
          RteEventToTaskMapping_OIE_EventInfo_PWM_E_UNEXPECTED_IRQ_GetFaultDetectionCounter: RteImmediateRestart=0, RteEventRef=OIE_EventInfo_PWM_E_UNEXPECTED_IRQ_GetFaultDetectionCounter
          RteEventToTaskMapping_OIE_EventInfo_SPI_E_TIMEOUT_GetDTCOfEvent: RteImmediateRestart=0, RteEventRef=OIE_EventInfo_SPI_E_TIMEOUT_GetDTCOfEvent
          RteEventToTaskMapping_OIE_EventInfo_SPI_E_TIMEOUT_GetEventExtendedDataRecord: RteImmediateRestart=0, RteEventRef=OIE_EventInfo_SPI_E_TIMEOUT_GetEventExtendedDataRecord
          RteEventToTaskMapping_OIE_EventInfo_SPI_E_TIMEOUT_GetEventFailed: RteImmediateRestart=0, RteEventRef=OIE_EventInfo_SPI_E_TIMEOUT_GetEventFailed
          RteEventToTaskMapping_OIE_EventInfo_SPI_E_TIMEOUT_GetEventFreezeFrameData: RteImmediateRestart=0, RteEventRef=OIE_EventInfo_SPI_E_TIMEOUT_GetEventFreezeFrameData
          RteEventToTaskMapping_OIE_EventInfo_SPI_E_TIMEOUT_GetEventStatus: RteImmediateRestart=0, RteEventRef=OIE_EventInfo_SPI_E_TIMEOUT_GetEventStatus
          RteEventToTaskMapping_OIE_EventInfo_SPI_E_TIMEOUT_GetEventTested: RteImmediateRestart=0, RteEventRef=OIE_EventInfo_SPI_E_TIMEOUT_GetEventTested
          RteEventToTaskMapping_OIE_EventInfo_SPI_E_TIMEOUT_GetFaultDetectionCounter: RteImmediateRestart=0, RteEventRef=OIE_EventInfo_SPI_E_TIMEOUT_GetFaultDetectionCounter
          RteEventToTaskMapping_OIE_EventInfo_WDGM_E_IMPROPER_CALLER_GetDTCOfEvent: RteImmediateRestart=0, RteEventRef=OIE_EventInfo_WDGM_E_IMPROPER_CALLER_GetDTCOfEvent
          RteEventToTaskMapping_OIE_EventInfo_WDGM_E_IMPROPER_CALLER_GetEventExtendedDataRecord: RteImmediateRestart=0, RteEventRef=OIE_EventInfo_WDGM_E_IMPROPER_CALLER_GetEventExtendedDataRecord
          RteEventToTaskMapping_OIE_EventInfo_WDGM_E_IMPROPER_CALLER_GetEventFailed: RteImmediateRestart=0, RteEventRef=OIE_EventInfo_WDGM_E_IMPROPER_CALLER_GetEventFailed
          RteEventToTaskMapping_OIE_EventInfo_WDGM_E_IMPROPER_CALLER_GetEventFreezeFrameData: RteImmediateRestart=0, RteEventRef=OIE_EventInfo_WDGM_E_IMPROPER_CALLER_GetEventFreezeFrameData
          RteEventToTaskMapping_OIE_EventInfo_WDGM_E_IMPROPER_CALLER_GetEventStatus: RteImmediateRestart=0, RteEventRef=OIE_EventInfo_WDGM_E_IMPROPER_CALLER_GetEventStatus
          RteEventToTaskMapping_OIE_EventInfo_WDGM_E_IMPROPER_CALLER_GetEventTested: RteImmediateRestart=0, RteEventRef=OIE_EventInfo_WDGM_E_IMPROPER_CALLER_GetEventTested
          RteEventToTaskMapping_OIE_EventInfo_WDGM_E_IMPROPER_CALLER_GetFaultDetectionCounter: RteImmediateRestart=0, RteEventRef=OIE_EventInfo_WDGM_E_IMPROPER_CALLER_GetFaultDetectionCounter
          RteEventToTaskMapping_OIE_EventInfo_WDGM_E_MONITORING_GetDTCOfEvent: RteImmediateRestart=0, RteEventRef=OIE_EventInfo_WDGM_E_MONITORING_GetDTCOfEvent
          RteEventToTaskMapping_OIE_EventInfo_WDGM_E_MONITORING_GetEventExtendedDataRecord: RteImmediateRestart=0, RteEventRef=OIE_EventInfo_WDGM_E_MONITORING_GetEventExtendedDataRecord
          RteEventToTaskMapping_OIE_EventInfo_WDGM_E_MONITORING_GetEventFailed: RteImmediateRestart=0, RteEventRef=OIE_EventInfo_WDGM_E_MONITORING_GetEventFailed
          RteEventToTaskMapping_OIE_EventInfo_WDGM_E_MONITORING_GetEventFreezeFrameData: RteImmediateRestart=0, RteEventRef=OIE_EventInfo_WDGM_E_MONITORING_GetEventFreezeFrameData
          RteEventToTaskMapping_OIE_EventInfo_WDGM_E_MONITORING_GetEventStatus: RteImmediateRestart=0, RteEventRef=OIE_EventInfo_WDGM_E_MONITORING_GetEventStatus
          RteEventToTaskMapping_OIE_EventInfo_WDGM_E_MONITORING_GetEventTested: RteImmediateRestart=0, RteEventRef=OIE_EventInfo_WDGM_E_MONITORING_GetEventTested
          RteEventToTaskMapping_OIE_EventInfo_WDGM_E_MONITORING_GetFaultDetectionCounter: RteImmediateRestart=0, RteEventRef=OIE_EventInfo_WDGM_E_MONITORING_GetFaultDetectionCounter
          RteEventToTaskMapping_OIE_EventInfo_WDGM_E_SET_MODE_GetDTCOfEvent: RteImmediateRestart=0, RteEventRef=OIE_EventInfo_WDGM_E_SET_MODE_GetDTCOfEvent
          RteEventToTaskMapping_OIE_EventInfo_WDGM_E_SET_MODE_GetEventExtendedDataRecord: RteImmediateRestart=0, RteEventRef=OIE_EventInfo_WDGM_E_SET_MODE_GetEventExtendedDataRecord
          RteEventToTaskMapping_OIE_EventInfo_WDGM_E_SET_MODE_GetEventFailed: RteImmediateRestart=0, RteEventRef=OIE_EventInfo_WDGM_E_SET_MODE_GetEventFailed
          RteEventToTaskMapping_OIE_EventInfo_WDGM_E_SET_MODE_GetEventFreezeFrameData: RteImmediateRestart=0, RteEventRef=OIE_EventInfo_WDGM_E_SET_MODE_GetEventFreezeFrameData
          RteEventToTaskMapping_OIE_EventInfo_WDGM_E_SET_MODE_GetEventStatus: RteImmediateRestart=0, RteEventRef=OIE_EventInfo_WDGM_E_SET_MODE_GetEventStatus
          RteEventToTaskMapping_OIE_EventInfo_WDGM_E_SET_MODE_GetEventTested: RteImmediateRestart=0, RteEventRef=OIE_EventInfo_WDGM_E_SET_MODE_GetEventTested
          RteEventToTaskMapping_OIE_EventInfo_WDGM_E_SET_MODE_GetFaultDetectionCounter: RteImmediateRestart=0, RteEventRef=OIE_EventInfo_WDGM_E_SET_MODE_GetFaultDetectionCounter
          RteEventToTaskMapping_OIE_EventInfo_WDG_E_DISABLE_REJECTED_GetDTCOfEvent: RteImmediateRestart=0, RteEventRef=OIE_EventInfo_WDG_E_DISABLE_REJECTED_GetDTCOfEvent
          RteEventToTaskMapping_OIE_EventInfo_WDG_E_DISABLE_REJECTED_GetEventExtendedDataRecord: RteImmediateRestart=0, RteEventRef=OIE_EventInfo_WDG_E_DISABLE_REJECTED_GetEventExtendedDataRecord
          RteEventToTaskMapping_OIE_EventInfo_WDG_E_DISABLE_REJECTED_GetEventFailed: RteImmediateRestart=0, RteEventRef=OIE_EventInfo_WDG_E_DISABLE_REJECTED_GetEventFailed
          RteEventToTaskMapping_OIE_EventInfo_WDG_E_DISABLE_REJECTED_GetEventFreezeFrameData: RteImmediateRestart=0, RteEventRef=OIE_EventInfo_WDG_E_DISABLE_REJECTED_GetEventFreezeFrameData
          RteEventToTaskMapping_OIE_EventInfo_WDG_E_DISABLE_REJECTED_GetEventStatus: RteImmediateRestart=0, RteEventRef=OIE_EventInfo_WDG_E_DISABLE_REJECTED_GetEventStatus
          RteEventToTaskMapping_OIE_EventInfo_WDG_E_DISABLE_REJECTED_GetEventTested: RteImmediateRestart=0, RteEventRef=OIE_EventInfo_WDG_E_DISABLE_REJECTED_GetEventTested
          RteEventToTaskMapping_OIE_EventInfo_WDG_E_DISABLE_REJECTED_GetFaultDetectionCounter: RteImmediateRestart=0, RteEventRef=OIE_EventInfo_WDG_E_DISABLE_REJECTED_GetFaultDetectionCounter
          RteEventToTaskMapping_OIE_EventInfo_WDG_E_MISS_TRIGGER_GetDTCOfEvent: RteImmediateRestart=0, RteEventRef=OIE_EventInfo_WDG_E_MISS_TRIGGER_GetDTCOfEvent
          RteEventToTaskMapping_OIE_EventInfo_WDG_E_MISS_TRIGGER_GetEventExtendedDataRecord: RteImmediateRestart=0, RteEventRef=OIE_EventInfo_WDG_E_MISS_TRIGGER_GetEventExtendedDataRecord
          RteEventToTaskMapping_OIE_EventInfo_WDG_E_MISS_TRIGGER_GetEventFailed: RteImmediateRestart=0, RteEventRef=OIE_EventInfo_WDG_E_MISS_TRIGGER_GetEventFailed
          RteEventToTaskMapping_OIE_EventInfo_WDG_E_MISS_TRIGGER_GetEventFreezeFrameData: RteImmediateRestart=0, RteEventRef=OIE_EventInfo_WDG_E_MISS_TRIGGER_GetEventFreezeFrameData
          RteEventToTaskMapping_OIE_EventInfo_WDG_E_MISS_TRIGGER_GetEventStatus: RteImmediateRestart=0, RteEventRef=OIE_EventInfo_WDG_E_MISS_TRIGGER_GetEventStatus
          RteEventToTaskMapping_OIE_EventInfo_WDG_E_MISS_TRIGGER_GetEventTested: RteImmediateRestart=0, RteEventRef=OIE_EventInfo_WDG_E_MISS_TRIGGER_GetEventTested
          RteEventToTaskMapping_OIE_EventInfo_WDG_E_MISS_TRIGGER_GetFaultDetectionCounter: RteImmediateRestart=0, RteEventRef=OIE_EventInfo_WDG_E_MISS_TRIGGER_GetFaultDetectionCounter
          RteEventToTaskMapping_OIE_EventInfo_WDG_E_MODE_FAILED_GetDTCOfEvent: RteImmediateRestart=0, RteEventRef=OIE_EventInfo_WDG_E_MODE_FAILED_GetDTCOfEvent
          RteEventToTaskMapping_OIE_EventInfo_WDG_E_MODE_FAILED_GetEventExtendedDataRecord: RteImmediateRestart=0, RteEventRef=OIE_EventInfo_WDG_E_MODE_FAILED_GetEventExtendedDataRecord
          RteEventToTaskMapping_OIE_EventInfo_WDG_E_MODE_FAILED_GetEventFailed: RteImmediateRestart=0, RteEventRef=OIE_EventInfo_WDG_E_MODE_FAILED_GetEventFailed
          RteEventToTaskMapping_OIE_EventInfo_WDG_E_MODE_FAILED_GetEventFreezeFrameData: RteImmediateRestart=0, RteEventRef=OIE_EventInfo_WDG_E_MODE_FAILED_GetEventFreezeFrameData
          RteEventToTaskMapping_OIE_EventInfo_WDG_E_MODE_FAILED_GetEventStatus: RteImmediateRestart=0, RteEventRef=OIE_EventInfo_WDG_E_MODE_FAILED_GetEventStatus
          RteEventToTaskMapping_OIE_EventInfo_WDG_E_MODE_FAILED_GetEventTested: RteImmediateRestart=0, RteEventRef=OIE_EventInfo_WDG_E_MODE_FAILED_GetEventTested
          RteEventToTaskMapping_OIE_EventInfo_WDG_E_MODE_FAILED_GetFaultDetectionCounter: RteImmediateRestart=0, RteEventRef=OIE_EventInfo_WDG_E_MODE_FAILED_GetFaultDetectionCounter
          RteEventToTaskMapping_OIE_Event_DEM_E_TEST_EVENT1_ResetEventStatus: RteImmediateRestart=0, RteEventRef=OIE_Event_DEM_E_TEST_EVENT1_ResetEventStatus
          RteEventToTaskMapping_OIE_Event_DEM_E_TEST_EVENT1_SetEventDisabled: RteImmediateRestart=0, RteEventRef=OIE_Event_DEM_E_TEST_EVENT1_SetEventDisabled
          RteEventToTaskMapping_OIE_Event_DEM_E_TEST_EVENT1_SetEventStatus: RteImmediateRestart=0, RteEventRef=OIE_Event_DEM_E_TEST_EVENT1_SetEventStatus
          RteEventToTaskMapping_OIE_Event_DEM_E_TEST_EVENT2_ResetEventStatus: RteImmediateRestart=0, RteEventRef=OIE_Event_DEM_E_TEST_EVENT2_ResetEventStatus
          RteEventToTaskMapping_OIE_Event_DEM_E_TEST_EVENT2_SetEventDisabled: RteImmediateRestart=0, RteEventRef=OIE_Event_DEM_E_TEST_EVENT2_SetEventDisabled
          RteEventToTaskMapping_OIE_Event_DEM_E_TEST_EVENT2_SetEventStatus: RteImmediateRestart=0, RteEventRef=OIE_Event_DEM_E_TEST_EVENT2_SetEventStatus
          RteEventToTaskMapping_OIE_Event_DEM_E_TEST_EVENT3_ResetEventStatus: RteImmediateRestart=0, RteEventRef=OIE_Event_DEM_E_TEST_EVENT3_ResetEventStatus
          RteEventToTaskMapping_OIE_Event_DEM_E_TEST_EVENT3_SetEventDisabled: RteImmediateRestart=0, RteEventRef=OIE_Event_DEM_E_TEST_EVENT3_SetEventDisabled
          RteEventToTaskMapping_OIE_Event_DEM_E_TEST_EVENT3_SetEventStatus: RteImmediateRestart=0, RteEventRef=OIE_Event_DEM_E_TEST_EVENT3_SetEventStatus
          RteEventToTaskMapping_OIE_Event_DEM_E_TEST_EVENT4_ResetEventStatus: RteImmediateRestart=0, RteEventRef=OIE_Event_DEM_E_TEST_EVENT4_ResetEventStatus
          RteEventToTaskMapping_OIE_Event_DEM_E_TEST_EVENT4_SetEventDisabled: RteImmediateRestart=0, RteEventRef=OIE_Event_DEM_E_TEST_EVENT4_SetEventDisabled
          RteEventToTaskMapping_OIE_Event_DEM_E_TEST_EVENT4_SetEventStatus: RteImmediateRestart=0, RteEventRef=OIE_Event_DEM_E_TEST_EVENT4_SetEventStatus
          RteEventToTaskMapping_OIE_Event_DEM_E_TEST_EVENT5_ResetEventStatus: RteImmediateRestart=0, RteEventRef=OIE_Event_DEM_E_TEST_EVENT5_ResetEventStatus
          RteEventToTaskMapping_OIE_Event_DEM_E_TEST_EVENT5_SetEventDisabled: RteImmediateRestart=0, RteEventRef=OIE_Event_DEM_E_TEST_EVENT5_SetEventDisabled
          RteEventToTaskMapping_OIE_Event_DEM_E_TEST_EVENT5_SetEventStatus: RteImmediateRestart=0, RteEventRef=OIE_Event_DEM_E_TEST_EVENT5_SetEventStatus
          RteEventToTaskMapping_OIE_Event_DEM_E_TEST_EVENT6_ResetEventStatus: RteImmediateRestart=0, RteEventRef=OIE_Event_DEM_E_TEST_EVENT6_ResetEventStatus
          RteEventToTaskMapping_OIE_Event_DEM_E_TEST_EVENT6_SetEventDisabled: RteImmediateRestart=0, RteEventRef=OIE_Event_DEM_E_TEST_EVENT6_SetEventDisabled
          RteEventToTaskMapping_OIE_Event_DEM_E_TEST_EVENT6_SetEventStatus: RteImmediateRestart=0, RteEventRef=OIE_Event_DEM_E_TEST_EVENT6_SetEventStatus
          RteEventToTaskMapping_OIE_GeneralEvtInfo_GetDTCOfEvent: RteImmediateRestart=0, RteEventRef=OIE_GeneralEvtInfo_GetDTCOfEvent
          RteEventToTaskMapping_OIE_GeneralEvtInfo_GetEventExtendedDataRecord: RteImmediateRestart=0, RteEventRef=OIE_GeneralEvtInfo_GetEventExtendedDataRecord
          RteEventToTaskMapping_OIE_GeneralEvtInfo_GetEventFailed: RteImmediateRestart=0, RteEventRef=OIE_GeneralEvtInfo_GetEventFailed
          RteEventToTaskMapping_OIE_GeneralEvtInfo_GetEventFreezeFrameData: RteImmediateRestart=0, RteEventRef=OIE_GeneralEvtInfo_GetEventFreezeFrameData
          RteEventToTaskMapping_OIE_GeneralEvtInfo_GetEventStatus: RteImmediateRestart=0, RteEventRef=OIE_GeneralEvtInfo_GetEventStatus
          RteEventToTaskMapping_OIE_GeneralEvtInfo_GetEventTested: RteImmediateRestart=0, RteEventRef=OIE_GeneralEvtInfo_GetEventTested
          RteEventToTaskMapping_OIE_GeneralEvtInfo_GetFaultDetectionCounter: RteImmediateRestart=0, RteEventRef=OIE_GeneralEvtInfo_GetFaultDetectionCounter
          RteEventToTaskMapping_OIE_IndStatus_DemIndicator_0_GetIndicatorStatus: RteImmediateRestart=0, RteEventRef=OIE_IndStatus_DemIndicator_0_GetIndicatorStatus
          RteEventToTaskMapping_OIE_IndStatus_DemIndicator_1_GetIndicatorStatus: RteImmediateRestart=0, RteEventRef=OIE_IndStatus_DemIndicator_1_GetIndicatorStatus
          RteEventToTaskMapping_OIE_OpCycle_DemOperationCycle0_SetOperationCycleState: RteImmediateRestart=0, RteEventRef=OIE_OpCycle_DemOperationCycle0_SetOperationCycleState
          RteEventToTaskMapping_OIE_OverflowIndPrimaryMemory_GetEventMemoryOverflow: RteImmediateRestart=0, RteEventRef=OIE_OverflowIndPrimaryMemory_GetEventMemoryOverflow
          RteEventToTaskMapping_OIE_EventInfo_CANSM_E_MODE_CHANGE_PROJECT_GetDTCOfEvent: RteImmediateRestart=0, RteEventRef=OIE_EventInfo_CANSM_E_MODE_CHANGE_PROJECT_GetDTCOfEvent
          RteEventToTaskMapping_OIE_EventInfo_CANSM_E_MODE_CHANGE_PROJECT_GetEventExtendedDataRecord: RteImmediateRestart=0, RteEventRef=OIE_EventInfo_CANSM_E_MODE_CHANGE_PROJECT_GetEventExtendedDataRecord
          RteEventToTaskMapping_OIE_EventInfo_CANSM_E_MODE_CHANGE_PROJECT_GetEventFailed: RteImmediateRestart=0, RteEventRef=OIE_EventInfo_CANSM_E_MODE_CHANGE_PROJECT_GetEventFailed
          RteEventToTaskMapping_OIE_EventInfo_CANSM_E_MODE_CHANGE_PROJECT_GetEventFreezeFrameData: RteImmediateRestart=0, RteEventRef=OIE_EventInfo_CANSM_E_MODE_CHANGE_PROJECT_GetEventFreezeFrameData
          RteEventToTaskMapping_OIE_EventInfo_CANSM_E_MODE_CHANGE_PROJECT_GetEventStatus: RteImmediateRestart=0, RteEventRef=OIE_EventInfo_CANSM_E_MODE_CHANGE_PROJECT_GetEventStatus
          RteEventToTaskMapping_OIE_EventInfo_CANSM_E_MODE_CHANGE_PROJECT_GetEventTested: RteImmediateRestart=0, RteEventRef=OIE_EventInfo_CANSM_E_MODE_CHANGE_PROJECT_GetEventTested
          RteEventToTaskMapping_OIE_EventInfo_CANSM_E_MODE_CHANGE_PROJECT_GetFaultDetectionCounter: RteImmediateRestart=0, RteEventRef=OIE_EventInfo_CANSM_E_MODE_CHANGE_PROJECT_GetFaultDetectionCounter
          RteEventToTaskMapping_OIE_Cdd_ClearDTC: RteImmediateRestart=false, RteEventRef=OIE_Cdd_ClearDTC
          RteEventToTaskMapping_OIE_EventInfo_CANCM_E_BAT_FAIL_GetDTCOfEvent: RteImmediateRestart=false, RteEventRef=OIE_EventInfo_CANCM_E_BAT_FAIL_GetDTCOfEvent
          RteEventToTaskMapping_OIE_EventInfo_CANCM_E_BAT_FAIL_GetEventExtendedDataRecord: RteImmediateRestart=false, RteEventRef=OIE_EventInfo_CANCM_E_BAT_FAIL_GetEventExtendedDataRecord
          RteEventToTaskMapping_OIE_EventInfo_CANCM_E_BAT_FAIL_GetEventFailed: RteImmediateRestart=false, RteEventRef=OIE_EventInfo_CANCM_E_BAT_FAIL_GetEventFailed
          RteEventToTaskMapping_OIE_EventInfo_CANCM_E_BAT_FAIL_GetEventFreezeFrameData: RteImmediateRestart=false, RteEventRef=OIE_EventInfo_CANCM_E_BAT_FAIL_GetEventFreezeFrameData
          RteEventToTaskMapping_OIE_EventInfo_CANCM_E_BAT_FAIL_GetEventStatus: RteImmediateRestart=false, RteEventRef=OIE_EventInfo_CANCM_E_BAT_FAIL_GetEventStatus
          RteEventToTaskMapping_OIE_EventInfo_CANCM_E_BAT_FAIL_GetEventTested: RteImmediateRestart=false, RteEventRef=OIE_EventInfo_CANCM_E_BAT_FAIL_GetEventTested
          RteEventToTaskMapping_OIE_EventInfo_CANCM_E_BAT_FAIL_GetFaultDetectionCounter: RteImmediateRestart=false, RteEventRef=OIE_EventInfo_CANCM_E_BAT_FAIL_GetFaultDetectionCounter
          RteEventToTaskMapping_OIE_EventInfo_Dem_FEE_GC_ERASE_ERROR_GetDTCOfEvent: RteImmediateRestart=false, RteEventRef=OIE_EventInfo_Dem_FEE_GC_ERASE_ERROR_GetDTCOfEvent
          RteEventToTaskMapping_OIE_EventInfo_Dem_FEE_GC_ERASE_ERROR_GetEventExtendedDataRecord: RteImmediateRestart=false, RteEventRef=OIE_EventInfo_Dem_FEE_GC_ERASE_ERROR_GetEventExtendedDataRecord
          RteEventToTaskMapping_OIE_EventInfo_Dem_FEE_GC_ERASE_ERROR_GetEventFailed: RteImmediateRestart=false, RteEventRef=OIE_EventInfo_Dem_FEE_GC_ERASE_ERROR_GetEventFailed
          RteEventToTaskMapping_OIE_EventInfo_Dem_FEE_GC_ERASE_ERROR_GetEventFreezeFrameData: RteImmediateRestart=false, RteEventRef=OIE_EventInfo_Dem_FEE_GC_ERASE_ERROR_GetEventFreezeFrameData
          RteEventToTaskMapping_OIE_EventInfo_Dem_FEE_GC_ERASE_ERROR_GetEventStatus: RteImmediateRestart=false, RteEventRef=OIE_EventInfo_Dem_FEE_GC_ERASE_ERROR_GetEventStatus
          RteEventToTaskMapping_OIE_EventInfo_Dem_FEE_GC_ERASE_ERROR_GetEventTested: RteImmediateRestart=false, RteEventRef=OIE_EventInfo_Dem_FEE_GC_ERASE_ERROR_GetEventTested
          RteEventToTaskMapping_OIE_EventInfo_Dem_FEE_GC_ERASE_ERROR_GetFaultDetectionCounter: RteImmediateRestart=false, RteEventRef=OIE_EventInfo_Dem_FEE_GC_ERASE_ERROR_GetFaultDetectionCounter
          RteEventToTaskMapping_OIE_EventInfo_Dem_FEE_GC_INIT_ERROR_GetDTCOfEvent: RteImmediateRestart=false, RteEventRef=OIE_EventInfo_Dem_FEE_GC_INIT_ERROR_GetDTCOfEvent
          RteEventToTaskMapping_OIE_EventInfo_Dem_FEE_GC_INIT_ERROR_GetEventExtendedDataRecord: RteImmediateRestart=false, RteEventRef=OIE_EventInfo_Dem_FEE_GC_INIT_ERROR_GetEventExtendedDataRecord
          RteEventToTaskMapping_OIE_EventInfo_Dem_FEE_GC_INIT_ERROR_GetEventFailed: RteImmediateRestart=false, RteEventRef=OIE_EventInfo_Dem_FEE_GC_INIT_ERROR_GetEventFailed
          RteEventToTaskMapping_OIE_EventInfo_Dem_FEE_GC_INIT_ERROR_GetEventFreezeFrameData: RteImmediateRestart=false, RteEventRef=OIE_EventInfo_Dem_FEE_GC_INIT_ERROR_GetEventFreezeFrameData
          RteEventToTaskMapping_OIE_EventInfo_Dem_FEE_GC_INIT_ERROR_GetEventStatus: RteImmediateRestart=false, RteEventRef=OIE_EventInfo_Dem_FEE_GC_INIT_ERROR_GetEventStatus
          RteEventToTaskMapping_OIE_EventInfo_Dem_FEE_GC_INIT_ERROR_GetEventTested: RteImmediateRestart=false, RteEventRef=OIE_EventInfo_Dem_FEE_GC_INIT_ERROR_GetEventTested
          RteEventToTaskMapping_OIE_EventInfo_Dem_FEE_GC_INIT_ERROR_GetFaultDetectionCounter: RteImmediateRestart=false, RteEventRef=OIE_EventInfo_Dem_FEE_GC_INIT_ERROR_GetFaultDetectionCounter
          RteEventToTaskMapping_OIE_EventInfo_Dem_FEE_GC_READ_ERROR_GetDTCOfEvent: RteImmediateRestart=false, RteEventRef=OIE_EventInfo_Dem_FEE_GC_READ_ERROR_GetDTCOfEvent
          RteEventToTaskMapping_OIE_EventInfo_Dem_FEE_GC_READ_ERROR_GetEventExtendedDataRecord: RteImmediateRestart=false, RteEventRef=OIE_EventInfo_Dem_FEE_GC_READ_ERROR_GetEventExtendedDataRecord
          RteEventToTaskMapping_OIE_EventInfo_Dem_FEE_GC_READ_ERROR_GetEventFailed: RteImmediateRestart=false, RteEventRef=OIE_EventInfo_Dem_FEE_GC_READ_ERROR_GetEventFailed
          RteEventToTaskMapping_OIE_EventInfo_Dem_FEE_GC_READ_ERROR_GetEventFreezeFrameData: RteImmediateRestart=false, RteEventRef=OIE_EventInfo_Dem_FEE_GC_READ_ERROR_GetEventFreezeFrameData
          RteEventToTaskMapping_OIE_EventInfo_Dem_FEE_GC_READ_ERROR_GetEventStatus: RteImmediateRestart=false, RteEventRef=OIE_EventInfo_Dem_FEE_GC_READ_ERROR_GetEventStatus
          RteEventToTaskMapping_OIE_EventInfo_Dem_FEE_GC_READ_ERROR_GetEventTested: RteImmediateRestart=false, RteEventRef=OIE_EventInfo_Dem_FEE_GC_READ_ERROR_GetEventTested
          RteEventToTaskMapping_OIE_EventInfo_Dem_FEE_GC_READ_ERROR_GetFaultDetectionCounter: RteImmediateRestart=false, RteEventRef=OIE_EventInfo_Dem_FEE_GC_READ_ERROR_GetFaultDetectionCounter
          RteEventToTaskMapping_OIE_EventInfo_Dem_FEE_GC_TRIG_ERROR_GetDTCOfEvent: RteImmediateRestart=false, RteEventRef=OIE_EventInfo_Dem_FEE_GC_TRIG_ERROR_GetDTCOfEvent
          RteEventToTaskMapping_OIE_EventInfo_Dem_FEE_GC_TRIG_ERROR_GetEventExtendedDataRecord: RteImmediateRestart=false, RteEventRef=OIE_EventInfo_Dem_FEE_GC_TRIG_ERROR_GetEventExtendedDataRecord
          RteEventToTaskMapping_OIE_EventInfo_Dem_FEE_GC_TRIG_ERROR_GetEventFailed: RteImmediateRestart=false, RteEventRef=OIE_EventInfo_Dem_FEE_GC_TRIG_ERROR_GetEventFailed
          RteEventToTaskMapping_OIE_EventInfo_Dem_FEE_GC_TRIG_ERROR_GetEventFreezeFrameData: RteImmediateRestart=false, RteEventRef=OIE_EventInfo_Dem_FEE_GC_TRIG_ERROR_GetEventFreezeFrameData
          RteEventToTaskMapping_OIE_EventInfo_Dem_FEE_GC_TRIG_ERROR_GetEventStatus: RteImmediateRestart=false, RteEventRef=OIE_EventInfo_Dem_FEE_GC_TRIG_ERROR_GetEventStatus
          RteEventToTaskMapping_OIE_EventInfo_Dem_FEE_GC_TRIG_ERROR_GetEventTested: RteImmediateRestart=false, RteEventRef=OIE_EventInfo_Dem_FEE_GC_TRIG_ERROR_GetEventTested
          RteEventToTaskMapping_OIE_EventInfo_Dem_FEE_GC_TRIG_ERROR_GetFaultDetectionCounter: RteImmediateRestart=false, RteEventRef=OIE_EventInfo_Dem_FEE_GC_TRIG_ERROR_GetFaultDetectionCounter
          RteEventToTaskMapping_OIE_EventInfo_Dem_FEE_GC_WRITE_ERROR_GetDTCOfEvent: RteImmediateRestart=false, RteEventRef=OIE_EventInfo_Dem_FEE_GC_WRITE_ERROR_GetDTCOfEvent
          RteEventToTaskMapping_OIE_EventInfo_Dem_FEE_GC_WRITE_ERROR_GetEventExtendedDataRecord: RteImmediateRestart=false, RteEventRef=OIE_EventInfo_Dem_FEE_GC_WRITE_ERROR_GetEventExtendedDataRecord
          RteEventToTaskMapping_OIE_EventInfo_Dem_FEE_GC_WRITE_ERROR_GetEventFailed: RteImmediateRestart=false, RteEventRef=OIE_EventInfo_Dem_FEE_GC_WRITE_ERROR_GetEventFailed
          RteEventToTaskMapping_OIE_EventInfo_Dem_FEE_GC_WRITE_ERROR_GetEventFreezeFrameData: RteImmediateRestart=false, RteEventRef=OIE_EventInfo_Dem_FEE_GC_WRITE_ERROR_GetEventFreezeFrameData
          RteEventToTaskMapping_OIE_EventInfo_Dem_FEE_GC_WRITE_ERROR_GetEventStatus: RteImmediateRestart=false, RteEventRef=OIE_EventInfo_Dem_FEE_GC_WRITE_ERROR_GetEventStatus
          RteEventToTaskMapping_OIE_EventInfo_Dem_FEE_GC_WRITE_ERROR_GetEventTested: RteImmediateRestart=false, RteEventRef=OIE_EventInfo_Dem_FEE_GC_WRITE_ERROR_GetEventTested
          RteEventToTaskMapping_OIE_EventInfo_Dem_FEE_GC_WRITE_ERROR_GetFaultDetectionCounter: RteImmediateRestart=false, RteEventRef=OIE_EventInfo_Dem_FEE_GC_WRITE_ERROR_GetFaultDetectionCounter
          RteEventToTaskMapping_OIE_EventInfo_Dem_FEE_INVALIDATE_ERROR_GetDTCOfEvent: RteImmediateRestart=false, RteEventRef=OIE_EventInfo_Dem_FEE_INVALIDATE_ERROR_GetDTCOfEvent
          RteEventToTaskMapping_OIE_EventInfo_Dem_FEE_INVALIDATE_ERROR_GetEventExtendedDataRecord: RteImmediateRestart=false, RteEventRef=OIE_EventInfo_Dem_FEE_INVALIDATE_ERROR_GetEventExtendedDataRecord
          RteEventToTaskMapping_OIE_EventInfo_Dem_FEE_INVALIDATE_ERROR_GetEventFailed: RteImmediateRestart=false, RteEventRef=OIE_EventInfo_Dem_FEE_INVALIDATE_ERROR_GetEventFailed
          RteEventToTaskMapping_OIE_EventInfo_Dem_FEE_INVALIDATE_ERROR_GetEventFreezeFrameData: RteImmediateRestart=false, RteEventRef=OIE_EventInfo_Dem_FEE_INVALIDATE_ERROR_GetEventFreezeFrameData
          RteEventToTaskMapping_OIE_EventInfo_Dem_FEE_INVALIDATE_ERROR_GetEventStatus: RteImmediateRestart=false, RteEventRef=OIE_EventInfo_Dem_FEE_INVALIDATE_ERROR_GetEventStatus
          RteEventToTaskMapping_OIE_EventInfo_Dem_FEE_INVALIDATE_ERROR_GetEventTested: RteImmediateRestart=false, RteEventRef=OIE_EventInfo_Dem_FEE_INVALIDATE_ERROR_GetEventTested
          RteEventToTaskMapping_OIE_EventInfo_Dem_FEE_INVALIDATE_ERROR_GetFaultDetectionCounter: RteImmediateRestart=false, RteEventRef=OIE_EventInfo_Dem_FEE_INVALIDATE_ERROR_GetFaultDetectionCounter
          RteEventToTaskMapping_OIE_EventInfo_Dem_FEE_READ_ERROR_GetDTCOfEvent: RteImmediateRestart=false, RteEventRef=OIE_EventInfo_Dem_FEE_READ_ERROR_GetDTCOfEvent
          RteEventToTaskMapping_OIE_EventInfo_Dem_FEE_READ_ERROR_GetEventExtendedDataRecord: RteImmediateRestart=false, RteEventRef=OIE_EventInfo_Dem_FEE_READ_ERROR_GetEventExtendedDataRecord
          RteEventToTaskMapping_OIE_EventInfo_Dem_FEE_READ_ERROR_GetEventFailed: RteImmediateRestart=false, RteEventRef=OIE_EventInfo_Dem_FEE_READ_ERROR_GetEventFailed
          RteEventToTaskMapping_OIE_EventInfo_Dem_FEE_READ_ERROR_GetEventFreezeFrameData: RteImmediateRestart=false, RteEventRef=OIE_EventInfo_Dem_FEE_READ_ERROR_GetEventFreezeFrameData
          RteEventToTaskMapping_OIE_EventInfo_Dem_FEE_READ_ERROR_GetEventStatus: RteImmediateRestart=false, RteEventRef=OIE_EventInfo_Dem_FEE_READ_ERROR_GetEventStatus
          RteEventToTaskMapping_OIE_EventInfo_Dem_FEE_READ_ERROR_GetEventTested: RteImmediateRestart=false, RteEventRef=OIE_EventInfo_Dem_FEE_READ_ERROR_GetEventTested
          RteEventToTaskMapping_OIE_EventInfo_Dem_FEE_READ_ERROR_GetFaultDetectionCounter: RteImmediateRestart=false, RteEventRef=OIE_EventInfo_Dem_FEE_READ_ERROR_GetFaultDetectionCounter
          RteEventToTaskMapping_OIE_EventInfo_Dem_FEE_UNCONFIG_BLK_EXCEEDED_ERROR_GetDTCOfEvent: RteImmediateRestart=false, RteEventRef=OIE_EventInfo_Dem_FEE_UNCONFIG_BLK_EXCEEDED_ERROR_GetDTCOfEvent
          RteEventToTaskMapping_OIE_EventInfo_Dem_FEE_UNCONFIG_BLK_EXCEEDED_ERROR_GetEventExtendedDataRecord: RteImmediateRestart=false, RteEventRef=OIE_EventInfo_Dem_FEE_UNCONFIG_BLK_EXCEEDED_ERROR_GetEventExtendedDataRecord
          RteEventToTaskMapping_OIE_EventInfo_Dem_FEE_UNCONFIG_BLK_EXCEEDED_ERROR_GetEventFailed: RteImmediateRestart=false, RteEventRef=OIE_EventInfo_Dem_FEE_UNCONFIG_BLK_EXCEEDED_ERROR_GetEventFailed
          RteEventToTaskMapping_OIE_EventInfo_Dem_FEE_UNCONFIG_BLK_EXCEEDED_ERROR_GetEventFreezeFrameData: RteImmediateRestart=false, RteEventRef=OIE_EventInfo_Dem_FEE_UNCONFIG_BLK_EXCEEDED_ERROR_GetEventFreezeFrameData
          RteEventToTaskMapping_OIE_EventInfo_Dem_FEE_UNCONFIG_BLK_EXCEEDED_ERROR_GetEventStatus: RteImmediateRestart=false, RteEventRef=OIE_EventInfo_Dem_FEE_UNCONFIG_BLK_EXCEEDED_ERROR_GetEventStatus
          RteEventToTaskMapping_OIE_EventInfo_Dem_FEE_UNCONFIG_BLK_EXCEEDED_ERROR_GetEventTested: RteImmediateRestart=false, RteEventRef=OIE_EventInfo_Dem_FEE_UNCONFIG_BLK_EXCEEDED_ERROR_GetEventTested
          RteEventToTaskMapping_OIE_EventInfo_Dem_FEE_UNCONFIG_BLK_EXCEEDED_ERROR_GetFaultDetectionCounter: RteImmediateRestart=false, RteEventRef=OIE_EventInfo_Dem_FEE_UNCONFIG_BLK_EXCEEDED_ERROR_GetFaultDetectionCounter
          RteEventToTaskMapping_OIE_EventInfo_Dem_FEE_WRITE_ERROR_GetDTCOfEvent: RteImmediateRestart=false, RteEventRef=OIE_EventInfo_Dem_FEE_WRITE_ERROR_GetDTCOfEvent
          RteEventToTaskMapping_OIE_EventInfo_Dem_FEE_WRITE_ERROR_GetEventExtendedDataRecord: RteImmediateRestart=false, RteEventRef=OIE_EventInfo_Dem_FEE_WRITE_ERROR_GetEventExtendedDataRecord
          RteEventToTaskMapping_OIE_EventInfo_Dem_FEE_WRITE_ERROR_GetEventFailed: RteImmediateRestart=false, RteEventRef=OIE_EventInfo_Dem_FEE_WRITE_ERROR_GetEventFailed
          RteEventToTaskMapping_OIE_EventInfo_Dem_FEE_WRITE_ERROR_GetEventFreezeFrameData: RteImmediateRestart=false, RteEventRef=OIE_EventInfo_Dem_FEE_WRITE_ERROR_GetEventFreezeFrameData
          RteEventToTaskMapping_OIE_EventInfo_Dem_FEE_WRITE_ERROR_GetEventStatus: RteImmediateRestart=false, RteEventRef=OIE_EventInfo_Dem_FEE_WRITE_ERROR_GetEventStatus
          RteEventToTaskMapping_OIE_EventInfo_Dem_FEE_WRITE_ERROR_GetEventTested: RteImmediateRestart=false, RteEventRef=OIE_EventInfo_Dem_FEE_WRITE_ERROR_GetEventTested
          RteEventToTaskMapping_OIE_EventInfo_Dem_FEE_WRITE_ERROR_GetFaultDetectionCounter: RteImmediateRestart=false, RteEventRef=OIE_EventInfo_Dem_FEE_WRITE_ERROR_GetFaultDetectionCounter
          RteEventToTaskMapping_OIE_EventInfo_Dem_FLS_COMPARE_ERROR_GetDTCOfEvent: RteImmediateRestart=false, RteEventRef=OIE_EventInfo_Dem_FLS_COMPARE_ERROR_GetDTCOfEvent
          RteEventToTaskMapping_OIE_EventInfo_Dem_FLS_COMPARE_ERROR_GetEventExtendedDataRecord: RteImmediateRestart=false, RteEventRef=OIE_EventInfo_Dem_FLS_COMPARE_ERROR_GetEventExtendedDataRecord
          RteEventToTaskMapping_OIE_EventInfo_Dem_FLS_COMPARE_ERROR_GetEventFailed: RteImmediateRestart=false, RteEventRef=OIE_EventInfo_Dem_FLS_COMPARE_ERROR_GetEventFailed
          RteEventToTaskMapping_OIE_EventInfo_Dem_FLS_COMPARE_ERROR_GetEventFreezeFrameData: RteImmediateRestart=false, RteEventRef=OIE_EventInfo_Dem_FLS_COMPARE_ERROR_GetEventFreezeFrameData
          RteEventToTaskMapping_OIE_EventInfo_Dem_FLS_COMPARE_ERROR_GetEventStatus: RteImmediateRestart=false, RteEventRef=OIE_EventInfo_Dem_FLS_COMPARE_ERROR_GetEventStatus
          RteEventToTaskMapping_OIE_EventInfo_Dem_FLS_COMPARE_ERROR_GetEventTested: RteImmediateRestart=false, RteEventRef=OIE_EventInfo_Dem_FLS_COMPARE_ERROR_GetEventTested
          RteEventToTaskMapping_OIE_EventInfo_Dem_FLS_COMPARE_ERROR_GetFaultDetectionCounter: RteImmediateRestart=false, RteEventRef=OIE_EventInfo_Dem_FLS_COMPARE_ERROR_GetFaultDetectionCounter
          RteEventToTaskMapping_OIE_EventInfo_Dem_FLS_ERASE_ERROR_GetDTCOfEvent: RteImmediateRestart=false, RteEventRef=OIE_EventInfo_Dem_FLS_ERASE_ERROR_GetDTCOfEvent
          RteEventToTaskMapping_OIE_EventInfo_Dem_FLS_ERASE_ERROR_GetEventExtendedDataRecord: RteImmediateRestart=false, RteEventRef=OIE_EventInfo_Dem_FLS_ERASE_ERROR_GetEventExtendedDataRecord
          RteEventToTaskMapping_OIE_EventInfo_Dem_FLS_ERASE_ERROR_GetEventFailed: RteImmediateRestart=false, RteEventRef=OIE_EventInfo_Dem_FLS_ERASE_ERROR_GetEventFailed
          RteEventToTaskMapping_OIE_EventInfo_Dem_FLS_ERASE_ERROR_GetEventFreezeFrameData: RteImmediateRestart=false, RteEventRef=OIE_EventInfo_Dem_FLS_ERASE_ERROR_GetEventFreezeFrameData
          RteEventToTaskMapping_OIE_EventInfo_Dem_FLS_ERASE_ERROR_GetEventStatus: RteImmediateRestart=false, RteEventRef=OIE_EventInfo_Dem_FLS_ERASE_ERROR_GetEventStatus
          RteEventToTaskMapping_OIE_EventInfo_Dem_FLS_ERASE_ERROR_GetEventTested: RteImmediateRestart=false, RteEventRef=OIE_EventInfo_Dem_FLS_ERASE_ERROR_GetEventTested
          RteEventToTaskMapping_OIE_EventInfo_Dem_FLS_ERASE_ERROR_GetFaultDetectionCounter: RteImmediateRestart=false, RteEventRef=OIE_EventInfo_Dem_FLS_ERASE_ERROR_GetFaultDetectionCounter
          RteEventToTaskMapping_OIE_EventInfo_Dem_FLS_READ_ERROR_GetDTCOfEvent: RteImmediateRestart=false, RteEventRef=OIE_EventInfo_Dem_FLS_READ_ERROR_GetDTCOfEvent
          RteEventToTaskMapping_OIE_EventInfo_Dem_FLS_READ_ERROR_GetEventExtendedDataRecord: RteImmediateRestart=false, RteEventRef=OIE_EventInfo_Dem_FLS_READ_ERROR_GetEventExtendedDataRecord
          RteEventToTaskMapping_OIE_EventInfo_Dem_FLS_READ_ERROR_GetEventFailed: RteImmediateRestart=false, RteEventRef=OIE_EventInfo_Dem_FLS_READ_ERROR_GetEventFailed
          RteEventToTaskMapping_OIE_EventInfo_Dem_FLS_READ_ERROR_GetEventFreezeFrameData: RteImmediateRestart=false, RteEventRef=OIE_EventInfo_Dem_FLS_READ_ERROR_GetEventFreezeFrameData
          RteEventToTaskMapping_OIE_EventInfo_Dem_FLS_READ_ERROR_GetEventStatus: RteImmediateRestart=false, RteEventRef=OIE_EventInfo_Dem_FLS_READ_ERROR_GetEventStatus
          RteEventToTaskMapping_OIE_EventInfo_Dem_FLS_READ_ERROR_GetEventTested: RteImmediateRestart=false, RteEventRef=OIE_EventInfo_Dem_FLS_READ_ERROR_GetEventTested
          RteEventToTaskMapping_OIE_EventInfo_Dem_FLS_READ_ERROR_GetFaultDetectionCounter: RteImmediateRestart=false, RteEventRef=OIE_EventInfo_Dem_FLS_READ_ERROR_GetFaultDetectionCounter
          RteEventToTaskMapping_OIE_EventInfo_Dem_FLS_WRITE_ERROR_GetDTCOfEvent: RteImmediateRestart=false, RteEventRef=OIE_EventInfo_Dem_FLS_WRITE_ERROR_GetDTCOfEvent
          RteEventToTaskMapping_OIE_EventInfo_Dem_FLS_WRITE_ERROR_GetEventExtendedDataRecord: RteImmediateRestart=false, RteEventRef=OIE_EventInfo_Dem_FLS_WRITE_ERROR_GetEventExtendedDataRecord
          RteEventToTaskMapping_OIE_EventInfo_Dem_FLS_WRITE_ERROR_GetEventFailed: RteImmediateRestart=false, RteEventRef=OIE_EventInfo_Dem_FLS_WRITE_ERROR_GetEventFailed
          RteEventToTaskMapping_OIE_EventInfo_Dem_FLS_WRITE_ERROR_GetEventFreezeFrameData: RteImmediateRestart=false, RteEventRef=OIE_EventInfo_Dem_FLS_WRITE_ERROR_GetEventFreezeFrameData
          RteEventToTaskMapping_OIE_EventInfo_Dem_FLS_WRITE_ERROR_GetEventStatus: RteImmediateRestart=false, RteEventRef=OIE_EventInfo_Dem_FLS_WRITE_ERROR_GetEventStatus
          RteEventToTaskMapping_OIE_EventInfo_Dem_FLS_WRITE_ERROR_GetEventTested: RteImmediateRestart=false, RteEventRef=OIE_EventInfo_Dem_FLS_WRITE_ERROR_GetEventTested
          RteEventToTaskMapping_OIE_EventInfo_Dem_FLS_WRITE_ERROR_GetFaultDetectionCounter: RteImmediateRestart=false, RteEventRef=OIE_EventInfo_Dem_FLS_WRITE_ERROR_GetFaultDetectionCounter
          RteEventToTaskMapping_OIE_EventInfo_EEP_E_COMPARE_FAILED_GetDTCOfEvent: RteImmediateRestart=false, RteEventRef=OIE_EventInfo_EEP_E_COMPARE_FAILED_GetDTCOfEvent
          RteEventToTaskMapping_OIE_EventInfo_EEP_E_COMPARE_FAILED_GetEventExtendedDataRecord: RteImmediateRestart=false, RteEventRef=OIE_EventInfo_EEP_E_COMPARE_FAILED_GetEventExtendedDataRecord
          RteEventToTaskMapping_OIE_EventInfo_EEP_E_COMPARE_FAILED_GetEventFailed: RteImmediateRestart=false, RteEventRef=OIE_EventInfo_EEP_E_COMPARE_FAILED_GetEventFailed
          RteEventToTaskMapping_OIE_EventInfo_EEP_E_COMPARE_FAILED_GetEventFreezeFrameData: RteImmediateRestart=false, RteEventRef=OIE_EventInfo_EEP_E_COMPARE_FAILED_GetEventFreezeFrameData
          RteEventToTaskMapping_OIE_EventInfo_EEP_E_COMPARE_FAILED_GetEventStatus: RteImmediateRestart=false, RteEventRef=OIE_EventInfo_EEP_E_COMPARE_FAILED_GetEventStatus
          RteEventToTaskMapping_OIE_EventInfo_EEP_E_COMPARE_FAILED_GetEventTested: RteImmediateRestart=false, RteEventRef=OIE_EventInfo_EEP_E_COMPARE_FAILED_GetEventTested
          RteEventToTaskMapping_OIE_EventInfo_EEP_E_COMPARE_FAILED_GetFaultDetectionCounter: RteImmediateRestart=false, RteEventRef=OIE_EventInfo_EEP_E_COMPARE_FAILED_GetFaultDetectionCounter
          RteEventToTaskMapping_OIE_EventInfo_EEP_E_ERASE_FAILED_GetDTCOfEvent: RteImmediateRestart=false, RteEventRef=OIE_EventInfo_EEP_E_ERASE_FAILED_GetDTCOfEvent
          RteEventToTaskMapping_OIE_EventInfo_EEP_E_ERASE_FAILED_GetEventExtendedDataRecord: RteImmediateRestart=false, RteEventRef=OIE_EventInfo_EEP_E_ERASE_FAILED_GetEventExtendedDataRecord
          RteEventToTaskMapping_OIE_EventInfo_EEP_E_ERASE_FAILED_GetEventFailed: RteImmediateRestart=false, RteEventRef=OIE_EventInfo_EEP_E_ERASE_FAILED_GetEventFailed
          RteEventToTaskMapping_OIE_EventInfo_EEP_E_ERASE_FAILED_GetEventFreezeFrameData: RteImmediateRestart=false, RteEventRef=OIE_EventInfo_EEP_E_ERASE_FAILED_GetEventFreezeFrameData
          RteEventToTaskMapping_OIE_EventInfo_EEP_E_ERASE_FAILED_GetEventStatus: RteImmediateRestart=false, RteEventRef=OIE_EventInfo_EEP_E_ERASE_FAILED_GetEventStatus
          RteEventToTaskMapping_OIE_EventInfo_EEP_E_ERASE_FAILED_GetEventTested: RteImmediateRestart=false, RteEventRef=OIE_EventInfo_EEP_E_ERASE_FAILED_GetEventTested
          RteEventToTaskMapping_OIE_EventInfo_EEP_E_ERASE_FAILED_GetFaultDetectionCounter: RteImmediateRestart=false, RteEventRef=OIE_EventInfo_EEP_E_ERASE_FAILED_GetFaultDetectionCounter
          RteEventToTaskMapping_OIE_EventInfo_EEP_E_READ_FAILED_GetDTCOfEvent: RteImmediateRestart=false, RteEventRef=OIE_EventInfo_EEP_E_READ_FAILED_GetDTCOfEvent
          RteEventToTaskMapping_OIE_EventInfo_EEP_E_READ_FAILED_GetEventExtendedDataRecord: RteImmediateRestart=false, RteEventRef=OIE_EventInfo_EEP_E_READ_FAILED_GetEventExtendedDataRecord
          RteEventToTaskMapping_OIE_EventInfo_EEP_E_READ_FAILED_GetEventFailed: RteImmediateRestart=false, RteEventRef=OIE_EventInfo_EEP_E_READ_FAILED_GetEventFailed
          RteEventToTaskMapping_OIE_EventInfo_EEP_E_READ_FAILED_GetEventFreezeFrameData: RteImmediateRestart=false, RteEventRef=OIE_EventInfo_EEP_E_READ_FAILED_GetEventFreezeFrameData
          RteEventToTaskMapping_OIE_EventInfo_EEP_E_READ_FAILED_GetEventStatus: RteImmediateRestart=false, RteEventRef=OIE_EventInfo_EEP_E_READ_FAILED_GetEventStatus
          RteEventToTaskMapping_OIE_EventInfo_EEP_E_READ_FAILED_GetEventTested: RteImmediateRestart=false, RteEventRef=OIE_EventInfo_EEP_E_READ_FAILED_GetEventTested
          RteEventToTaskMapping_OIE_EventInfo_EEP_E_READ_FAILED_GetFaultDetectionCounter: RteImmediateRestart=false, RteEventRef=OIE_EventInfo_EEP_E_READ_FAILED_GetFaultDetectionCounter
          RteEventToTaskMapping_OIE_EventInfo_EEP_E_WRITE_FAILED_GetDTCOfEvent: RteImmediateRestart=false, RteEventRef=OIE_EventInfo_EEP_E_WRITE_FAILED_GetDTCOfEvent
          RteEventToTaskMapping_OIE_EventInfo_EEP_E_WRITE_FAILED_GetEventExtendedDataRecord: RteImmediateRestart=false, RteEventRef=OIE_EventInfo_EEP_E_WRITE_FAILED_GetEventExtendedDataRecord
          RteEventToTaskMapping_OIE_EventInfo_EEP_E_WRITE_FAILED_GetEventFailed: RteImmediateRestart=false, RteEventRef=OIE_EventInfo_EEP_E_WRITE_FAILED_GetEventFailed
          RteEventToTaskMapping_OIE_EventInfo_EEP_E_WRITE_FAILED_GetEventFreezeFrameData: RteImmediateRestart=false, RteEventRef=OIE_EventInfo_EEP_E_WRITE_FAILED_GetEventFreezeFrameData
          RteEventToTaskMapping_OIE_EventInfo_EEP_E_WRITE_FAILED_GetEventStatus: RteImmediateRestart=false, RteEventRef=OIE_EventInfo_EEP_E_WRITE_FAILED_GetEventStatus
          RteEventToTaskMapping_OIE_EventInfo_EEP_E_WRITE_FAILED_GetEventTested: RteImmediateRestart=false, RteEventRef=OIE_EventInfo_EEP_E_WRITE_FAILED_GetEventTested
          RteEventToTaskMapping_OIE_EventInfo_EEP_E_WRITE_FAILED_GetFaultDetectionCounter: RteImmediateRestart=false, RteEventRef=OIE_EventInfo_EEP_E_WRITE_FAILED_GetFaultDetectionCounter
          RteEventToTaskMapping_OIE_EventInfo_ETHSM_E_LINK_DOWN_GetDTCOfEvent: RteImmediateRestart=false, RteEventRef=OIE_EventInfo_ETHSM_E_LINK_DOWN_GetDTCOfEvent
          RteEventToTaskMapping_OIE_EventInfo_ETHSM_E_LINK_DOWN_GetEventExtendedDataRecord: RteImmediateRestart=false, RteEventRef=OIE_EventInfo_ETHSM_E_LINK_DOWN_GetEventExtendedDataRecord
          RteEventToTaskMapping_OIE_EventInfo_ETHSM_E_LINK_DOWN_GetEventFailed: RteImmediateRestart=false, RteEventRef=OIE_EventInfo_ETHSM_E_LINK_DOWN_GetEventFailed
          RteEventToTaskMapping_OIE_EventInfo_ETHSM_E_LINK_DOWN_GetEventFreezeFrameData: RteImmediateRestart=false, RteEventRef=OIE_EventInfo_ETHSM_E_LINK_DOWN_GetEventFreezeFrameData
          RteEventToTaskMapping_OIE_EventInfo_ETHSM_E_LINK_DOWN_GetEventStatus: RteImmediateRestart=false, RteEventRef=OIE_EventInfo_ETHSM_E_LINK_DOWN_GetEventStatus
          RteEventToTaskMapping_OIE_EventInfo_ETHSM_E_LINK_DOWN_GetEventTested: RteImmediateRestart=false, RteEventRef=OIE_EventInfo_ETHSM_E_LINK_DOWN_GetEventTested
          RteEventToTaskMapping_OIE_EventInfo_ETHSM_E_LINK_DOWN_GetFaultDetectionCounter: RteImmediateRestart=false, RteEventRef=OIE_EventInfo_ETHSM_E_LINK_DOWN_GetFaultDetectionCounter
          RteEventToTaskMapping_OIE_EventInfo_ETHTRCV_E_ACCESS_GetDTCOfEvent: RteImmediateRestart=false, RteEventRef=OIE_EventInfo_ETHTRCV_E_ACCESS_GetDTCOfEvent
          RteEventToTaskMapping_OIE_EventInfo_ETHTRCV_E_ACCESS_GetEventExtendedDataRecord: RteImmediateRestart=false, RteEventRef=OIE_EventInfo_ETHTRCV_E_ACCESS_GetEventExtendedDataRecord
          RteEventToTaskMapping_OIE_EventInfo_ETHTRCV_E_ACCESS_GetEventFailed: RteImmediateRestart=false, RteEventRef=OIE_EventInfo_ETHTRCV_E_ACCESS_GetEventFailed
          RteEventToTaskMapping_OIE_EventInfo_ETHTRCV_E_ACCESS_GetEventFreezeFrameData: RteImmediateRestart=false, RteEventRef=OIE_EventInfo_ETHTRCV_E_ACCESS_GetEventFreezeFrameData
          RteEventToTaskMapping_OIE_EventInfo_ETHTRCV_E_ACCESS_GetEventStatus: RteImmediateRestart=false, RteEventRef=OIE_EventInfo_ETHTRCV_E_ACCESS_GetEventStatus
          RteEventToTaskMapping_OIE_EventInfo_ETHTRCV_E_ACCESS_GetEventTested: RteImmediateRestart=false, RteEventRef=OIE_EventInfo_ETHTRCV_E_ACCESS_GetEventTested
          RteEventToTaskMapping_OIE_EventInfo_ETHTRCV_E_ACCESS_GetFaultDetectionCounter: RteImmediateRestart=false, RteEventRef=OIE_EventInfo_ETHTRCV_E_ACCESS_GetFaultDetectionCounter
          RteEventToTaskMapping_OIE_EventInfo_ETH_E_ACCESS_GetDTCOfEvent: RteImmediateRestart=false, RteEventRef=OIE_EventInfo_ETH_E_ACCESS_GetDTCOfEvent
          RteEventToTaskMapping_OIE_EventInfo_ETH_E_ACCESS_GetEventExtendedDataRecord: RteImmediateRestart=false, RteEventRef=OIE_EventInfo_ETH_E_ACCESS_GetEventExtendedDataRecord
          RteEventToTaskMapping_OIE_EventInfo_ETH_E_ACCESS_GetEventFailed: RteImmediateRestart=false, RteEventRef=OIE_EventInfo_ETH_E_ACCESS_GetEventFailed
          RteEventToTaskMapping_OIE_EventInfo_ETH_E_ACCESS_GetEventFreezeFrameData: RteImmediateRestart=false, RteEventRef=OIE_EventInfo_ETH_E_ACCESS_GetEventFreezeFrameData
          RteEventToTaskMapping_OIE_EventInfo_ETH_E_ACCESS_GetEventStatus: RteImmediateRestart=false, RteEventRef=OIE_EventInfo_ETH_E_ACCESS_GetEventStatus
          RteEventToTaskMapping_OIE_EventInfo_ETH_E_ACCESS_GetEventTested: RteImmediateRestart=false, RteEventRef=OIE_EventInfo_ETH_E_ACCESS_GetEventTested
          RteEventToTaskMapping_OIE_EventInfo_ETH_E_ACCESS_GetFaultDetectionCounter: RteImmediateRestart=false, RteEventRef=OIE_EventInfo_ETH_E_ACCESS_GetFaultDetectionCounter
          RteEventToTaskMapping_OIE_EventInfo_FR_E_ACCESS_GetDTCOfEvent: RteImmediateRestart=false, RteEventRef=OIE_EventInfo_FR_E_ACCESS_GetDTCOfEvent
          RteEventToTaskMapping_OIE_EventInfo_FR_E_ACCESS_GetEventExtendedDataRecord: RteImmediateRestart=false, RteEventRef=OIE_EventInfo_FR_E_ACCESS_GetEventExtendedDataRecord
          RteEventToTaskMapping_OIE_EventInfo_FR_E_ACCESS_GetEventFailed: RteImmediateRestart=false, RteEventRef=OIE_EventInfo_FR_E_ACCESS_GetEventFailed
          RteEventToTaskMapping_OIE_EventInfo_FR_E_ACCESS_GetEventFreezeFrameData: RteImmediateRestart=false, RteEventRef=OIE_EventInfo_FR_E_ACCESS_GetEventFreezeFrameData
          RteEventToTaskMapping_OIE_EventInfo_FR_E_ACCESS_GetEventStatus: RteImmediateRestart=false, RteEventRef=OIE_EventInfo_FR_E_ACCESS_GetEventStatus
          RteEventToTaskMapping_OIE_EventInfo_FR_E_ACCESS_GetEventTested: RteImmediateRestart=false, RteEventRef=OIE_EventInfo_FR_E_ACCESS_GetEventTested
          RteEventToTaskMapping_OIE_EventInfo_FR_E_ACCESS_GetFaultDetectionCounter: RteImmediateRestart=false, RteEventRef=OIE_EventInfo_FR_E_ACCESS_GetFaultDetectionCounter
          RteEventToTaskMapping_OIE_EventInfo_LIN_E_TIMEOUT_GetDTCOfEvent: RteImmediateRestart=false, RteEventRef=OIE_EventInfo_LIN_E_TIMEOUT_GetDTCOfEvent
          RteEventToTaskMapping_OIE_EventInfo_LIN_E_TIMEOUT_GetEventExtendedDataRecord: RteImmediateRestart=false, RteEventRef=OIE_EventInfo_LIN_E_TIMEOUT_GetEventExtendedDataRecord
          RteEventToTaskMapping_OIE_EventInfo_LIN_E_TIMEOUT_GetEventFailed: RteImmediateRestart=false, RteEventRef=OIE_EventInfo_LIN_E_TIMEOUT_GetEventFailed
          RteEventToTaskMapping_OIE_EventInfo_LIN_E_TIMEOUT_GetEventFreezeFrameData: RteImmediateRestart=false, RteEventRef=OIE_EventInfo_LIN_E_TIMEOUT_GetEventFreezeFrameData
          RteEventToTaskMapping_OIE_EventInfo_LIN_E_TIMEOUT_GetEventStatus: RteImmediateRestart=false, RteEventRef=OIE_EventInfo_LIN_E_TIMEOUT_GetEventStatus
          RteEventToTaskMapping_OIE_EventInfo_LIN_E_TIMEOUT_GetEventTested: RteImmediateRestart=false, RteEventRef=OIE_EventInfo_LIN_E_TIMEOUT_GetEventTested
          RteEventToTaskMapping_OIE_EventInfo_LIN_E_TIMEOUT_GetFaultDetectionCounter: RteImmediateRestart=false, RteEventRef=OIE_EventInfo_LIN_E_TIMEOUT_GetFaultDetectionCounter
          RteEventToTaskMapping_OIE_EventInfo_RAMTST_E_RAM_FAILURE_GetDTCOfEvent: RteImmediateRestart=false, RteEventRef=OIE_EventInfo_RAMTST_E_RAM_FAILURE_GetDTCOfEvent
          RteEventToTaskMapping_OIE_EventInfo_RAMTST_E_RAM_FAILURE_GetEventExtendedDataRecord: RteImmediateRestart=false, RteEventRef=OIE_EventInfo_RAMTST_E_RAM_FAILURE_GetEventExtendedDataRecord
          RteEventToTaskMapping_OIE_EventInfo_RAMTST_E_RAM_FAILURE_GetEventFailed: RteImmediateRestart=false, RteEventRef=OIE_EventInfo_RAMTST_E_RAM_FAILURE_GetEventFailed
          RteEventToTaskMapping_OIE_EventInfo_RAMTST_E_RAM_FAILURE_GetEventFreezeFrameData: RteImmediateRestart=false, RteEventRef=OIE_EventInfo_RAMTST_E_RAM_FAILURE_GetEventFreezeFrameData
          RteEventToTaskMapping_OIE_EventInfo_RAMTST_E_RAM_FAILURE_GetEventStatus: RteImmediateRestart=false, RteEventRef=OIE_EventInfo_RAMTST_E_RAM_FAILURE_GetEventStatus
          RteEventToTaskMapping_OIE_EventInfo_RAMTST_E_RAM_FAILURE_GetEventTested: RteImmediateRestart=false, RteEventRef=OIE_EventInfo_RAMTST_E_RAM_FAILURE_GetEventTested
          RteEventToTaskMapping_OIE_EventInfo_RAMTST_E_RAM_FAILURE_GetFaultDetectionCounter: RteImmediateRestart=false, RteEventRef=OIE_EventInfo_RAMTST_E_RAM_FAILURE_GetFaultDetectionCounter
          RteEventToTaskMapping_OIE_EventInfo_REGMON_E_REG_FAILURE_GetDTCOfEvent: RteImmediateRestart=false, RteEventRef=OIE_EventInfo_REGMON_E_REG_FAILURE_GetDTCOfEvent
          RteEventToTaskMapping_OIE_EventInfo_REGMON_E_REG_FAILURE_GetEventExtendedDataRecord: RteImmediateRestart=false, RteEventRef=OIE_EventInfo_REGMON_E_REG_FAILURE_GetEventExtendedDataRecord
          RteEventToTaskMapping_OIE_EventInfo_REGMON_E_REG_FAILURE_GetEventFailed: RteImmediateRestart=false, RteEventRef=OIE_EventInfo_REGMON_E_REG_FAILURE_GetEventFailed
          RteEventToTaskMapping_OIE_EventInfo_REGMON_E_REG_FAILURE_GetEventFreezeFrameData: RteImmediateRestart=false, RteEventRef=OIE_EventInfo_REGMON_E_REG_FAILURE_GetEventFreezeFrameData
          RteEventToTaskMapping_OIE_EventInfo_REGMON_E_REG_FAILURE_GetEventStatus: RteImmediateRestart=false, RteEventRef=OIE_EventInfo_REGMON_E_REG_FAILURE_GetEventStatus
          RteEventToTaskMapping_OIE_EventInfo_REGMON_E_REG_FAILURE_GetEventTested: RteImmediateRestart=false, RteEventRef=OIE_EventInfo_REGMON_E_REG_FAILURE_GetEventTested
          RteEventToTaskMapping_OIE_EventInfo_REGMON_E_REG_FAILURE_GetFaultDetectionCounter: RteImmediateRestart=false, RteEventRef=OIE_EventInfo_REGMON_E_REG_FAILURE_GetFaultDetectionCounter
          RteEventToTaskMapping_OIE_EventInfo_WDG_76_ACW_E_DISABLE_REJECTED_GetDTCOfEvent: RteImmediateRestart=false, RteEventRef=OIE_EventInfo_WDG_76_ACW_E_DISABLE_REJECTED_GetDTCOfEvent
          RteEventToTaskMapping_OIE_EventInfo_WDG_76_ACW_E_DISABLE_REJECTED_GetEventExtendedDataRecord: RteImmediateRestart=false, RteEventRef=OIE_EventInfo_WDG_76_ACW_E_DISABLE_REJECTED_GetEventExtendedDataRecord
          RteEventToTaskMapping_OIE_EventInfo_WDG_76_ACW_E_DISABLE_REJECTED_GetEventFailed: RteImmediateRestart=false, RteEventRef=OIE_EventInfo_WDG_76_ACW_E_DISABLE_REJECTED_GetEventFailed
          RteEventToTaskMapping_OIE_EventInfo_WDG_76_ACW_E_DISABLE_REJECTED_GetEventFreezeFrameData: RteImmediateRestart=false, RteEventRef=OIE_EventInfo_WDG_76_ACW_E_DISABLE_REJECTED_GetEventFreezeFrameData
          RteEventToTaskMapping_OIE_EventInfo_WDG_76_ACW_E_DISABLE_REJECTED_GetEventStatus: RteImmediateRestart=false, RteEventRef=OIE_EventInfo_WDG_76_ACW_E_DISABLE_REJECTED_GetEventStatus
          RteEventToTaskMapping_OIE_EventInfo_WDG_76_ACW_E_DISABLE_REJECTED_GetEventTested: RteImmediateRestart=false, RteEventRef=OIE_EventInfo_WDG_76_ACW_E_DISABLE_REJECTED_GetEventTested
          RteEventToTaskMapping_OIE_EventInfo_WDG_76_ACW_E_DISABLE_REJECTED_GetFaultDetectionCounter: RteImmediateRestart=false, RteEventRef=OIE_EventInfo_WDG_76_ACW_E_DISABLE_REJECTED_GetFaultDetectionCounter
          RteEventToTaskMapping_OIE_EventInfo_WDG_76_ACW_E_MODE_FAILED_GetDTCOfEvent: RteImmediateRestart=false, RteEventRef=OIE_EventInfo_WDG_76_ACW_E_MODE_FAILED_GetDTCOfEvent
          RteEventToTaskMapping_OIE_EventInfo_WDG_76_ACW_E_MODE_FAILED_GetEventExtendedDataRecord: RteImmediateRestart=false, RteEventRef=OIE_EventInfo_WDG_76_ACW_E_MODE_FAILED_GetEventExtendedDataRecord
          RteEventToTaskMapping_OIE_EventInfo_WDG_76_ACW_E_MODE_FAILED_GetEventFailed: RteImmediateRestart=false, RteEventRef=OIE_EventInfo_WDG_76_ACW_E_MODE_FAILED_GetEventFailed
          RteEventToTaskMapping_OIE_EventInfo_WDG_76_ACW_E_MODE_FAILED_GetEventFreezeFrameData: RteImmediateRestart=false, RteEventRef=OIE_EventInfo_WDG_76_ACW_E_MODE_FAILED_GetEventFreezeFrameData
          RteEventToTaskMapping_OIE_EventInfo_WDG_76_ACW_E_MODE_FAILED_GetEventStatus: RteImmediateRestart=false, RteEventRef=OIE_EventInfo_WDG_76_ACW_E_MODE_FAILED_GetEventStatus
          RteEventToTaskMapping_OIE_EventInfo_WDG_76_ACW_E_MODE_FAILED_GetEventTested: RteImmediateRestart=false, RteEventRef=OIE_EventInfo_WDG_76_ACW_E_MODE_FAILED_GetEventTested
          RteEventToTaskMapping_OIE_EventInfo_WDG_76_ACW_E_MODE_FAILED_GetFaultDetectionCounter: RteImmediateRestart=false, RteEventRef=OIE_EventInfo_WDG_76_ACW_E_MODE_FAILED_GetFaultDetectionCounter
      SwcInstance_Det: RteSoftwareComponentInstanceRef=Det
        RteEventToTaskMapping_OperationInvokedEvent_Det (RteEventToTaskMapping): category=TOOL_CONFIGURED, RteImmediateRestart=0, RteEventRef=OperationInvokedEvent_Det
      SwcInstance_EcuM: RteSoftwareComponentInstanceRef=EcuM
        15 x RteEventToTaskMapping, all with category=TOOL_CONFIGURED, RteImmediateRestart=0:
          RteEventToTaskMapping_OIE_DisableWakeupSources: RteEventRef=OIE_DisableWakeupSources
          RteEventToTaskMapping_OIE_EnableWakeupSources: RteEventRef=OIE_EnableWakeupSources
          RteEventToTaskMapping_OIE_GetBootTarget: RteEventRef=OIE_GetBootTarget
          RteEventToTaskMapping_OIE_GetLastShutdownTarget: RteEventRef=OIE_GetLastShutdownTarget
          RteEventToTaskMapping_OIE_GetMostRecentShutdown: RteEventRef=OIE_GetMostRecentShutdown
          RteEventToTaskMapping_OIE_GetNextRecentShutdown: RteEventRef=OIE_GetNextRecentShutdown
          RteEventToTaskMapping_OIE_GetShutdownCause: RteEventRef=OIE_GetShutdownCause
          RteEventToTaskMapping_OIE_GetShutdownTarget: RteEventRef=OIE_GetShutdownTarget
          RteEventToTaskMapping_OIE_GoDown: RteEventRef=OIE_GoDown
          RteEventToTaskMapping_OIE_SelectBootTarget: RteEventRef=OIE_SelectBootTarget
          RteEventToTaskMapping_OIE_SelectShutdownCause: RteEventRef=OIE_SelectShutdownCause
          RteEventToTaskMapping_OIE_SelectShutdownTarget: RteEventRef=OIE_SelectShutdownTarget
          RteEventToTaskMapping_OIE_GoHalt: RteEventRef=OIE_GoHalt
          RteEventToTaskMapping_OIE_GoPoll: RteEventRef=OIE_GoPoll
          RteEventToTaskMapping_OIE_ClearWakeupEvent: RteEventRef=OIE_ClearWakeupEvent
      SwcInstance_IoHwAb: RteSoftwareComponentInstanceRef=Svc_IoHwAb
        89 x RteEventToTaskMapping, all with category=TOOL_CONFIGURED, RteImmediateRestart=false:
          RteEventToTaskMapping_IoHwAb_Ev_IoHwAbMcuSpecific_ControlIBE: RteEventRef=IoHwAb_Ev_IoHwAbMcuSpecific_ControlIBE
          RteEventToTaskMapping_IoHwAb_Ev_IoHwAbDigitalDirectLogical_LED01_ReadDirect: RteEventRef=IoHwAb_Ev_IoHwAbDigitalDirectLogical_LED01_ReadDirect
          RteEventToTaskMapping_IoHwAb_Ev_IoHwAbDigitalDirectLogical_LED01_WriteDirect: RteEventRef=IoHwAb_Ev_IoHwAbDigitalDirectLogical_LED01_WriteDirect
          RteEventToTaskMapping_IoHwAb_Ev_IoHwAbDigitalDirectLogical_LED01_SetToInput: RteEventRef=IoHwAb_Ev_IoHwAbDigitalDirectLogical_LED01_SetToInput
          RteEventToTaskMapping_IoHwAb_Ev_IoHwAbDigitalDirectLogical_LED01_SetToOutput: RteEventRef=IoHwAb_Ev_IoHwAbDigitalDirectLogical_LED01_SetToOutput
          RteEventToTaskMapping_IoHwAb_Ev_IoHwAbDigitalDirectLogical_LED01_IsInput: RteEventRef=IoHwAb_Ev_IoHwAbDigitalDirectLogical_LED01_IsInput
          RteEventToTaskMapping_IoHwAb_Ev_IoHwAbDigitalDirectLogical_LED01_IsOutput: RteEventRef=IoHwAb_Ev_IoHwAbDigitalDirectLogical_LED01_IsOutput
          RteEventToTaskMapping_IoHwAb_Ev_IoHwAbDigitalDirectLogical_S01_ReadDirect: RteEventRef=IoHwAb_Ev_IoHwAbDigitalDirectLogical_S01_ReadDirect
          RteEventToTaskMapping_IoHwAb_Ev_IoHwAbDigitalDirectLogical_S01_WriteDirect: RteEventRef=IoHwAb_Ev_IoHwAbDigitalDirectLogical_S01_WriteDirect
          RteEventToTaskMapping_IoHwAb_Ev_IoHwAbDigitalDirectLogical_S01_SetToInput: RteEventRef=IoHwAb_Ev_IoHwAbDigitalDirectLogical_S01_SetToInput
          RteEventToTaskMapping_IoHwAb_Ev_IoHwAbDigitalDirectLogical_S01_SetToOutput: RteEventRef=IoHwAb_Ev_IoHwAbDigitalDirectLogical_S01_SetToOutput
          RteEventToTaskMapping_IoHwAb_Ev_IoHwAbDigitalDirectLogical_S01_IsInput: RteEventRef=IoHwAb_Ev_IoHwAbDigitalDirectLogical_S01_IsInput
          RteEventToTaskMapping_IoHwAb_Ev_IoHwAbDigitalDirectLogical_S01_IsOutput: RteEventRef=IoHwAb_Ev_IoHwAbDigitalDirectLogical_S01_IsOutput
          RteEventToTaskMapping_IoHwAb_Ev_IoHwAbDigitalDirectLogical_S02_ReadDirect: RteEventRef=IoHwAb_Ev_IoHwAbDigitalDirectLogical_S02_ReadDirect
          RteEventToTaskMapping_IoHwAb_Ev_IoHwAbDigitalDirectLogical_S02_WriteDirect: RteEventRef=IoHwAb_Ev_IoHwAbDigitalDirectLogical_S02_WriteDirect
          RteEventToTaskMapping_IoHwAb_Ev_IoHwAbDigitalDirectLogical_S02_SetToInput: RteEventRef=IoHwAb_Ev_IoHwAbDigitalDirectLogical_S02_SetToInput
          RteEventToTaskMapping_IoHwAb_Ev_IoHwAbDigitalDirectLogical_S02_SetToOutput: RteEventRef=IoHwAb_Ev_IoHwAbDigitalDirectLogical_S02_SetToOutput
          RteEventToTaskMapping_IoHwAb_Ev_IoHwAbDigitalDirectLogical_S02_IsInput: RteEventRef=IoHwAb_Ev_IoHwAbDigitalDirectLogical_S02_IsInput
          RteEventToTaskMapping_IoHwAb_Ev_IoHwAbDigitalDirectLogical_S02_IsOutput: RteEventRef=IoHwAb_Ev_IoHwAbDigitalDirectLogical_S02_IsOutput
          RteEventToTaskMapping_IoHwAb_Ev_IoHwAbDigitalDirectLogical_S03_ReadDirect: RteEventRef=IoHwAb_Ev_IoHwAbDigitalDirectLogical_S03_ReadDirect
          RteEventToTaskMapping_IoHwAb_Ev_IoHwAbDigitalDirectLogical_S03_WriteDirect: RteEventRef=IoHwAb_Ev_IoHwAbDigitalDirectLogical_S03_WriteDirect
          RteEventToTaskMapping_IoHwAb_Ev_IoHwAbDigitalDirectLogical_S03_SetToInput: RteEventRef=IoHwAb_Ev_IoHwAbDigitalDirectLogical_S03_SetToInput
          RteEventToTaskMapping_IoHwAb_Ev_IoHwAbDigitalDirectLogical_S03_SetToOutput: RteEventRef=IoHwAb_Ev_IoHwAbDigitalDirectLogical_S03_SetToOutput
          RteEventToTaskMapping_IoHwAb_Ev_IoHwAbDigitalDirectLogical_S03_IsInput: RteEventRef=IoHwAb_Ev_IoHwAbDigitalDirectLogical_S03_IsInput
          RteEventToTaskMapping_IoHwAb_Ev_IoHwAbDigitalDirectLogical_S03_IsOutput: RteEventRef=IoHwAb_Ev_IoHwAbDigitalDirectLogical_S03_IsOutput
          RteEventToTaskMapping_IoHwAb_Ev_IoHwAbDigitalDirectLogical_S04_ReadDirect: RteEventRef=IoHwAb_Ev_IoHwAbDigitalDirectLogical_S04_ReadDirect
          RteEventToTaskMapping_IoHwAb_Ev_IoHwAbDigitalDirectLogical_S04_WriteDirect: RteEventRef=IoHwAb_Ev_IoHwAbDigitalDirectLogical_S04_WriteDirect
          RteEventToTaskMapping_IoHwAb_Ev_IoHwAbDigitalDirectLogical_S04_SetToInput: RteEventRef=IoHwAb_Ev_IoHwAbDigitalDirectLogical_S04_SetToInput
          RteEventToTaskMapping_IoHwAb_Ev_IoHwAbDigitalDirectLogical_S04_SetToOutput: RteEventRef=IoHwAb_Ev_IoHwAbDigitalDirectLogical_S04_SetToOutput
          RteEventToTaskMapping_IoHwAb_Ev_IoHwAbDigitalDirectLogical_S04_IsInput: RteEventRef=IoHwAb_Ev_IoHwAbDigitalDirectLogical_S04_IsInput
          RteEventToTaskMapping_IoHwAb_Ev_IoHwAbDigitalDirectLogical_S04_IsOutput: RteEventRef=IoHwAb_Ev_IoHwAbDigitalDirectLogical_S04_IsOutput
          RteEventToTaskMapping_IoHwAb_Ev_IoHwAbAnalogInputDirectLogical_01_ReadDirect: RteEventRef=IoHwAb_Ev_IoHwAbAnalogInputDirectLogical_01_ReadDirect
          RteEventToTaskMapping_IoHwAb_Ev_IoHwAbAnalogInputLogical_PD00_Read: RteEventRef=IoHwAb_Ev_IoHwAbAnalogInputLogical_PD00_Read
          RteEventToTaskMapping_IoHwAb_Ev_IoHwAbAnalogInputLogical_PD00_ReadDirect: RteEventRef=IoHwAb_Ev_IoHwAbAnalogInputLogical_PD00_ReadDirect
          RteEventToTaskMapping_IoHwAb_Ev_IoHwAbAnalogInputLogical_PD00_Freeze: RteEventRef=IoHwAb_Ev_IoHwAbAnalogInputLogical_PD00_Freeze
          RteEventToTaskMapping_IoHwAb_Ev_IoHwAbAnalogInputLogical_PD00_Unfreeze: RteEventRef=IoHwAb_Ev_IoHwAbAnalogInputLogical_PD00_Unfreeze
          RteEventToTaskMapping_IoHwAb_Ev_IoHwAbIcuLogical_Timestamp_PA8_SetActivationCondition: RteEventRef=IoHwAb_Ev_IoHwAbIcuLogical_Timestamp_PA8_SetActivationCondition
          RteEventToTaskMapping_IoHwAb_Ev_IoHwAbIcuLogical_Timestamp_PA8_DisableNotification: RteEventRef=IoHwAb_Ev_IoHwAbIcuLogical_Timestamp_PA8_DisableNotification
          RteEventToTaskMapping_IoHwAb_Ev_IoHwAbIcuLogical_Timestamp_PA8_EnableNotification: RteEventRef=IoHwAb_Ev_IoHwAbIcuLogical_Timestamp_PA8_EnableNotification
          RteEventToTaskMapping_IoHwAb_Ev_IoHwAbIcuLogical_Timestamp_PA8_GetInputState: RteEventRef=IoHwAb_Ev_IoHwAbIcuLogical_Timestamp_PA8_GetInputState
          RteEventToTaskMapping_IoHwAb_Ev_IoHwAbIcuLogical_Timestamp_PA8_StartTimestamp: RteEventRef=IoHwAb_Ev_IoHwAbIcuLogical_Timestamp_PA8_StartTimestamp
          RteEventToTaskMapping_IoHwAb_Ev_IoHwAbIcuLogical_Timestamp_PA8_StopTimestamp: RteEventRef=IoHwAb_Ev_IoHwAbIcuLogical_Timestamp_PA8_StopTimestamp
          RteEventToTaskMapping_IoHwAb_Ev_IoHwAbIcuLogical_Timestamp_PA8_GetTimestampIndex: RteEventRef=IoHwAb_Ev_IoHwAbIcuLogical_Timestamp_PA8_GetTimestampIndex
          RteEventToTaskMapping_IoHwAb_Ev_IoHwAbIcuLogical_Timestamp_PA8_ResetEdgeCount: RteEventRef=IoHwAb_Ev_IoHwAbIcuLogical_Timestamp_PA8_ResetEdgeCount
          RteEventToTaskMapping_IoHwAb_Ev_IoHwAbIcuLogical_Timestamp_PA8_EnableEdgeCount: RteEventRef=IoHwAb_Ev_IoHwAbIcuLogical_Timestamp_PA8_EnableEdgeCount
          RteEventToTaskMapping_IoHwAb_Ev_IoHwAbIcuLogical_Timestamp_PA8_DisableEdgeCount: RteEventRef=IoHwAb_Ev_IoHwAbIcuLogical_Timestamp_PA8_DisableEdgeCount
          RteEventToTaskMapping_IoHwAb_Ev_IoHwAbIcuLogical_Timestamp_PA8_GetEdgeNumbers: RteEventRef=IoHwAb_Ev_IoHwAbIcuLogical_Timestamp_PA8_GetEdgeNumbers
          RteEventToTaskMapping_IoHwAb_Ev_IoHwAbIcuLogical_Timestamp_PA8_EnableEdgeDetection: RteEventRef=IoHwAb_Ev_IoHwAbIcuLogical_Timestamp_PA8_EnableEdgeDetection
          RteEventToTaskMapping_IoHwAb_Ev_IoHwAbIcuLogical_Timestamp_PA8_DisableEdgeDetection: RteEventRef=IoHwAb_Ev_IoHwAbIcuLogical_Timestamp_PA8_DisableEdgeDetection
          RteEventToTaskMapping_IoHwAb_Ev_IoHwAbIcuLogical_Timestamp_PA8_StartSignalMeasurement: RteEventRef=IoHwAb_Ev_IoHwAbIcuLogical_Timestamp_PA8_StartSignalMeasurement
          RteEventToTaskMapping_IoHwAb_Ev_IoHwAbIcuLogical_Timestamp_PA8_StopSignalMeasurement: RteEventRef=IoHwAb_Ev_IoHwAbIcuLogical_Timestamp_PA8_StopSignalMeasurement
          RteEventToTaskMapping_IoHwAb_Ev_IoHwAbIcuLogical_Timestamp_PA8_GetTimeElapsed: RteEventRef=IoHwAb_Ev_IoHwAbIcuLogical_Timestamp_PA8_GetTimeElapsed
          RteEventToTaskMapping_IoHwAb_Ev_IoHwAbIcuLogical_Timestamp_PA8_GetDutyCycleValues: RteEventRef=IoHwAb_Ev_IoHwAbIcuLogical_Timestamp_PA8_GetDutyCycleValues
          RteEventToTaskMapping_IoHwAb_Ev_IoHwAbGptLogical0_StartTimer: RteEventRef=IoHwAb_Ev_IoHwAbGptLogical0_StartTimer
          RteEventToTaskMapping_IoHwAb_Ev_IoHwAbGptLogical0_StopTimer: RteEventRef=IoHwAb_Ev_IoHwAbGptLogical0_StopTimer
          RteEventToTaskMapping_IoHwAb_Ev_IoHwAbGptLogical0_GetTimeElapsed: RteEventRef=IoHwAb_Ev_IoHwAbGptLogical0_GetTimeElapsed
          RteEventToTaskMapping_IoHwAb_Ev_IoHwAbGptLogical0_GetTimeRemaining: RteEventRef=IoHwAb_Ev_IoHwAbGptLogical0_GetTimeRemaining
          RteEventToTaskMapping_IoHwAb_Ev_IoHwAbGptLogical0_DisableNotification: RteEventRef=IoHwAb_Ev_IoHwAbGptLogical0_DisableNotification
          RteEventToTaskMapping_IoHwAb_Ev_IoHwAbGptLogical0_EnableNotification: RteEventRef=IoHwAb_Ev_IoHwAbGptLogical0_EnableNotification
          RteEventToTaskMapping_IoHwAb_Ev_IoHwAbPwm_0_SetDutyCycle: RteEventRef=IoHwAb_Ev_IoHwAbPwm_0_SetDutyCycle
          RteEventToTaskMapping_IoHwAb_Ev_IoHwAbPwm_0_SetPeriodAndDuty: RteEventRef=IoHwAb_Ev_IoHwAbPwm_0_SetPeriodAndDuty
          RteEventToTaskMapping_IoHwAb_Ev_IoHwAbPwm_0_SetOutputToIdle: RteEventRef=IoHwAb_Ev_IoHwAbPwm_0_SetOutputToIdle
          RteEventToTaskMapping_IoHwAb_Ev_IoHwAbPwm_0_GetOutputState: RteEventRef=IoHwAb_Ev_IoHwAbPwm_0_GetOutputState
          RteEventToTaskMapping_IoHwAb_Ev_IoHwAbPwm_0_DisableNotification: RteEventRef=IoHwAb_Ev_IoHwAbPwm_0_DisableNotification
          RteEventToTaskMapping_IoHwAb_Ev_IoHwAbPwm_0_EnableNotification: RteEventRef=IoHwAb_Ev_IoHwAbPwm_0_EnableNotification
          RteEventToTaskMapping_IoHwAb_Ev_IoHwAbDigitalDirectLogical_LED02_ReadDirect: RteEventRef=IoHwAb_Ev_IoHwAbDigitalDirectLogical_LED02_ReadDirect
          RteEventToTaskMapping_IoHwAb_Ev_IoHwAbDigitalDirectLogical_LED02_WriteDirect: RteEventRef=IoHwAb_Ev_IoHwAbDigitalDirectLogical_LED02_WriteDirect
          RteEventToTaskMapping_IoHwAb_Ev_IoHwAbDigitalDirectLogical_LED02_SetToInput: RteEventRef=IoHwAb_Ev_IoHwAbDigitalDirectLogical_LED02_SetToInput
          RteEventToTaskMapping_IoHwAb_Ev_IoHwAbDigitalDirectLogical_LED02_SetToOutput: RteEventRef=IoHwAb_Ev_IoHwAbDigitalDirectLogical_LED02_SetToOutput
          RteEventToTaskMapping_IoHwAb_Ev_IoHwAbDigitalDirectLogical_LED02_IsInput: RteEventRef=IoHwAb_Ev_IoHwAbDigitalDirectLogical_LED02_IsInput
          RteEventToTaskMapping_IoHwAb_Ev_IoHwAbDigitalDirectLogical_LED02_IsOutput: RteEventRef=IoHwAb_Ev_IoHwAbDigitalDirectLogical_LED02_IsOutput
          RteEventToTaskMapping_IoHwAb_Ev_IoHwAbDigitalDirectLogical_LED03_ReadDirect: RteEventRef=IoHwAb_Ev_IoHwAbDigitalDirectLogical_LED03_ReadDirect
          RteEventToTaskMapping_IoHwAb_Ev_IoHwAbDigitalDirectLogical_LED03_WriteDirect: RteEventRef=IoHwAb_Ev_IoHwAbDigitalDirectLogical_LED03_WriteDirect
          RteEventToTaskMapping_IoHwAb_Ev_IoHwAbDigitalDirectLogical_LED03_SetToInput: RteEventRef=IoHwAb_Ev_IoHwAbDigitalDirectLogical_LED03_SetToInput
          RteEventToTaskMapping_IoHwAb_Ev_IoHwAbDigitalDirectLogical_LED03_SetToOutput: RteEventRef=IoHwAb_Ev_IoHwAbDigitalDirectLogical_LED03_SetToOutput
          RteEventToTaskMapping_IoHwAb_Ev_IoHwAbDigitalDirectLogical_LED03_IsInput: RteEventRef=IoHwAb_Ev_IoHwAbDigitalDirectLogical_LED03_IsInput
          RteEventToTaskMapping_IoHwAb_Ev_IoHwAbDigitalDirectLogical_LED03_IsOutput: RteEventRef=IoHwAb_Ev_IoHwAbDigitalDirectLogical_LED03_IsOutput
          RteEventToTaskMapping_IoHwAb_Ev_IoHwAbGptLogical_EMIOS4_StartTimer: RteEventRef=IoHwAb_Ev_IoHwAbGptLogical_EMIOS4_StartTimer
          RteEventToTaskMapping_IoHwAb_Ev_IoHwAbGptLogical_EMIOS4_StopTimer: RteEventRef=IoHwAb_Ev_IoHwAbGptLogical_EMIOS4_StopTimer
          RteEventToTaskMapping_IoHwAb_Ev_IoHwAbGptLogical_EMIOS4_GetTimeElapsed: RteEventRef=IoHwAb_Ev_IoHwAbGptLogical_EMIOS4_GetTimeElapsed
          RteEventToTaskMapping_IoHwAb_Ev_IoHwAbGptLogical_EMIOS4_GetTimeRemaining: RteEventRef=IoHwAb_Ev_IoHwAbGptLogical_EMIOS4_GetTimeRemaining
          RteEventToTaskMapping_IoHwAb_Ev_IoHwAbGptLogical_EMIOS4_DisableNotification: RteEventRef=IoHwAb_Ev_IoHwAbGptLogical_EMIOS4_DisableNotification
          RteEventToTaskMapping_IoHwAb_Ev_IoHwAbGptLogical_EMIOS4_EnableNotification: RteEventRef=IoHwAb_Ev_IoHwAbGptLogical_EMIOS4_EnableNotification
          RteEventToTaskMapping_IoHwAb_Ev_IoHwAbPwmLogical_EMIOS23_SetDutyCycle: RteEventRef=IoHwAb_Ev_IoHwAbPwmLogical_EMIOS23_SetDutyCycle
          RteEventToTaskMapping_IoHwAb_Ev_IoHwAbPwmLogical_EMIOS23_SetPeriodAndDuty: RteEventRef=IoHwAb_Ev_IoHwAbPwmLogical_EMIOS23_SetPeriodAndDuty
          RteEventToTaskMapping_IoHwAb_Ev_IoHwAbPwmLogical_EMIOS23_SetOutputToIdle: RteEventRef=IoHwAb_Ev_IoHwAbPwmLogical_EMIOS23_SetOutputToIdle
          RteEventToTaskMapping_IoHwAb_Ev_IoHwAbPwmLogical_EMIOS23_GetOutputState: RteEventRef=IoHwAb_Ev_IoHwAbPwmLogical_EMIOS23_GetOutputState
          RteEventToTaskMapping_IoHwAb_Ev_IoHwAbPwmLogical_EMIOS23_DisableNotification: RteEventRef=IoHwAb_Ev_IoHwAbPwmLogical_EMIOS23_DisableNotification
          RteEventToTaskMapping_IoHwAb_Ev_IoHwAbPwmLogical_EMIOS23_EnableNotification: RteEventRef=IoHwAb_Ev_IoHwAbPwmLogical_EMIOS23_EnableNotification
      SwcInstance_NvM: RteSoftwareComponentInstanceRef=NvM
        63 x RteEventToTaskMapping, all with category=TOOL_CONFIGURED, RteImmediateRestart=0:
          RteEventToTaskMapping_OperationInvokedEvent_PS_NvMBlock_ConfigID_CancelJobs: RteEventRef=OperationInvokedEvent_PS_NvMBlock_ConfigID_CancelJobs
          RteEventToTaskMapping_OperationInvokedEvent_PS_NvMBlock_ConfigID_EraseNvBlock: RteEventRef=OperationInvokedEvent_PS_NvMBlock_ConfigID_EraseNvBlock
          RteEventToTaskMapping_OperationInvokedEvent_PS_NvMBlock_ConfigID_GetErrorStatus: RteEventRef=OperationInvokedEvent_PS_NvMBlock_ConfigID_GetErrorStatus
          RteEventToTaskMapping_OperationInvokedEvent_PS_NvMBlock_ConfigID_InvalidateNvBlock: RteEventRef=OperationInvokedEvent_PS_NvMBlock_ConfigID_InvalidateNvBlock
          RteEventToTaskMapping_OperationInvokedEvent_PS_NvMBlock_ConfigID_ReadBlock: RteEventRef=OperationInvokedEvent_PS_NvMBlock_ConfigID_ReadBlock
          RteEventToTaskMapping_OperationInvokedEvent_PS_NvMBlock_ConfigID_RestoreBlockDefaults: RteEventRef=OperationInvokedEvent_PS_NvMBlock_ConfigID_RestoreBlockDefaults
          RteEventToTaskMapping_OperationInvokedEvent_PS_NvMBlock_ConfigID_WriteBlock: RteEventRef=OperationInvokedEvent_PS_NvMBlock_ConfigID_WriteBlock
          RteEventToTaskMapping_OperationInvokedEvent_PS_NvMBlock_DemNonVolatileData_CancelJobs: RteEventRef=OperationInvokedEvent_PS_NvMBlock_DemNonVolatileData_CancelJobs
          RteEventToTaskMapping_OperationInvokedEvent_PS_NvMBlock_DemNonVolatileData_EraseNvBlock: RteEventRef=OperationInvokedEvent_PS_NvMBlock_DemNonVolatileData_EraseNvBlock
          RteEventToTaskMapping_OperationInvokedEvent_PS_NvMBlock_DemNonVolatileData_GetErrorStatus: RteEventRef=OperationInvokedEvent_PS_NvMBlock_DemNonVolatileData_GetErrorStatus
          RteEventToTaskMapping_OperationInvokedEvent_PS_NvMBlock_DemNonVolatileData_InvalidateNvBlock: RteEventRef=OperationInvokedEvent_PS_NvMBlock_DemNonVolatileData_InvalidateNvBlock
          RteEventToTaskMapping_OperationInvokedEvent_PS_NvMBlock_DemNonVolatileData_ReadBlock: RteEventRef=OperationInvokedEvent_PS_NvMBlock_DemNonVolatileData_ReadBlock
          RteEventToTaskMapping_OperationInvokedEvent_PS_NvMBlock_DemNonVolatileData_RestoreBlockDefaults: RteEventRef=OperationInvokedEvent_PS_NvMBlock_DemNonVolatileData_RestoreBlockDefaults
          RteEventToTaskMapping_OperationInvokedEvent_PS_NvMBlock_DemNonVolatileData_WriteBlock: RteEventRef=OperationInvokedEvent_PS_NvMBlock_DemNonVolatileData_WriteBlock
          RteEventToTaskMapping_OperationInvokedEvent_PS_NvMBlock_DemPrimaryEventMemoryEntry_0_CancelJobs: RteEventRef=OperationInvokedEvent_PS_NvMBlock_DemPrimaryEventMemory_0_CancelJobs
          RteEventToTaskMapping_OperationInvokedEvent_PS_NvMBlock_DemPrimaryEventMemoryEntry_0_EraseNvBlock: RteEventRef=OperationInvokedEvent_PS_NvMBlock_DemPrimaryEventMemory_0_EraseNvBlock
          RteEventToTaskMapping_OperationInvokedEvent_PS_NvMBlock_DemPrimaryEventMemoryEntry_0_GetErrorStatus: RteEventRef=OperationInvokedEvent_PS_NvMBlock_DemPrimaryEventMemory_0_GetErrorStatus
          RteEventToTaskMapping_OperationInvokedEvent_PS_NvMBlock_DemPrimaryEventMemoryEntry_0_InvalidateNvBlock: RteEventRef=OperationInvokedEvent_PS_NvMBlock_DemPrimaryEventMemory_0_InvalidateNvBlock
          RteEventToTaskMapping_OperationInvokedEvent_PS_NvMBlock_DemPrimaryEventMemoryEntry_0_ReadBlock: RteEventRef=OperationInvokedEvent_PS_NvMBlock_DemPrimaryEventMemory_0_ReadBlock
          RteEventToTaskMapping_OperationInvokedEvent_PS_NvMBlock_DemPrimaryEventMemoryEntry_0_RestoreBlockDefaults: RteEventRef=OperationInvokedEvent_PS_NvMBlock_DemPrimaryEventMemory_0_RestoreBlockDefaults
          RteEventToTaskMapping_OperationInvokedEvent_PS_NvMBlock_DemPrimaryEventMemoryEntry_0_WriteBlock: RteEventRef=OperationInvokedEvent_PS_NvMBlock_DemPrimaryEventMemory_0_WriteBlock
          RteEventToTaskMapping_OperationInvokedEvent_PS_NvMBlock_DemPrimaryEventMemoryEntry_1_CancelJobs: RteEventRef=OperationInvokedEvent_PS_NvMBlock_DemPrimaryEventMemory_1_CancelJobs
          RteEventToTaskMapping_OperationInvokedEvent_PS_NvMBlock_DemPrimaryEventMemoryEntry_1_EraseNvBlock: RteEventRef=OperationInvokedEvent_PS_NvMBlock_DemPrimaryEventMemory_1_EraseNvBlock
          RteEventToTaskMapping_OperationInvokedEvent_PS_NvMBlock_DemPrimaryEventMemoryEntry_1_GetErrorStatus: RteEventRef=OperationInvokedEvent_PS_NvMBlock_DemPrimaryEventMemory_1_GetErrorStatus
          RteEventToTaskMapping_OperationInvokedEvent_PS_NvMBlock_DemPrimaryEventMemoryEntry_1_InvalidateNvBlock: RteEventRef=OperationInvokedEvent_PS_NvMBlock_DemPrimaryEventMemory_1_InvalidateNvBlock
          RteEventToTaskMapping_OperationInvokedEvent_PS_NvMBlock_DemPrimaryEventMemoryEntry_1_ReadBlock: RteEventRef=OperationInvokedEvent_PS_NvMBlock_DemPrimaryEventMemory_1_ReadBlock
          RteEventToTaskMapping_OperationInvokedEvent_PS_NvMBlock_DemPrimaryEventMemoryEntry_1_RestoreBlockDefaults: RteEventRef=OperationInvokedEvent_PS_NvMBlock_DemPrimaryEventMemory_1_RestoreBlockDefaults
          RteEventToTaskMapping_OperationInvokedEvent_PS_NvMBlock_DemPrimaryEventMemoryEntry_1_WriteBlock: RteEventRef=OperationInvokedEvent_PS_NvMBlock_DemPrimaryEventMemory_1_WriteBlock
          RteEventToTaskMapping_OperationInvokedEvent_PS_NvMBlock_DemPrimaryEventMemoryEntry_2_CancelJobs: RteEventRef=OperationInvokedEvent_PS_NvMBlock_DemPrimaryEventMemory_2_CancelJobs
          RteEventToTaskMapping_OperationInvokedEvent_PS_NvMBlock_DemPrimaryEventMemoryEntry_2_EraseNvBlock: RteEventRef=OperationInvokedEvent_PS_NvMBlock_DemPrimaryEventMemory_2_EraseNvBlock
          RteEventToTaskMapping_OperationInvokedEvent_PS_NvMBlock_DemPrimaryEventMemoryEntry_2_GetErrorStatus: RteEventRef=OperationInvokedEvent_PS_NvMBlock_DemPrimaryEventMemory_2_GetErrorStatus
          RteEventToTaskMapping_OperationInvokedEvent_PS_NvMBlock_DemPrimaryEventMemoryEntry_2_InvalidateNvBlock: RteEventRef=OperationInvokedEvent_PS_NvMBlock_DemPrimaryEventMemory_2_InvalidateNvBlock
          RteEventToTaskMapping_OperationInvokedEvent_PS_NvMBlock_DemPrimaryEventMemoryEntry_2_ReadBlock: RteEventRef=OperationInvokedEvent_PS_NvMBlock_DemPrimaryEventMemory_2_ReadBlock
          RteEventToTaskMapping_OperationInvokedEvent_PS_NvMBlock_DemPrimaryEventMemoryEntry_2_RestoreBlockDefaults: RteEventRef=OperationInvokedEvent_PS_NvMBlock_DemPrimaryEventMemory_2_RestoreBlockDefaults
          RteEventToTaskMapping_OperationInvokedEvent_PS_NvMBlock_DemPrimaryEventMemoryEntry_2_WriteBlock: RteEventRef=OperationInvokedEvent_PS_NvMBlock_DemPrimaryEventMemory_2_WriteBlock
          RteEventToTaskMapping_OperationInvokedEvent_PS_NvMBlock_IntTst_TestBlock1_CancelJobs: RteEventRef=OperationInvokedEvent_PS_NvMBlock_IntTst_TestBlock1_CancelJobs
          RteEventToTaskMapping_OperationInvokedEvent_PS_NvMBlock_IntTst_TestBlock1_EraseNvBlock: RteEventRef=OperationInvokedEvent_PS_NvMBlock_IntTst_TestBlock1_EraseNvBlock
          RteEventToTaskMapping_OperationInvokedEvent_PS_NvMBlock_IntTst_TestBlock1_GetErrorStatus: RteEventRef=OperationInvokedEvent_PS_NvMBlock_IntTst_TestBlock1_GetErrorStatus
          RteEventToTaskMapping_OperationInvokedEvent_PS_NvMBlock_IntTst_TestBlock1_InvalidateNvBlock: RteEventRef=OperationInvokedEvent_PS_NvMBlock_IntTst_TestBlock1_InvalidateNvBlock
          RteEventToTaskMapping_OperationInvokedEvent_PS_NvMBlock_IntTst_TestBlock1_ReadBlock: RteEventRef=OperationInvokedEvent_PS_NvMBlock_IntTst_TestBlock1_ReadBlock
          RteEventToTaskMapping_OperationInvokedEvent_PS_NvMBlock_IntTst_TestBlock1_RestoreBlockDefaults: RteEventRef=OperationInvokedEvent_PS_NvMBlock_IntTst_TestBlock1_RestoreBlockDefaults
          RteEventToTaskMapping_OperationInvokedEvent_PS_NvMBlock_IntTst_TestBlock1_WriteBlock: RteEventRef=OperationInvokedEvent_PS_NvMBlock_IntTst_TestBlock1_WriteBlock
          RteEventToTaskMapping_OperationInvokedEvent_PS_NvMBlock_IntTst_TestBlock2_CancelJobs: RteEventRef=OperationInvokedEvent_PS_NvMBlock_IntTst_TestBlock2_CancelJobs
          RteEventToTaskMapping_OperationInvokedEvent_PS_NvMBlock_IntTst_TestBlock2_EraseNvBlock: RteEventRef=OperationInvokedEvent_PS_NvMBlock_IntTst_TestBlock2_EraseNvBlock
          RteEventToTaskMapping_OperationInvokedEvent_PS_NvMBlock_IntTst_TestBlock2_GetErrorStatus: RteEventRef=OperationInvokedEvent_PS_NvMBlock_IntTst_TestBlock2_GetErrorStatus
          RteEventToTaskMapping_OperationInvokedEvent_PS_NvMBlock_IntTst_TestBlock2_InvalidateNvBlock: RteEventRef=OperationInvokedEvent_PS_NvMBlock_IntTst_TestBlock2_InvalidateNvBlock
          RteEventToTaskMapping_OperationInvokedEvent_PS_NvMBlock_IntTst_TestBlock2_ReadBlock: RteEventRef=OperationInvokedEvent_PS_NvMBlock_IntTst_TestBlock2_ReadBlock
          RteEventToTaskMapping_OperationInvokedEvent_PS_NvMBlock_IntTst_TestBlock2_RestoreBlockDefaults: RteEventRef=OperationInvokedEvent_PS_NvMBlock_IntTst_TestBlock2_RestoreBlockDefaults
          RteEventToTaskMapping_OperationInvokedEvent_PS_NvMBlock_IntTst_TestBlock2_WriteBlock: RteEventRef=OperationInvokedEvent_PS_NvMBlock_IntTst_TestBlock2_WriteBlock
          RteEventToTaskMapping_OperationInvokedEvent_PS_NvMBlock_IntTst_TestBlock3_CancelJobs: RteEventRef=OperationInvokedEvent_PS_NvMBlock_IntTst_TestBlock3_CancelJobs
          RteEventToTaskMapping_OperationInvokedEvent_PS_NvMBlock_IntTst_TestBlock3_EraseNvBlock: RteEventRef=OperationInvokedEvent_PS_NvMBlock_IntTst_TestBlock3_EraseNvBlock
          RteEventToTaskMapping_OperationInvokedEvent_PS_NvMBlock_IntTst_TestBlock3_GetErrorStatus: RteEventRef=OperationInvokedEvent_PS_NvMBlock_IntTst_TestBlock3_GetErrorStatus
          RteEventToTaskMapping_OperationInvokedEvent_PS_NvMBlock_IntTst_TestBlock3_InvalidateNvBlock: RteEventRef=OperationInvokedEvent_PS_NvMBlock_IntTst_TestBlock3_InvalidateNvBlock
          RteEventToTaskMapping_OperationInvokedEvent_PS_NvMBlock_IntTst_TestBlock3_ReadBlock: RteEventRef=OperationInvokedEvent_PS_NvMBlock_IntTst_TestBlock3_ReadBlock
          RteEventToTaskMapping_OperationInvokedEvent_PS_NvMBlock_IntTst_TestBlock3_RestoreBlockDefaults: RteEventRef=OperationInvokedEvent_PS_NvMBlock_IntTst_TestBlock3_RestoreBlockDefaults
          RteEventToTaskMapping_OperationInvokedEvent_PS_NvMBlock_IntTst_TestBlock3_WriteBlock: RteEventRef=OperationInvokedEvent_PS_NvMBlock_IntTst_TestBlock3_WriteBlock
          RteEventToTaskMapping_OperationInvokedEvent_PS_NvMBlock_DemEventStatusNvRamBlock_InvalidateNvBlock: RteEventRef=OperationInvokedEvent_PS_NvMBlock_DemEventStatusNvRamBlock_InvalidateNvBlock
          RteEventToTaskMapping_OperationInvokedEvent_PS_NvMBlock_DemEventStatusNvRamBlock_EraseNvBlock: RteEventRef=OperationInvokedEvent_PS_NvMBlock_DemEventStatusNvRamBlock_EraseNvBlock
          RteEventToTaskMapping_OperationInvokedEvent_PS_NvMBlock_DemEventStatusNvRamBlock_RestoreBlockDefaults: RteEventRef=OperationInvokedEvent_PS_NvMBlock_DemEventStatusNvRamBlock_RestoreBlockDefaults
          RteEventToTaskMapping_OperationInvokedEvent_PS_NvMBlock_DemEventStatusNvRamBlock_CancelJobs: RteEventRef=OperationInvokedEvent_PS_NvMBlock_DemEventStatusNvRamBlock_CancelJobs
          RteEventToTaskMapping_OperationInvokedEvent_PS_NvMBlock_DemEventStatusNvRamBlock_GetErrorStatus: RteEventRef=OperationInvokedEvent_PS_NvMBlock_DemEventStatusNvRamBlock_GetErrorStatus
          RteEventToTaskMapping_OperationInvokedEvent_PS_NvMBlock_DemEventStatusNvRamBlock_WriteBlock: RteEventRef=OperationInvokedEvent_PS_NvMBlock_DemEventStatusNvRamBlock_WriteBlock
          RteEventToTaskMapping_OperationInvokedEvent_PS_NvMBlock_DemEventStatusNvRamBlock_ReadBlock: RteEventRef=OperationInvokedEvent_PS_NvMBlock_DemEventStatusNvRamBlock_ReadBlock
      SwcInstance_WdgM: RteSoftwareComponentInstanceRef=WdgM
        10 x RteEventToTaskMapping, all with category=TOOL_CONFIGURED, RteImmediateRestart=0:
          RteEventToTaskMapping0: RteEventRef=OperationInvokedEvent_GetLocalStatus
          RteEventToTaskMapping1: RteEventRef=OperationInvokedEvent_alive_SE_WdgMTest_UpdateAliveCounter
          RteEventToTaskMapping2: RteEventRef=OperationInvokedEvent_GetGlobalStatus
          RteEventToTaskMapping3: RteEventRef=OperationInvokedEvent_GetFirstExpiredSEID
          RteEventToTaskMapping4: RteEventRef=OperationInvokedEvent_alive_SE_WdgMTest_CheckpointReached
          RteEventToTaskMapping5: RteEventRef=OperationInvokedEvent_alive_SE_Init_UpdateAliveCounter
          RteEventToTaskMapping6: RteEventRef=OperationInvokedEvent_alive_SE_Init_CheckpointReached
          RteEventToTaskMapping7: RteEventRef=OperationInvokedEvent_GetMode
          RteEventToTaskMapping_OIE_PerformReset: RtePositionInTask=1, RteEventRef=OperationInvokedEvent_PerformReset, RteMappedToTaskRef=OsTask_BSW_FG2_WdgMAPI
          RteEventToTaskMapping_OIE_SetMode: RtePositionInTask=0, RteEventRef=OperationInvokedEvent_SetMode, RteMappedToTaskRef=OsTask_BSW_FG2_WdgMAPI
      SwcInstance_SWC_Actuator: RteSoftwareComponentInstanceRef=SWC_Actuator
        RteEventToTaskMapping0 (RteEventToTaskMapping):
          category = TOOL_CONFIGURED
          RtePositionInTask = 4
          RteImmediateRestart = 0
          RteEventRef = TE_Run_Actuator
          RteMappedToTaskRef = OsTask_ASW_FG1_10ms
          RteUsedOsAlarmRef = OsAlarm_ASW_10ms
      SwcInstance_SWC_ComM: RteSoftwareComponentInstanceRef=SWC_ComM
      SwcInstance_DiagnosticTest: RteSoftwareComponentInstanceRef=SWC_DiagnosticMonitor
        5 x RteEventToTaskMapping, all with category=TOOL_CONFIGURED, RteImmediateRestart=0:
          RteEventToTaskMapping0: RtePositionInTask=1, RteEventRef=TimingEvent_DiagnosticMonitor, RteMappedToTaskRef=OsTask_ASW_FG1_10ms, RteUsedOsAlarmRef=OsAlarm_ASW_10ms
          RteEventToTaskMapping1: RteEventRef=OIE_CBStatusEvt_DEM_E_TEST_EVENT
          RteEventToTaskMapping2: RteEventRef=OIE_CBReadData_DE_0002
          RteEventToTaskMapping3: RteEventRef=OIE_CBReadData_DE_0001
          RteEventToTaskMapping4: RteEventRef=OIE_InitMonitorForEvent
      SwcInstance_SWC_DiagnosticService: RteSoftwareComponentInstanceRef=SWC_DiagnosticService
        46 x RteEventToTaskMapping, all with category=TOOL_CONFIGURED, RteImmediateRestart=0:
          RteEventToTaskMapping_OIE_ActuatorControl_ConditionCheckRead: RteEventRef=OIE_ActuatorControl_ConditionCheckRead
          RteEventToTaskMapping_OIE_ActuatorControl_FreezeCurrentState: RteEventRef=OIE_ActuatorControl_FreezeCurrentState
          RteEventToTaskMapping_OIE_ActuatorControl_ReadData: RteEventRef=OIE_ActuatorControl_ReadData
          RteEventToTaskMapping_OIE_ActuatorControl_ResetToDefault: RteEventRef=OIE_ActuatorControl_ResetToDefault
          RteEventToTaskMapping_OIE_ActuatorControl_ReturnControlToECU: RteEventRef=OIE_ActuatorControl_ReturnControlToECU
          RteEventToTaskMapping_OIE_ActuatorControl_ShortTermAdjustment: RteEventRef=OIE_ActuatorControl_ShortTermAdjustment
          RteEventToTaskMapping_OIE_ActuatorControl_WriteData: RteEventRef=OIE_ActuatorControl_WriteData
          RteEventToTaskMapping_OIE_BatVolt_ConditionCheckRead: RteEventRef=OIE_BatVolt_ConditionCheckRead
          RteEventToTaskMapping_OIE_BatVolt_ReadData: RteEventRef=OIE_BatVolt_ReadData
          RteEventToTaskMapping_OIE_BatVolt_WriteData: RteEventRef=OIE_BatVolt_WriteData
          RteEventToTaskMapping_OIE_CallbackDCMRequestServices_StartProtocol: RteEventRef=OIE_CallbackDCMRequestServices_StartProtocol
          RteEventToTaskMapping_OIE_CallbackDCMRequestServices_StopProtocol: RteEventRef=OIE_CallbackDCMRequestServices_StopProtocol
          RteEventToTaskMapping_OIE_DID_0100h_0110h_IsDidAvailable: RteEventRef=OIE_DID_0100h_0110h_IsDidAvailable
          RteEventToTaskMapping_OIE_DID_0100h_0110h_ReadDidData: RteEventRef=OIE_DID_0100h_0110h_ReadDidData
          RteEventToTaskMapping_OIE_DID_0100h_0110h_WriteDidData: RteEventRef=OIE_DID_0100h_0110h_WriteDidData
          RteEventToTaskMapping_OIE_ECT_ConditionCheckRead: RteEventRef=OIE_ECT_ConditionCheckRead
          RteEventToTaskMapping_OIE_ECT_ReadData: RteEventRef=OIE_ECT_ReadData
          RteEventToTaskMapping_OIE_ECT_WriteData: RteEventRef=OIE_ECT_WriteData
          RteEventToTaskMapping_OIE_L1_CompareKey: RteEventRef=OIE_L1_CompareKey
          RteEventToTaskMapping_OIE_L1_GetSeed: RteEventRef=OIE_L1_GetSeed
          RteEventToTaskMapping_OIE_RID_0200h_CalibrationActuator_RequestResults: RteEventRef=OIE_RID_0200h_CalibrationActuator_RequestResults
          RteEventToTaskMapping_OIE_RID_0200h_CalibrationActuator_Start: RteEventRef=OIE_RID_0200h_CalibrationActuator_Start
          RteEventToTaskMapping_OIE_RID_0200h_CalibrationActuator_Stop: RteEventRef=OIE_RID_0200h_CalibrationActuator_Stop
          RteEventToTaskMapping_OIE_RPM_ConditionCheckRead: RteEventRef=OIE_RPM_ConditionCheckRead
          RteEventToTaskMapping_OIE_RPM_FreezeCurrentState: RteEventRef=OIE_RPM_FreezeCurrentState
          RteEventToTaskMapping_OIE_RPM_ReadData: RteEventRef=OIE_RPM_ReadData
          RteEventToTaskMapping_OIE_RPM_ReturnControlToECU: RteEventRef=OIE_RPM_ReturnControlToECU
          RteEventToTaskMapping_OIE_RPM_ShortTermAdjustment: RteEventRef=OIE_RPM_ShortTermAdjustment
          RteEventToTaskMapping_OIE_RPM_WriteData: RteEventRef=OIE_RPM_WriteData
          RteEventToTaskMapping_OIE_ServiceRequestSupplierNotification_Confirmation: RteEventRef=OIE_ServiceRequestSupplierNotification_Confirmation
          RteEventToTaskMapping_OIE_ServiceRequestSupplierNotification_Indication: RteEventRef=OIE_ServiceRequestSupplierNotification_Indication
          RteEventToTaskMapping_OIE_SystemSupplierECUHardwareVersionNumber_ConditionCheckRead: RteEventRef=OIE_SystemSupplierECUHardwareVersionNumber_ConditionCheckRead
          RteEventToTaskMapping_OIE_SystemSupplierECUHardwareVersionNumber_ReadData: RteEventRef=OIE_SystemSupplierECUHardwareVersionNumber_ReadData
          RteEventToTaskMapping_OIE_SystemSupplierECUSoftwareNumber_ConditionCheckRead: RteEventRef=OIE_SystemSupplierECUSoftwareNumber_ConditionCheckRead
          RteEventToTaskMapping_OIE_SystemSupplierECUSoftwareNumber_ReadData: RteEventRef=OIE_SystemSupplierECUSoftwareNumber_ReadData
          RteEventToTaskMapping_OIE_VINDataIdentifier_ConditionCheckRead: RteEventRef=OIE_VINDataIdentifier_ConditionCheckRead
          RteEventToTaskMapping_OIE_VINDataIdentifier_GetScalingInformation: RteEventRef=OIE_VINDataIdentifier_GetScalingInformation
          RteEventToTaskMapping_OIE_VINDataIdentifier_ReadData: RteEventRef=OIE_VINDataIdentifier_ReadData
          RteEventToTaskMapping_OIE_VINDataIdentifier_WriteData: RteEventRef=OIE_VINDataIdentifier_WriteData
          RteEventToTaskMapping_OIE_VehicleManufacturerECUSoftwareVersionNumber_ConditionCheckRead: RteEventRef=OIE_VehicleManufacturerECUSoftwareVersionNumber_ConditionCheckRead
          RteEventToTaskMapping_OIE_VehicleManufacturerECUSoftwareVersionNumber_ReadData: RteEventRef=OIE_VehicleManufacturerECUSoftwareVersionNumber_ReadData
          RteEventToTaskMapping_OIE_VehicleSpeed_ConditionCheckRead: RteEventRef=OIE_VehicleSpeed_ConditionCheckRead
          RteEventToTaskMapping_OIE_VehicleSpeed_GetScalingInformation: RteEventRef=OIE_VehicleSpeed_GetScalingInformation
          RteEventToTaskMapping_OIE_VehicleSpeed_ReadData: RteEventRef=OIE_VehicleSpeed_ReadData
          RteEventToTaskMapping_SMSE_Entry_DiagnosticSessionControlNotification_modeNotificationPort_SessionControl_DcmDiagnosticSessionControl_DCM_EXTENDED_DIAGNOSTIC_SESSION: RteEventRef=SMSE_Entry_DiagnosticSessionControlNotification_modeNotificationPort_SessionControl_DcmDiagnosticSessionControl_DCM_EXTENDED_DIAGNOSTIC_SESSION
          RteEventToTaskMapping_SMSE_Entry_DiagnosticSessionControlNotification_modeNotificationPort_SessionControl_DcmDiagnosticSessionControl_DCM_DEFAULT_SESSION: RteEventRef=SMSE_Entry_DiagnosticSessionControlNotification_modeNotificationPort_SessionControl_DcmDiagnosticSessionControl_DCM_DEFAULT_SESSION
      SwcInstance_SWC_ErrM: RteSoftwareComponentInstanceRef=SWC_ErrM
        RteEventToTaskMapping_OIE_GeneralCallbackEventStatusChange (RteEventToTaskMapping): category=TOOL_CONFIGURED, RteImmediateRestart=0, RteEventRef=OIE_GeneralCallbackEventStatusChange
      SwcInstance_SWC_FiM: RteSoftwareComponentInstanceRef=FiM
        RteEventToTaskMapping_OIE_GetFunctionPermission_FiMFID_0 (RteEventToTaskMapping): category=TOOL_CONFIGURED, RteImmediateRestart=0, RteEventRef=OIE_GetFunctionPermission_FiMFID_0
        RteEventToTaskMapping_OIE_GetFunctionPermission_FiMFID_1 (RteEventToTaskMapping): category=TOOL_CONFIGURED, RteImmediateRestart=0, RteEventRef=OIE_GetFunctionPermission_FiMFID_1
      SwcInstance_WdgMTest: RteSoftwareComponentInstanceRef=SWC_WdgMTest
        5 x RteEventToTaskMapping, all with category=TOOL_CONFIGURED, RteImmediateRestart=0:
          RteEventToTaskMapping_SMSE_globalMode_EXPIRED: RtePositionInTask=2, RteEventRef=SwcModeSwitchEvent_globalMode_EXPIRED, RteMappedToTaskRef=OsTask_ASW_FG2_WdgMTestMode
          RteEventToTaskMapping_SMSE_globalMode_FAILED: RtePositionInTask=1, RteEventRef=SwcModeSwitchEvent_globalMode_FAILED, RteMappedToTaskRef=OsTask_ASW_FG2_WdgMTestMode
          RteEventToTaskMapping_SMSE_globalMode_OK: RtePositionInTask=0, RteEventRef=SwcModeSwitchEvent_globalMode_OK, RteMappedToTaskRef=OsTask_ASW_FG2_WdgMTestMode
          RteEventToTaskMapping_SMSE_globalMode_STOPPED: RtePositionInTask=3, RteEventRef=SwcModeSwitchEvent_globalMode_STOPPED, RteMappedToTaskRef=OsTask_ASW_FG2_WdgMTestMode
          RteEventToTaskMapping_TE_WdgMTest: RtePositionInTask=2, RteEventRef=TE_WdgMTest, RteMappedToTaskRef=OsTask_ASW_FG1_10ms, RteUsedOsAlarmRef=OsAlarm_ASW_10ms
    16 x RteSwComponentType:
      RteSwComponentType_BswM: RteComponentTypeRef=BswM
        RteComponentTypeCalibration: category=TOOL_CONFIGURED, RteCalibrationSupportEnabled=0
      RteSwComponentType_ComM: RteComponentTypeRef=ComM
        RteComponentTypeCalibration: category=TOOL_CONFIGURED, RteCalibrationSupportEnabled=0
      RteSwComponentType_Dcm: RteComponentTypeRef=Dcm
        RteComponentTypeCalibration: category=TOOL_CONFIGURED, RteCalibrationSupportEnabled=0
      RteSwComponentType_Dem: RteComponentTypeRef=Dem
        RteComponentTypeCalibration: category=TOOL_CONFIGURED, RteCalibrationSupportEnabled=0
      RteSwComponentType_Det: RteComponentTypeRef=Det
        RteComponentTypeCalibration: category=TOOL_CONFIGURED, RteCalibrationSupportEnabled=0
      RteSwComponentType_EcuM: RteComponentTypeRef=EcuM
        RteComponentTypeCalibration: category=TOOL_CONFIGURED, RteCalibrationSupportEnabled=0
      RteSwComponentType_FiM: RteComponentTypeRef=FiM
        RteComponentTypeCalibration: category=TOOL_CONFIGURED, RteCalibrationSupportEnabled=0
      RteSwComponentType_IoHwAb: RteComponentTypeRef=IoHwAb
        RteComponentTypeCalibration: category=TOOL_CONFIGURED, RteCalibrationSupportEnabled=0
      RteSwComponentType_NvM: RteComponentTypeRef=NvM
        RteComponentTypeCalibration: category=TOOL_CONFIGURED, RteCalibrationSupportEnabled=0
      RteSwComponentType_WdgM: RteComponentTypeRef=WdgM
        RteComponentTypeCalibration: category=TOOL_CONFIGURED, RteCalibrationSupportEnabled=0
      RteSwComponentType_SWC_Actuator: RteComponentTypeRef=SWC_Actuator
        RteComponentTypeCalibration: category=TOOL_CONFIGURED, RteCalibrationSupportEnabled=0
      RteSwComponentType_SWC_ComM: RteComponentTypeRef=SWC_ComM
        RteComponentTypeCalibration: category=TOOL_CONFIGURED, RteCalibrationSupportEnabled=0
      RteSwComponentType_SWC_DiagnosticMonitor: RteComponentTypeRef=SWC_DiagnosticMonitor
        RteComponentTypeCalibration: category=TOOL_CONFIGURED, RteCalibrationSupportEnabled=0
      RteSwComponentType_SWC_DiagnosticService: RteComponentTypeRef=SWC_DiagnosticService
        RteComponentTypeCalibration: category=TOOL_CONFIGURED, RteCalibrationSupportEnabled=0
      RteSwComponentType_SWC_ErrM: RteComponentTypeRef=SWC_ErrM
        RteComponentTypeCalibration: category=TOOL_CONFIGURED, RteCalibrationSupportEnabled=0
      RteSwComponentType_SWC_WdgMTest: RteComponentTypeRef=SWC_WdgMTest
        RteComponentTypeCalibration: category=TOOL_CONFIGURED, RteCalibrationSupportEnabled=0
    RteInitializationBehavior0 (RteInitializationBehavior): RteSectionInitializationPolicy=INIT, RteInitializationStrategy=
    SwcInstance_SWC_AppMode (RteSwComponentInstance): category=TOOL_CONFIGURED, RteSoftwareComponentInstanceRef=SWC_AppMode
      8 x RteEventToTaskMapping, all with category=TOOL_CONFIGURED, RteImmediateRestart=false:
        RteEventToTaskMapping_TE_AppMode_Test: RtePositionInTask=0, RteEventRef=TE_AppMode_Test, RteMappedToTaskRef=OsTask_ASW_FG1_100ms, RteUsedOsAlarmRef=OsAlarm_ASW_100ms
        RteEventToTaskMapping_SMSE_Entry_EcuModeSwitched_modeNotificationPort_EcuMode_EcuMode_ECUM_STATE_PREP_SHUTDOWN: RteEventRef=SMSE_Entry_EcuModeSwitched_modeNotificationPort_EcuMode_EcuMode_ECUM_STATE_PREP_SHUTDOWN
        RteEventToTaskMapping_SMSE_Entry_EcuModeSwitched_modeNotificationPort_EcuMode_EcuMode_ECUM_STATE_RUN: RteEventRef=SMSE_Entry_EcuModeSwitched_modeNotificationPort_EcuMode_EcuMode_ECUM_STATE_RUN
        RteEventToTaskMapping_SMSE_Entry_EcuModeSwitched_modeNotificationPort_EcuMode_EcuMode_ECUM_STATE_SHUTDOWN: RteEventRef=SMSE_Entry_EcuModeSwitched_modeNotificationPort_EcuMode_EcuMode_ECUM_STATE_SHUTDOWN
        RteEventToTaskMapping_SMSE_Entry_EcuModeSwitched_modeNotificationPort_EcuMode_EcuMode_ECUM_STATE_SLEEP: RteEventRef=SMSE_Entry_EcuModeSwitched_modeNotificationPort_EcuMode_EcuMode_ECUM_STATE_SLEEP
        RteEventToTaskMapping_SMSE_Entry_InitCompleted_modeNotificationPort_InitState_InitState_COMPLETE: RteEventRef=SMSE_Entry_InitCompleted_modeNotificationPort_InitState_InitState_COMPLETE
        RteEventToTaskMapping_SMSE_Entry_PduGroupSwitched_modeNotificationPort_PduGroupTx_Project_PduGroupTx_Project_START: RteEventRef=SMSE_Entry_PduGroupSwitched_modeNotificationPort_PduGroupTx_Project_PduGroupTx_Project_START
        RteEventToTaskMapping_SMSE_Entry_PduGroupSwitched_modeNotificationPort_PduGroupTx_Project_PduGroupTx_Project_STOP: RteEventRef=SMSE_Entry_PduGroupSwitched_modeNotificationPort_PduGroupTx_Project_PduGroupTx_Project_STOP
    RteSwComponentType_SWC_AppMode (RteSwComponentType): RteComponentTypeRef=SWC_AppMode
      RteComponentTypeCalibration: category=TOOL_CONFIGURED, RteCalibrationSupportEnabled=0
    SwcInstance_SWC_TestModeManager (RteSwComponentInstance): category=TOOL_CONFIGURED, RteSoftwareComponentInstanceRef=SWC_TestModeManager
      RteEventToTaskMapping_DRE_TestModeManager_TestModeRequestInterface_TestMode (RteEventToTaskMapping):
        category = TOOL_CONFIGURED
        RteImmediateRestart = false
        RtePositionInTask = 0
        RteEventRef = DRE_TestModeManager_TestModeRequestInterface_TestMode
        RteMappedToTaskRef = OsTask_ASW_TestModeManager
        RteUsedOsAlarmRef = (unset)
    RteSwComponentType_SWC_TestModeManager (RteSwComponentType): RteComponentTypeRef=SWC_TestModeManager
      RteComponentTypeCalibration: category=TOOL_CONFIGURED, RteCalibrationSupportEnabled=0
    SwcInstance_SWC_TestModeUser (RteSwComponentInstance): category=TOOL_CONFIGURED, RteSoftwareComponentInstanceRef=SWC_TestModeUser
      RteEventToTaskMapping_TE_TestModeUser_B (RteEventToTaskMapping):
        category = TOOL_CONFIGURED
        RteImmediateRestart = false
        RtePositionInTask = 5
        RteEventRef = TE_TestModeUser_B
        RteMappedToTaskRef = OsTask_ASW_FG1_10ms
        RteUsedOsAlarmRef = OsAlarm_ASW_10ms
    RteSwComponentType_SWC_TestModeUser (RteSwComponentType): RteComponentTypeRef=SWC_TestModeUser
      RteComponentTypeCalibration: category=TOOL_CONFIGURED, RteCalibrationSupportEnabled=0
    SwcInstance_SWC_IoHwAbTest (RteSwComponentInstance): category=TOOL_CONFIGURED, RteSoftwareComponentInstanceRef=SWC_IoHwAbTest
      RteEventToTaskMapping_TE_IoHwAbTest (RteEventToTaskMapping):
        category = TOOL_CONFIGURED
        RteImmediateRestart = false
        RtePositionInTask = 3
        RteEventRef = TE_IoHwAbTest
        RteMappedToTaskRef = OsTask_ASW_FG1_10ms
        RteUsedOsAlarmRef = OsAlarm_ASW_10ms
      RteEventToTaskMapping_OIE_RE_IoHwAbTest_EMIOS4_GptCbk_RE_IoHwAbTest_EMIOS4_GptCbk_Notification (RteEventToTaskMapping): category=TOOL_CONFIGURED, RteImmediateRestart=false, RteEventRef=OIE_RE_IoHwAbTest_EMIOS4_GptCbk_RE_IoHwAbTest_EMIOS4_GptCbk_Notification
    RteSwComponentType_SWC_IoHwAbTest (RteSwComponentType): RteComponentTypeRef=SWC_IoHwAbTest
      RteComponentTypeCalibration: category=TOOL_CONFIGURED, RteCalibrationSupportEnabled=0
