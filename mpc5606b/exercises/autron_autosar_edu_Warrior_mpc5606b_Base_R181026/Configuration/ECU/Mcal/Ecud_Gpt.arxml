AUTOSAR XML (schema 4-0-3)
package /Gpt
  module config Gpt: implementation-config-variant=VARIANT-POST-BUILD, module-description=BswImplementation_Gpt
    GptChannelConfigSet: GptSTMChannelPrescale_Alternate=63
      5 x GptChannelConfiguration, all with GptChannelPrescale_Alternate=1, GptFreezeEnable=1, GptEnableWakeup=0:
        GptChannelConfiguration_Wdg: GptChannelId=0, GptHwChannel=PIT_CH_1, GptChannelMode=GPT_CH_MODE_CONTINUOUS, GptChannelTickFrequency=1.0E6, GptChannelTickValueMax=4294967296, GptNotification=Wdg_Cbk_GptNotification0, GptChannelClkSrcRef=GptClockReferencePoint_SystemClockFrequency
        GptChannelConfiguration_IoHwAbTest: GptChannelId=1, GptHwChannel=EMIOS_0_CH_3, GptChannelMode=GPT_CH_MODE_CONTINUOUS, GptChannelTickFrequency=1.0E6, GptChannelTickValueMax=4294967296, GptNotification=GptChannelConfiguration_Dummy_Cbk, GptChannelClkSrcRef=GptClockReferencePoint_IoHwAbTest
        GptChannelConfiguration_STM: GptChannelId=2, GptHwChannel=STM_0_CH_0, GptChannelMode=GPT_CH_MODE_ONESHOT, GptChannelTickFrequency=1000000.0, GptChannelTickValueMax=4294967296, GptChannelClkSrcRef=GptClockReferencePoint_SystemClockFrequency
        GptChannelConfiguration_Memory: GptChannelId=3, GptHwChannel=PIT_CH_3, GptChannelMode=GPT_CH_MODE_ONESHOT, GptChannelTickFrequency=1.0E6, GptChannelTickValueMax=4294967296, GptNotification=NvM_Call_NvM_BITP_MainFunction, GptChannelClkSrcRef=GptClockReferencePoint_SystemClockFrequency
        GptChannelConfiguration_EMIOS4: GptChannelId=4, GptHwChannel=EMIOS_0_CH_4, GptChannelMode=GPT_CH_MODE_ONESHOT, GptChannelTickFrequency=1.0E6, GptChannelTickValueMax=65536, GptNotification=GptChannelConfiguration_IoHwAbTest_Cbk, GptChannelClkSrcRef=GptClockReferencePoint_IoHwAbTest
    GptConfigurationOfOptApiServices: GptDeinitApi=0, GptEnableDisableNotificationApi=1, GptTimeElapsedApi=1, GptTimeRemainingApi=1, GptVersionInfoApi=0, GptWakeupFunctionalityApi=1
    GptDriverConfiguration: GptDevErrorDetect=1, GptReportWakeupSource=1
      GptClockReferencePoint_IoHwAbTest (GptClockReferencePoint): GptClockReference=McuClockReferencePoint_IoHwAbTest
      GptClockReferencePoint_SystemClockFrequency (GptClockReferencePoint): GptClockReference=McuClockReferencePoint_SystemClockFrequency
    GptNonAUTOSAR: GptEnableDualClockMode=0
    CommonPublishedInformation:
      ArReleaseMajorVersion = 4
      ArReleaseMinorVersion = 0
      ArReleaseRevisionVersion = 3
      ModuleId = 100
      SwMajorVersion = 1
      SwMinorVersion = 0
      SwPatchVersion = 1
      VendorId = 43
