AUTOSAR XML (schema 4-0-3)
package /Pwm
  module config Pwm: implementation-config-variant=VARIANT-POST-BUILD, module-description=BswImplementation_Pwm_43
    PwmChannelConfigSet_0 (PwmChannelConfigSet)
      PwmChannel_0 (PwmChannel):
        PwmChannelClass = PWM_VARIABLE_PERIOD
        PwmChannelId = 0
        PwmHwChannel = EMIOS_0_CH_2
        PwmPolarity = PWM_HIGH
        PwmPeriodDefaultUnits = Period_in_seconds
        PwmPeriodDefault = 0.010
        PwmDutycycleDefault = 16384
        PwmIdleState = PWM_LOW
        PwmModeSelect = PWM_MODE_OPWFMB
        EmiosUnifiedChannelBusSelect = PWM_BUS_INTERNAL_COUNTER
        PwmPrescaler = PwmPrescalerDiv1
        PwmPrescaler_Alternate = PwmPrescalerDiv1
        PwmOffset = 0
        PwmTriggerDelay = 0
        Pwm_Deadtime = 0
        OffsetDelayAdjust = 0
        PwmFreezeEnable = 0
      PwmChannel_EMIOS23 (PwmChannel):
        PwmChannelId = 1
        PwmHwChannel = EMIOS_0_CH_23
        PwmPolarity = PWM_HIGH
        PwmPeriodDefaultUnits = Period_in_seconds
        PwmPeriodDefault = 0.010
        PwmDutycycleDefault = 0
        PwmIdleState = PWM_LOW
        PwmModeSelect = PWM_MODE_OPWFMB
        EmiosUnifiedChannelBusSelect = PWM_BUS_INTERNAL_COUNTER
        PwmPrescaler = PwmPrescalerDiv1
        PwmPrescaler_Alternate = PwmPrescalerDiv1
        PwmOffset = 0
        PwmTriggerDelay = 0
        Pwm_Deadtime = 0
        OffsetDelayAdjust = 0
        PwmFreezeEnable = 0
        PwmChannelClass = PWM_VARIABLE_PERIOD
    PwmConfigurationOfOptApiServices: PwmDeInitApi=0, PwmGetOutputState=1, PwmSetDutyCycle=1, PwmSetOutputToIdle=1, PwmSetPeriodAndDuty=1, PwmVersionInfoApi=0
    PwmGeneral:
      PwmDevErorDetect = 1
      PwmChangeRegisterA = 0
      PwmDutycycleUpdatedEndperiod = 1
      PwmNotificationSupported = 0
      PwmPeriodUpdatedEndperiod = 1
      PwmIndex = 0
      PwmClockFromMCU = 0
      PwmEmiosClockValue = 1000000
      PwmGenerateClockTreeDebugInfo = 0
      PwmCpuClockRef = McuClockReferencePoint_SystemClockFrequency
      PWM_E_UNEXPECTED_IRQ = PWM_E_UNEXPECTED_IRQ
    PwmNonAUTOSAR:
      PwmEnableDualClockMode = 0
      PwmSetCounterBusApi = 0
      PwmSetChannelOutputApi = 0
      PwmSetTriggerDelay = 0
      PwmDisableDemReportErrorStatus = 0
      PwmGetChannelState = 0
      MultiPwmChannelSynch = 0
    CommonPublishedInformation:
      ArReleaseMajorVersion = 4
      ArReleaseMinorVersion = 0
      ArReleaseRevisionVersion = 3
      ModuleId = 121
      SwMajorVersion = 1
      SwMinorVersion = 0
      SwPatchVersion = 1
      VendorId = 43
