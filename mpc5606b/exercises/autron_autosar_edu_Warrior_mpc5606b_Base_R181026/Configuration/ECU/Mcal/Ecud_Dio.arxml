AUTOSAR XML (schema 4-0-3)
package /Dio
  module config Dio: implementation-config-variant=VARIANT-POST-BUILD, module-description=BswImplementation_Dio
    DioConfig_0 (DioConfig)
      8 x DioPort:
        DioPort_A: DioPortId=0
          16 x DioChannel:
            DioPort_A_DioChannel_0: DioChannelId=0
            DioPort_A_DioChannel_1: DioChannelId=1
            DioPort_A_DioChannel_{10..15}: DioChannelId={10..15}
            DioPort_A_DioChannel_{2..9}: DioChannelId={2..9}
          DioChannelGroup_ExtWdg (DioChannelGroup): DioChannelGroupIdentification=WdgExtGroup_PA10, DioPortMask=0x20, DioPortOffset=5
        DioPort_B: DioPortId=1
          16 x DioChannel:
            DioPort_B_DioChannel_0: DioChannelId=0
            DioPort_B_DioChannel_1: DioChannelId=1
            DioPort_B_DioChannel_{10..15}: DioChannelId={10..15}
            DioPort_B_DioChannel_{2..9}: DioChannelId={2..9}
        DioPort_C: DioPortId=2
          16 x DioChannel:
            DioPort_C_DioChannel_0: DioChannelId=0
            DioPort_C_DioChannel_1: DioChannelId=1
            DioPort_C_DioChannel_{10..15}: DioChannelId={10..15}
            DioPort_C_DioChannel_{2..9}: DioChannelId={2..9}
        DioPort_D: DioPortId=3
          16 x DioChannel:
            DioPort_D_DioChannel_0: DioChannelId=0
            DioPort_D_DioChannel_1: DioChannelId=1
            DioPort_D_DioChannel_{10..15}: DioChannelId={10..15}
            DioPort_D_DioChannel_{2..9}: DioChannelId={2..9}
        DioPort_E: DioPortId=4
          16 x DioChannel:
            DioPort_E_DioChannel_0: DioChannelId=0
            DioPort_E_DioChannel_1: DioChannelId=1
            DioPort_E_DioChannel_{10..15}: DioChannelId={10..15}
            DioPort_E_DioChannel_{2..9}: DioChannelId={2..9}
        DioPort_F: DioPortId=5
          16 x DioChannel:
            DioPort_F_DioChannel_0: DioChannelId=0
            DioPort_F_DioChannel_1: DioChannelId=1
            DioPort_F_DioChannel_{10..15}: DioChannelId={10..15}
            DioPort_F_DioChannel_{2..9}: DioChannelId={2..9}
        DioPort_G: DioPortId=6
          16 x DioChannel:
            DioPort_G_DioChannel_0: DioChannelId=0
            DioPort_G_DioChannel_1: DioChannelId=1
            DioPort_G_DioChannel_{10..15}: DioChannelId={10..15}
            DioPort_G_DioChannel_{2..9}: DioChannelId={2..9}
        DioPort_H: DioPortId=7
          11 x DioChannel:
            DioPort_H_DioChannel_0: DioChannelId=0
            DioPort_H_DioChannel_1: DioChannelId=1
            DioPort_H_DioChannel_10: DioChannelId=10
            DioPort_H_DioChannel_{2..9}: DioChannelId={2..9}
    DioGeneral: DioDevErrorDetect=1, DioFlipChannelApi=0, DioVersionInfoApi=0, DioReversePortBits=0, DioMaskedWritePortApi=0, DioReadZeroForUndefinedPortPins=0
    CommonPublishedInformation: ArReleaseMajorVersion=4, ArReleaseMinorVersion=0, ArReleaseRevisionVersion=3, ModuleId=120, SwMajorVersion=1, SwMinorVersion=0, VendorId=43
