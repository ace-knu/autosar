AUTOSAR XML (schema 4-0-3)
package /Spi
  module config Spi: implementation-config-variant=VARIANT-POST-BUILD, module-description=BswImplementation_Spi
    SpiPublishedInformation:
      ArReleaseMajorVersion = 4
      ArReleaseMinorVersion = 0
      ArReleaseRevisionVersion = 4
      ModuleId = 83
      SwMajorVersion = 1
      SwMinorVersion = 0
      SwPatchVersion = 0
      VendorId = 43
      SpiMaxHwUnit = 0
    SpiDriver_0 (SpiDriver)
      SpiChannel_L99MC6 (SpiChannel): SpiChannelId=0, SpiChannelType=EB, SpiDataWidth=8, SpiDefaultData=255, SpiEbMaxLength=2, SpiIbNBuffers=1, SpiTransferStart=MSB
      SpiChannel_MC33972 (SpiChannel): SpiChannelId=1, SpiChannelType=EB, SpiDataWidth=8, SpiDefaultData=1, SpiEbMaxLength=3, SpiIbNBuffers=1, SpiTransferStart=MSB
      SpiDemEventParameterRefs: SPI_E_HARDWARE_ERROR=SPI_E_TIMEOUT
      4 x SpiExternalDevice, all with SpiSlaveMode=0, SpiCsPolarity=LOW, SpiDataShiftEdge=TRAILING, SpiEnableCs=1, SpiShiftClockIdleLevel=LOW, SpiTimeClk2Cs=1.0E-6, SpiTimeCs2Clk=1.0E-6, SpiTimeCs2Cs=6.4E-6, SpiCsContinous=True:
        SpiExternalDevice_L99MC6_1: SpiBaudrate=500000.0, SpiCsIdentifier=PCS0, SpiCsSelection=CS_VIA_GPIO, SpiHwUnit=CSIB0
        SpiExternalDevice_L99MC6_2: SpiBaudrate=500000.0, SpiCsIdentifier=PCS1, SpiCsSelection=CS_VIA_PERIPHERAL_ENGINE, SpiHwUnit=CSIB0
        SpiExternalDevice_MC33972_1: SpiBaudrate=6000000.0, SpiCsIdentifier=PCS0, SpiCsSelection=CS_VIA_PERIPHERAL_ENGINE, SpiHwUnit=CSIB1
        SpiExternalDevice_MC33972_2: SpiBaudrate=6000000.0, SpiCsIdentifier=PCS1, SpiCsSelection=CS_VIA_PERIPHERAL_ENGINE, SpiHwUnit=CSIB1
      4 x SpiJob, all with SpiHwUnitSynchronous=SYNCHRONOUS, SpiJobEndNotification=NULL_PTR, SpiJobStartNotification=NULL_PTR, SpiJobPriority=0:
        SpiJob_L99MC6_1: SpiJobId=0, SpiDeviceAssignment=SpiExternalDevice_L99MC6_1
          SpiChannelList_L99MC6_1 (SpiChannelList): SpiChannelIndex=0, SpiChannelAssignment=SpiChannel_L99MC6
        SpiJob_L99MC6_2: SpiJobId=1, SpiDeviceAssignment=SpiExternalDevice_L99MC6_2
          SpiChannelList_L99MC6_2 (SpiChannelList): SpiChannelIndex=0, SpiChannelAssignment=SpiChannel_L99MC6
        SpiJob_MC33972_1: SpiJobId=2, SpiDeviceAssignment=SpiExternalDevice_MC33972_1
          SpiChannelList0 (SpiChannelList): SpiChannelIndex=0, SpiChannelAssignment=SpiChannel_MC33972
        SpiJob_MC33972_2: SpiJobId=3, SpiDeviceAssignment=SpiExternalDevice_MC33972_2
          SpiChannelList0 (SpiChannelList): SpiChannelIndex=0, SpiChannelAssignment=SpiChannel_MC33972
      4 x SpiSequence, all with SpiInterruptibleSequence=0, SpiSeqEndNotification=NULL_PTR:
        SpiSequence_L99MC6_1: SpiSequenceId=0, SpiJobAssignment=SpiJob_L99MC6_1
        SpiSequence_L99MC6_2: SpiSequenceId=1, SpiJobAssignment=SpiJob_L99MC6_2
        SpiSequence_MC33972_1: SpiSequenceId=2, SpiJobAssignment=SpiJob_MC33972_1
        SpiSequence_MC33972_2: SpiSequenceId=3, SpiJobAssignment=SpiJob_MC33972_2
    SpiGeneral:
      SpiCancelApi = 1
      SpiChannelBuffersAllowed = 2
      SpiDevErrorDetect = 1
      SpiHwStatusApi = 1
      SpiInterruptibleSeqAllowed = 0
      SpiLevelDelivered = 2
      SpiSupportConcurrentSyncTransmit = 0
      SpiVersionInfoApi = 1
      SpiGlobalDmaEnable = 0
      SpiSyncTransmitTimeout = 50000
      SpiOptimizeOneJobSequences = 0
      SpiOptimizedSeqNumber = 0
      SpiOptimizedChannelsNumber = 0
      SpiClockRef = McuClockReferencePoint_PeripheralSet2clock
      SpiPhyUnit_DSPI_0 (SpiPhyUnit):
        SpiPhyUnitMapping = DSPI_0
        SpiPhyUnitMode = SPI_MASTER
        SpiPhyUnitSync = 1
        SpiPhyUnitAsyncMethod = PIO_FIFO
        SpiPhyTxDmaChannel = 0
        SpiPhyTxDmaChannelAux = 1
        SpiPhyRxDmaChannel = 2
      SpiPhyUnit_DSPI_1 (SpiPhyUnit):
        SpiPhyUnitMapping = DSPI_1
        SpiPhyUnitMode = SPI_MASTER
        SpiPhyUnitSync = 1
        SpiPhyUnitAsyncMethod = PIO_FIFO
        SpiPhyTxDmaChannel = 0
        SpiPhyTxDmaChannelAux = 1
        SpiPhyRxDmaChannel = 2
    SpiNonAUTOSAR:
      SpiAllowBigSizeCollections = 0
      SpiEnableHWUnitAsyncMode = 0
      SpiEnableDualClockMode = 0
      SpiJobStartNotificationEnable = 0
      SpiForceDataType = 0
      SpiDisableDemReportErrorStatus = 0
