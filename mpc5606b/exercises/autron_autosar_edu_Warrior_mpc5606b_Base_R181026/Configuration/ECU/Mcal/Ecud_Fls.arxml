AUTOSAR XML (schema 4-0-3)
package /Fls
  module config Fls: implementation-config-variant=VARIANT-POST-BUILD, module-description=BswImplementation_Fls
    FlsConfigSet_0 (FlsConfigSet):
      FlsAcErase = 1073751296
      FlsAcWrite = 1073751296
      FlsAcErasePointer = NULL_PTR
      FlsAcWritePointer = NULL_PTR
      FlsCallCycle = 0.0
      FlsJobEndNotification = Fee_JobEndNotification
      FlsJobErrorNotification = Fee_JobErrorNotification
      FlsMaxReadFastMode = 1048576
      FlsMaxReadNormalMode = 1024
      FlsMaxWriteFastMode = 256
      FlsMaxWriteNormalMode = 256
      FlsProtection = 0
      FlsDefaultMode = MEMIF_MODE_FAST
      FlsDemEventParameterRefs:
        FLS_E_COMPARE_FAILED = FLS_E_COMPARE_FAILED
        FLS_E_ERASE_FAILED = FLS_E_ERASE_FAILED
        FLS_E_READ_FAILED = FLS_E_READ_FAILED
        FLS_E_UNEXPECTED_FLASH_ID = FLS_E_UNEXPECTED_FLASH_ID
        FLS_E_WRITE_FAILED = FLS_E_WRITE_FAILED
      FlsSectorList
        4 x FlsSector, all with FlsPhysicalSectorUnlock=1, FlsNumberOfSectors=1, FlsPageSize=8, FlsSectorSize=16384, FlsProgrammingSize=FLS_WRITE_DOUBLE_WORD, FlsSectorEraseAsynch=1, FlsPageWriteAsynch=1:
          FlsSector_0: FlsPhysicalSector=FLS_DATA_ARRAY_0_L00, FlsSectorStartaddress=0
          FlsSector_1: FlsPhysicalSector=FLS_DATA_ARRAY_0_L01, FlsSectorStartaddress=16384
          FlsSector_2: FlsPhysicalSector=FLS_DATA_ARRAY_0_L02, FlsSectorStartaddress=32768
          FlsSector_3: FlsPhysicalSector=FLS_DATA_ARRAY_0_L03, FlsSectorStartaddress=49152
    NonAutosar: FlsDisableDemReportErrorStatus=0
    FlsGeneral:
      FlsAcLoadOnJobStart = 0
      FlsBaseAddress = 0
      FlsCancelApi = 0
      FlsCompareApi = 0
      FlsDevErrorDetect = 1
      FlsDriverIndex = 0
      FlsGetJobResultApi = 1
      FlsGetStatusApi = 1
      FlsSetModeApi = 1
      FlsTotalSize = 65536
      FlsUseInterrupts = 0
      FlsVersionInfoApi = 1
      FlsDsiHandlerApi = 1
      FlsEraseBlankCheck = 1
      FlsWriteBlankCheck = 1
      FlsWriteVerifyCheck = 1
      FlsMaxEraseBlankCheck = 256
    FlsPublishedInformation:
      FlsAcLocationErase = 0
      FlsAcLocationWrite = 0
      FlsAcSizeErase = 60
      FlsAcSizeWrite = 60
      FlsEraseTime = 5.0
      FlsErasedValue = 4294967295
      FlsExpectedHwId = 0
      FlsSpecifiedEraseCycles = 100000
      FlsWriteTime = 5.0E-4
    CommonPublishedInformation:
      ArReleaseMajorVersion = 4
      ArReleaseMinorVersion = 0
      ArReleaseRevisionVersion = 3
      ModuleId = 92
      SwMajorVersion = 1
      SwMinorVersion = 0
      VendorId = 43
      SwPatchVersion = 1
