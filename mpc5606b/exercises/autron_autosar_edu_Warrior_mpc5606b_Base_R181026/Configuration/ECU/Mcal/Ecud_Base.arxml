AUTOSAR XML (schema 4-0-3)
package /Base
  module config Base
    CommonPublishedInformation: ArReleaseMajorVersion=4, ArReleaseMinorVersion=0, ArReleaseRevisionVersion=3, ModuleId=0, SwMajorVersion=1, SwMinorVersion=0, VendorId=43
