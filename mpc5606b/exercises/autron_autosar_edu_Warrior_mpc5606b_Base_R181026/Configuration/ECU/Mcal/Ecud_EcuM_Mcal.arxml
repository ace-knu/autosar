AUTOSAR XML (schema 4-0-3)
package /EcuM
  module config EcuM: implementation-config-variant=VARIANT-POST-BUILD, module-description=BswImplementation_EcuM
    EcuMConfiguration
      EcuMCommonConfiguration: EcuMConfigConsistencyHash=1, EcuMDefaultAppMode=OsAppMode0
        EcuMDefaultShutdownTarget: EcuMDefaultState=EcuMStateReset
    EcuMGeneral: EcuMDevErrorDetect=1, EcuMIncludeDem=0, EcuMIncludeDet=0, EcuMMainFunctionPeriod=0.01, EcuMVersionInfoApi=0, EcuMEnableDefBehaviour=0
    CommonPublishedInformation: ArReleaseMajorVersion=4, ArReleaseMinorVersion=0, ArReleaseRevisionVersion=3, ModuleId=10, SwMajorVersion=1, SwMinorVersion=0, VendorId=43
