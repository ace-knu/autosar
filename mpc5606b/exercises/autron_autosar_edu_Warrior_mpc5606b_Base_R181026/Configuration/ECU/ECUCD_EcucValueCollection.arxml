AUTOSAR XML (schema 4-0-3)
package /EcucValueCollection
  ecuc value collection EcucValueCollection: category=MANAGED_ECUC_MODULES, ecu-extract=EcuExtract
    ecuc-values:
      Adc
      BswM
      Can
      CanIf
      CanSM
      CanTp
      Com
      ComM
      Crc
      Dcm
      Dem
      Dio
      EcuC
      EcuM
      Fee
      FiM
      Fls
      Gpt
      Icu
      Mcu
      MemIf
      NvM
      Os
      PduR
      Port
      Pwm
      Rte
      Spi
      Wdg
      WdgIf
      WdgM
      IoHwAb
      HwResource
      Base
      Resource
      Det
      OsProfiler
