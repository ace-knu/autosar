AUTOSAR XML (schema 4-0-3)
package /AUTOSAR
  module config EcuM: implementation-config-variant=VARIANT-PRE-COMPILE, module-description=BswImplementation_EcuM
    EcuMConfiguration
      EcuMCommonConfiguration: category=TOOL_CONFIGURED, EcuMConfigConsistencyHash=123456789, EcuMDefaultAppMode=OsAppMode0, EcuMOSResource=OsResource_Sleep
        EcuMDefaultShutdownTarget: EcuMDefaultState=EcuMStateSleep, EcuMDefaultResetModeRef=ECUM_RESET_MCU
        EcuMDemEventParameterRefs:
          ECUM_E_IMPROPER_CALLER = ECUM_E_IMPROPER_CALLER
          ECUM_E_CONFIGURATION_DATA_INCONSISTENT = ECUM_E_CONFIGURATION_DATA_INCONSISTENT
          ECUM_E_RAM_CHECK_FAILED = ECUM_E_RAM_CHECK_FAILED
        EcuMDriverInitListZero
          Dem_PreInit (EcuMDriverInitItem): EcuMModuleID=Dem, EcuMModuleParameter=NULL_PTR, EcuMModuleService=PreInit, EcuMDriverInitItemIndex=0, EcuMModuleRef=Dem
        EcuMDriverInitListOne
          20 x EcuMDriverInitItem, all with EcuMModuleService=Init:
            Mcu_Init: EcuMModuleID=Mcu, EcuMModuleParameter=POSTBUILD_PTR, EcuMDriverInitItemIndex=0, EcuMModulePostBuildPtr=&McuModuleConfiguration_0, EcuMModuleRef=Mcu
            Port_Init: EcuMModuleID=Port, EcuMModuleParameter=POSTBUILD_PTR, EcuMDriverInitItemIndex=1, EcuMModulePostBuildPtr=&PortConfigSet_0, EcuMModuleRef=Port
            Adc_Init: EcuMModuleID=Adc, EcuMModuleParameter=POSTBUILD_PTR, EcuMDriverInitItemIndex=2, EcuMModulePostBuildPtr=&AdcConfigSet_0, EcuMModuleRef=Adc
            Dio_Init: EcuMModuleID=Dio, EcuMModuleParameter=POSTBUILD_PTR, EcuMDriverInitItemIndex=3, EcuMModulePostBuildPtr=&DioConfig_0, EcuMModuleRef=Dio
            Gpt_Init: EcuMModuleID=Gpt, EcuMModuleParameter=POSTBUILD_PTR, EcuMDriverInitItemIndex=4, EcuMModulePostBuildPtr=&GptChannelConfigSet, EcuMModuleRef=Gpt
            Pwm_Init: EcuMModuleID=Pwm, EcuMModuleParameter=POSTBUILD_PTR, EcuMDriverInitItemIndex=5, EcuMModulePostBuildPtr=&PwmChannelConfigSet_0, EcuMModuleRef=Pwm
            Icu_Init: EcuMModuleID=Icu, EcuMModuleParameter=POSTBUILD_PTR, EcuMDriverInitItemIndex=6, EcuMModulePostBuildPtr=&IcuConfigSet_0, EcuMModuleRef=Icu
            Spi_Init: EcuMModuleID=Spi, EcuMModuleParameter=POSTBUILD_PTR, EcuMDriverInitItemIndex=7, EcuMModulePostBuildPtr=&SpiDriver_0, EcuMModuleRef=Spi
            Can_Init: EcuMModuleID=Can, EcuMModuleParameter=POSTBUILD_PTR, EcuMDriverInitItemIndex=9, EcuMModulePostBuildPtr=&CanConfigSet, EcuMModuleRef=Can
            IoHwAb_Init: EcuMModuleID=IoHwAb, EcuMModuleParameter=VOID, EcuMDriverInitItemIndex=10, EcuMModuleRef=IoHwAb
            CanIf_Init: EcuMModuleID=CanIf, EcuMModuleParameter=NULL_PTR, EcuMDriverInitItemIndex=11, EcuMModuleRef=CanIf
            CanSM_Init: EcuMModuleID=CanSM, EcuMModuleParameter=NULL_PTR, EcuMDriverInitItemIndex=12, EcuMModuleRef=CanSM
            CanTp_Init: EcuMModuleID=CanTp, EcuMModuleParameter=NULL_PTR, EcuMDriverInitItemIndex=13, EcuMModuleRef=CanTp
            PduR_Init: EcuMModuleID=PduR, EcuMModuleParameter=NULL_PTR, EcuMDriverInitItemIndex=14, EcuMModuleRef=PduR
            Com_Init: EcuMModuleID=Com, EcuMModuleParameter=NULL_PTR, EcuMDriverInitItemIndex=15, EcuMModuleRef=Com
            ComM_Init: EcuMModuleID=ComM, EcuMModuleParameter=VOID, EcuMDriverInitItemIndex=16, EcuMModuleRef=ComM
            Dcm_Init: EcuMModuleID=Dcm, EcuMModuleParameter=NULL_PTR, EcuMDriverInitItemIndex=17, EcuMModuleRef=Dcm
            Det_Init: EcuMModuleID=Det, EcuMModuleParameter=VOID, EcuMDriverInitItemIndex=18, EcuMModuleRef=Det
            Wdg_Init: EcuMModuleID=Wdg, EcuMModuleParameter=NULL_PTR, EcuMDriverInitItemIndex=19, EcuMModuleRef=Wdg
            WdgM_Init: EcuMModuleID=WdgM, EcuMModuleParameter=NULL_PTR, EcuMDriverInitItemIndex=20, EcuMModuleRef=WdgM
        ECUM_SLEEP_HALT (EcuMSleepMode):
          EcuMSleepModeId = 0
          EcuMSleepModeSuspend = 1
          EcuMSleepModeMcuModeRef = McuModeSettingConf_HALT
          EcuMWakeupSourceMask = ECUM_WKSOURCE_GPT
          EcuMWakeupSourceMask = ECUM_WKSOURCE_CAN1RX
          EcuMWakeupSourceMask = ECUM_WKSOURCE_CAN1RX_POLL
        8 x EcuMWakeupSource, all with EcuMWakeupSourcePolling=0, EcuMResetReasonRef=MCU_RESET_UNDEFINED:
          ECUM_WKSOURCE_POWER: category=TOOL_CONFIGURED, EcuMWakeupSourceId=0
          ECUM_WKSOURCE_RESET: category=TOOL_CONFIGURED, EcuMWakeupSourceId=1
          ECUM_WKSOURCE_INTERNAL_RESET: category=TOOL_CONFIGURED, EcuMWakeupSourceId=2
          ECUM_WKSOURCE_INTERNAL_WDG: category=TOOL_CONFIGURED, EcuMWakeupSourceId=3
          ECUM_WKSOURCE_EXTERNAL_WDG: category=TOOL_CONFIGURED, EcuMWakeupSourceId=4
          ECUM_WKSOURCE_GPT: category=TOOL_CONFIGURED, EcuMWakeupSourceId=5
          ECUM_WKSOURCE_CAN1RX: EcuMWakeupSourceId=6, EcuMComMChannelRef=ComMChannel_Project
          ECUM_WKSOURCE_CAN1RX_POLL: EcuMWakeupSourceId=7
      EcuMFlexConfiguration: category=TOOL_CONFIGURED, EcuMMcuType=FREESCALE_MPC560XB, EcuMNormalMcuClockRef=McuClockSettingConfig_PLL
        ECUM_ALARM_PM (EcuMAlarmClock): EcuMAlarmClockId=0, EcuMAlarmClockTimeOut=0, EcuMAlarmClockUser=ECUM_USER_PM
        EcuMGoDownAllowedUsers: EcuMGoDownAllowedUserRef=ECUM_USER_BSWM
        EcuMSetClockAllowedUsers: EcuMSetClockAllowedUserRef=ECUM_USER_PM
        ECUM_USER_BSWM (EcuMFlexUserConfig): EcuMFlexUser=42
        ECUM_USER_PM (EcuMFlexUserConfig): EcuMFlexUser=255
        3 x EcuMResetMode, all with category=TOOL_CONFIGURED:
          ECUM_RESET_MCU: EcuMResetModeId=0
          ECUM_RESET_WDG: EcuMResetModeId=1
          ECUM_RESET_IO: EcuMResetModeId=2
        4 x EcuMShutdownCause, all with category=TOOL_CONFIGURED:
          ECUM_CAUSE_UNKNOWN: EcuMShutdownCauseId=0
          ECUM_CAUSE_ECU_STATE: EcuMShutdownCauseId=1
          ECUM_CAUSE_WDGM: EcuMShutdownCauseId=2
          ECUM_CAUSE_DCM: EcuMShutdownCauseId=3
    EcuMFlexGeneral: EcuMAlarmClockPresent=0, EcuMEnableDefBehaviour=0, EcuMResetLoopDetection=1, EcuMPmEnabled=0, EcuMLpTransitionCalloutEnabled=false
    EcuMGeneral: EcuMDevErrorDetect=1, EcuMIncludeDet=1, EcuMMainFunctionPeriod=0.01, EcuMVersionInfoApi=0
