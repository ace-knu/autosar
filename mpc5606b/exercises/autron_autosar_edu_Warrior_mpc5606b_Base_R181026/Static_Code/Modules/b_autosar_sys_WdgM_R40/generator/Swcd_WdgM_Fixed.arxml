AUTOSAR XML (schema 4-0-3)
package /WdgM/ImplementationDataTypes
  6 x impl type, all with category=TYPE_REFERENCE:
    WdgM_SupervisedEntityIdType: compu-method=WdgM_SupervisedEntityIdTypeValues, implementation-data-type=uint16
    WdgM_CheckpointIdType: compu-method=WdgM_CheckpointIdTypeValues, implementation-data-type=uint16
    WdgM_LocalStatusType: compu {0=WDGM_LOCAL_STATUS_OK, 1=WDGM_LOCAL_STATUS_FAILED, 2=WDGM_LOCAL_STATUS_EXPIRED, 4=WDGM_LOCAL_STATUS_DEACTIVATED}, implementation-data-type=uint8
    WdgM_GlobalStatusType: compu {0=WDGM_GLOBAL_STATUS_OK, 1=WDGM_GLOBAL_STATUS_FAILED, 2=WDGM_GLOBAL_STATUS_EXPIRED, 3=WDGM_GLOBAL_STATUS_STOPPED, 4=WDGM_GLOBAL_STATUS_DEACTIVATED}, implementation-data-type=uint8
    WdgM_SupervisionType: compu {1=WDGM_ALIVE_SUPERVISION, 2=WDGM_DEADLINE_SUPERVISION, 3=WDGM_INTERNAL_LOGICAL_SUPERVISION, 4=WDGM_EXTERNAL_LOGICAL_SUPERVISION}, implementation-data-type=uint8
    WdgM_ModeType: compu-method=WdgM_ModeIdTypeValues, implementation-data-type=uint8
package /WdgM/ModeDeclarationGroups
  mode declaration group WdgM_Mode: category=EXPLICIT_ORDER, initial-mode=SUPERVISION_OK, on-transition-value=5
    5 x mode:
      SUPERVISION_OK: value=0
      SUPERVISION_FAILED: value=1
      SUPERVISION_EXPIRED: value=2
      SUPERVISION_STOPPED: value=3
      SUPERVISION_DEACTIVATED: value=4
package /WdgM/DataTypeMappingSets
  data type mapping set WdgM_Mode: mode-request-type-map{implementation-data-type=uint8, mode-group=WdgM_Mode}
package /WdgM/ClientServerInterfaces
  client server interface WdgM_AliveSupervision: is-service=true, service-kind=WATCH-DOG-MANAGER
    operation CheckpointReached: possible-error=WdgM_AliveSupervision/E_NOT_OK
      arg ddCheckpointID: type=WdgM_CheckpointIdType, direction=IN, server-argument-impl-policy=USE-ARGUMENT-TYPE
    operation UpdateAliveCounter: possible-error=WdgM_AliveSupervision/E_NOT_OK
    error E_NOT_OK: error-code=1
  client server interface WdgM_API: is-service=true, service-kind=WATCH-DOG-MANAGER
    6 x operation:
      SetMode: possible-error=WdgM_API/E_NOT_OK
        arg ddMode: type=WdgM_ModeType, direction=IN, server-argument-impl-policy=USE-ARGUMENT-TYPE
        arg usCallerID: type=uint16, direction=IN, server-argument-impl-policy=USE-ARGUMENT-TYPE
      GetMode: possible-error=WdgM_API/E_NOT_OK
        arg pMode: type=WdgM_ModeType, direction=OUT, server-argument-impl-policy=USE-ARGUMENT-TYPE
      GetLocalStatus: possible-error=WdgM_API/E_NOT_OK
        arg ddSEID: type=WdgM_SupervisedEntityIdType, direction=IN, server-argument-impl-policy=USE-ARGUMENT-TYPE
        arg pStatus: type=WdgM_LocalStatusType, direction=OUT, server-argument-impl-policy=USE-ARGUMENT-TYPE
      GetGlobalStatus: possible-error=WdgM_API/E_NOT_OK
        arg pStatus: type=WdgM_GlobalStatusType, direction=OUT, server-argument-impl-policy=USE-ARGUMENT-TYPE
      PerformReset
      GetFirstExpiredSEID: possible-error=WdgM_API/E_NOT_OK
        arg pSEID: type=WdgM_SupervisedEntityIdType, direction=OUT, server-argument-impl-policy=USE-ARGUMENT-TYPE
    error E_NOT_OK: error-code=1
package /WdgM/ModeSwitchInterfaces
  mode switch interface WdgM_IndividualMode: is-service=true, service-kind=WATCH-DOG-MANAGER
    mode group currentMode: type=WdgM_Mode
  mode switch interface WdgM_GlobalMode: is-service=true, service-kind=WATCH-DOG-MANAGER
    mode group currentMode: type=WdgM_Mode
