AUTOSAR XML (schema 4-0-3)
# (C) 2013 HYUNDAI AUTRON Co., Ltd.
# Confidential Proprietary Information. Distribution Limited.
# Do Not Copy Without Prior Permission
package /AUTRON
  ecuc definition collection ParameterDefinition_MemIf: module=MemIf
  module definition MemIf: refined-module-def=MemIf, variants pre-compile  # Configuration of the MemIf (Memory Abstraction Interface) module.
    container MemIfGeneral  # Configuration of the memory abstraction interface (Memif) module.
      boolean MemIfDevErrorDetect: category=FIXED, set at pre-compile  # Pre-processor switch to enable and disable development error detection. | true: Development error detection enabled. false: Development error detection disabled.
      integer MemIfNumberOfDevices: 1..255, category=FIXED, set at pre-compile, default-value=1  # Concrete number of underlying memory abstraction modules. | Calculation Formula: Count number of configured EA and FEE modules.
      boolean MemIfVersionInfoApi: category=FIXED, set at pre-compile  # Pre-processor switch to enable / disable the API to read out the modules version information. | true: Version info API enabled. false: Version info API disabled.
