AUTOSAR XML (schema 4-0-3)
package /Bsw_WdgIf
  bsw implementation BswImplementation_WdgIf: sw-version=1.2.1, vendor-id=39, ar-release-version=4.0.3, behavior=BswInternalBehavior_WdgIf
  bsw module description WdgIf: module-id=43, provided-entrys=[WdgIf_SetMode, WdgIf_SetTriggerCondition, WdgIf_GetVersionInfo]
    bsw internal behavior BswInternalBehavior_WdgIf
      bsw called entity WdgIf_SetMode: implemented-entry=WdgIf_SetMode
      bsw called entity WdgIf_SetTriggerCondition: implemented-entry=WdgIf_SetTriggerCondition
      bsw called entity WdgIf_GetVersionInfo: implemented-entry=WdgIf_GetVersionInfo
  bsw module entry WdgIf_SetMode: service-id=1, is-reentrant=false, is-synchronous=true, call-type=REGULAR, execution-context=UNSPECIFIED, sw-service-impl-policy=STANDARD
  bsw module entry WdgIf_SetTriggerCondition: service-id=2, is-reentrant=false, is-synchronous=true, call-type=REGULAR, execution-context=UNSPECIFIED, sw-service-impl-policy=STANDARD
  bsw module entry WdgIf_GetVersionInfo: service-id=3, is-reentrant=true, is-synchronous=true, call-type=REGULAR, execution-context=UNSPECIFIED, sw-service-impl-policy=STANDARD
