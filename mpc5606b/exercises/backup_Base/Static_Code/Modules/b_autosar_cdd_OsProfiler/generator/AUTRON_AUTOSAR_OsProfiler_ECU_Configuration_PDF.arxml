AUTOSAR XML (schema 4-2-1)
# (C) 2016-2017 HYUNDAI AUTRON Co., Ltd.
# Confidential Proprietary Information. Distribution Limited.
# Do Not Copy Without Prior Permission
package /AUTRON
  ecuc definition collection ParameterDefinition_OsProfiler: module=OsProfiler
  module definition OsProfiler: refined-module-def=Cdd, variants pre-compile  # Configuration of the OsProfiler module.
    container OsProfilerGlobalConfig
      boolean EnableOsProfiler: set at , default-value=false  # Enable OsProfiler
      boolean EnableProfileIsr: set at , default-value=false  # Enable OsProfiler
      integer ProfileEventCount: 0..32767, set at pre-compile, origin=AUTRON, default-value=20  # Profiled Event Count
      boolean EnableTimeIndex: set at , default-value=false  # Enable Time Index
      float TimeIndexPeriod: 0.000005..1, set at pre-compile, origin=AUTRON  # Period of Time Index in seconds .
    container OsProfilerTargetConfig
      enumeration TargetOperatingSystem: {FREESCALE_MPC560xB, RENESAS_RH850, AUTRON_TC2XX}, category=FIXED, set at pre-compile, origin=AUTRON, default-value=NONE  # Target Operating System
      integer XOSC: 0..4294967295, category=FIXED, set at pre-compile, origin=AUTRON  # XOSC clock
    container OsProfilerPeriodTaskConfig [1..255]
      float TaskPeriod [0..1]: 0.000001..100, set at pre-compile, origin=AUTRON  # Period of Task in seconds
      reference PeriodTaskRef: destination=OsTask
