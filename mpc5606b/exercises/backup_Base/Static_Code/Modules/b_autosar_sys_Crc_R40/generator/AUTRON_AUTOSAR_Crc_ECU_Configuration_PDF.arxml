AUTOSAR XML (schema 4-0-3)
# (C) 2013 HYUNDAI AUTRON Co., Ltd.
# Confidential Proprietary Information. Distribution Limited.
# Do Not Copy Without Prior Permission
package /AUTRON
  ecuc definition collection ParameterDefinition_Crc: module=Crc
  module definition Crc [0..1]: category=VENDOR_SPECIFIC_MODULE_DEFINITION, refined-module-def=Crc, variants pre-compile  # Configuration of the Crc (Crc routines) module.
    container CrcGeneral  # General configuration of CRC module
      enumeration Crc16Mode [0..1]: {CRC_16_HARDWARE, CRC_16_RUNTIME, CRC_16_TABLE}, set at pre-compile  # Switch to select one of the available CRC 16-bit (CCITT) calculation methods CRC_16_HARDWARE CRC_16_RUNTIME CRC_16_TABLE
      enumeration Crc32Mode [0..1]: {CRC_32_HARDWARE, CRC_32_RUNTIME, CRC_32_TABLE}, set at pre-compile  # Switch to select one of the available CRC 32-bit (IEEE-802.3 CRC32 Ethernet Standard) calculation methods CRC_32_HARDWARE CRC_32_RUNTIME CRC_32_TABLE
      enumeration Crc8H2FMode [0..1]: {CRC_8H2F_HARDWARE, CRC_8H2F_RUNTIME, CRC_8H2F_TABLE}, set at pre-compile  # Switch to select one of the available CRC 8-bit (2Fh polynomial) calculation methods CRC_8H2F_HARDWARE CRC_8H2F_RUNTIME CRC_8H2F_TABLE
      enumeration Crc8Mode [0..1]: {CRC_8_HARDWARE, CRC_8_RUNTIME, CRC_8_TABLE}, set at pre-compile  # Switch to select one of the available CRC 8-bit (SAE J1850) calculation methods CRC_8_HARDWARE CRC_8_RUNTIME CRC_8_TABLE
