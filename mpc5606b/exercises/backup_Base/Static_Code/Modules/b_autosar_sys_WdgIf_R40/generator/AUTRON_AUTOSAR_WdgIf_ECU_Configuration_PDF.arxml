AUTOSAR XML (schema 4-0-3)
# (C) 2014 HYUNDAI AUTRON Co., Ltd.
# Confidential Proprietary Information. Distribution Limited.
# Do Not Copy Without Prior Permission
package /AUTRON
  module definition WdgIf: refined-module-def=WdgIf, variants pre-compile  # Configuration of the WdgIf (Watchdog Interface) module.
    container WdgIfDevice [1..*]  # It contains the information for the selection of a particular Watchdog device in case multiple Watchdog drivers are connected.
      integer WdgIfDeviceIndex: 0..255, category=FIXED, set at pre-compile, symbolic-name-value=true  # Represents the watchdog interface ID so that it can be referenced by the watchdog manager.
      symbolic name reference WdgIfDriverRef: category=FIXED, set at pre-compile, destination=WdgGeneral  # Reference to the watchdog drivers that are controlled by the watchdog interface.
    container WdgIfGeneral  # This container collects all generic watchdog interface parameters.
      boolean WdgIfDevErrorDetect: category=FIXED, set at pre-compile, default-value=true  # Pre-processor switch for enabling the development error detection and reporting. | true: Development error detection enabled false: Development error detection disabled
      boolean WdgIfVersionInfoApi: category=FIXED, set at pre-compile, default-value=false  # Pre-processor switch to enable / disable the service returning the version information. | true: Version information service enabled false: Version information service disabled
  ecuc definition collection ParameterDefinition_WdgIf: module=WdgIf
