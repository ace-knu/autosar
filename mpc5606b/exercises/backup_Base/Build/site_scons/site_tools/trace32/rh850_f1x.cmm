;*********************************************************
;*                                                       *
;* Basic setup of RH850/F1x Devices                      *
;*                                                       *
;* NOTE:                                                 *
;* - read-accesses to an erased data-flash will get      *
;*   random data --> memory-dump is flickering           *
;*                                                       *
;*********************************************************
;*                                                       *
;*                                                       *
;* CPU-Type      FlashSize(KB)     RamSize(KB)           *
;* -------------------------------------------           *
;* R7F701035        2048+32+48             64.           *
;*                                                       *
;*********************************************************
;
; $Author: mobermeir $
; $Date: 2013-07-02 15:31:50 +0200 (Tue, 02 Jul 2013) $
; $Rev: 2308 $
;
;*********************************************************
;*                                                       *
;*                                                       *

 LOCAL &parameters
 ENTRY %LINE &parameters

 LOCAL &param_prepareonly
 &param_prepareonly=(STRing.SCAN(STRing.UPpeR("&parameters"),"PREPAREONLY",0)!=-1)

; Activate Debugger 
 SYStem.CPU R7F701035

 SYStem.JtagClock 10.MHz

 TrOnchip.Set.Alignment OFF
 TrOnchip.Set.MissAlign OFF

 SYStem.Up


; init RAM (prevent ECC errors)
 Data.Set 0xfedf0000--0xfedfffff %Long 0

; FLASH Setup
 FLASH.RESet
 FLASH.Create 1. 0x00000000--0x0000ffff 0x002000 TARGET Long
 FLASH.Create 1. 0x00010000--0x001fffff 0x008000 TARGET Long
 FLASH.Create 1. 0x01000000--0x01007fff 0x008000 NOP    Long
 FLASH.Create 2. 0xff200000--0xff20afff 0x000040 TARGET Long

 FLASH.TARGET 0xfedf8000 0xfedf6000 0x1000 ~~/demo/rh850/flash/long/rh850f1x.bin /STACKSIZE 0x180

; Flash script ends here if called with parameter PREPAREONLY
 IF &param_prepareonly
   ENDDO PREPAREDONE

;========================================================================
; Flash programming example

 ;DIALOG.YESNO "Program flash memory?"
 ;LOCAL &progflash
 ;ENTRY &progflash
 ;IF &progflash 
 ;(
   FLASH.ReProgram 1.        ; unit "1." == programflash, see flash.list
   Data.LOAD.auto TestProject_Integration_f1l.elf
   FLASH.ReProgram off
 ;)

sys.option IMASKASM ON
sys.option IMASKHLL ON
sys.option PERSTOP ON
;
 ENDDO
 
;*                                                       *
;* End of basic setup                                    *
;*********************************************************

