AUTOSAR XML (schema 4-0-3)
package /AUTOSAR
  module config WdgIf: implementation-config-variant=VARIANT-PRE-COMPILE, module-description=BswImplementation_WdgIf
    WdgIfDevice_Int (WdgIfDevice): WdgIfDeviceIndex=0, WdgIfDriverRef=WdgGeneral
    WdgIfGeneral: WdgIfDevErrorDetect=1, WdgIfVersionInfoApi=1
