AUTOSAR XML (schema 4-0-3)
package /AUTOSAR
  module config HwResource: implementation-config-variant=VARIANT-PRE-COMPILE
    HwResourceGeneral: HwResourceMcuPackageType=MPC5606B/LQFP144
      5 x HwResourceVendor:
        FREESCALE
          7 x HwResourceFamily:
            MPC5601X
              MPC5601D (HwResourceMcu)
                LQFP64 (HwResourcePackage)
                LQFP100 (HwResourcePackage)
            MPC5602X
              3 x HwResourceMcu:
                MPC5602B
                  3 x HwResourcePackage:
                    LQFP64
                    LQFP100
                    LQFP144
                MPC5602C
                  LQFP64 (HwResourcePackage)
                  LQFP100 (HwResourcePackage)
                MPC5602D
                  LQFP64 (HwResourcePackage)
                  LQFP100 (HwResourcePackage)
            MPC5603X
              MPC5603B (HwResourceMcu)
                3 x HwResourcePackage:
                  LQFP64
                  LQFP100
                  LQFP144
              MPC5603C (HwResourceMcu)
                LQFP64 (HwResourcePackage)
                LQFP100 (HwResourcePackage)
            MPC5604X
              MPC5604B (HwResourceMcu)
                4 x HwResourcePackage:
                  LQFP64
                  LQFP100
                  LQFP144
                  MAPBGA208
              MPC5604C (HwResourceMcu)
                LQFP64 (HwResourcePackage)
                LQFP100 (HwResourcePackage)
            MPC5605X
              MPC5605B (HwResourceMcu)
                3 x HwResourcePackage:
                  LQFP100
                  LQFP144
                  LQFP176
            MPC5606X
              MPC5606B (HwResourceMcu)
                LQFP144 (HwResourcePackage)
                LQFP176 (HwResourcePackage)
            MPC5607X
              MPC5607B (HwResourceMcu)
                LQFP176 (HwResourcePackage)
                MAPBGA208 (HwResourcePackage)
        INFINEON
          7 x HwResourceFamily:
            TC21X
              3 x HwResourceMcu:
                TC212
                  TQFP80 (HwResourcePackage)
                TC213
                  TQFP100 (HwResourcePackage)
                TC214
                  LQFP144 (HwResourcePackage)
                  TQFP144 (HwResourcePackage)
            TC22X
              3 x HwResourceMcu:
                TC222
                  TQFP80 (HwResourcePackage)
                TC223
                  TQFP100 (HwResourcePackage)
                TC224
                  LQFP144 (HwResourcePackage)
                  TQFP144 (HwResourcePackage)
            TC23X
              3 x HwResourceMcu:
                TC233
                  TQFP100 (HwResourcePackage)
                TC234
                  LQFP144 (HwResourcePackage)
                  TQFP144 (HwResourcePackage)
                TC237
                  LFBGA292 (HwResourcePackage)
            TC24X
              TC244 (HwResourceMcu)
                LQFP144 (HwResourcePackage)
                TQFP144 (HwResourcePackage)
            TC26X
              3 x HwResourceMcu:
                TC264
                  LQFP144 (HwResourcePackage)
                  TQFP144 (HwResourcePackage)
                TC265
                  LQFP176 (HwResourcePackage)
                TC267
                  LFBGA292 (HwResourcePackage)
            TC27X
              TC275 (HwResourceMcu)
                LQFP176 (HwResourcePackage)
              TC277 (HwResourceMcu)
                LFBGA292 (HwResourcePackage)
            TC29X
              3 x HwResourceMcu:
                TC297
                  LFBGA292 (HwResourcePackage)
                TC298
                  BGA416 (HwResourcePackage)
                TC299
                  LFBGA516 (HwResourcePackage)
        RENESAS
          RH850F1X (HwResourceFamily)
            RH850F1H (HwResourceMcu)
              4 x HwResourcePackage:
                FPBGA233
                FPBGA272
                HLQFP176
                LQFP176
            RH850F1L (HwResourceMcu)
              5 x HwResourcePackage:
                LQFP64
                LQFP80
                LQFP100
                LQFP144
                LQFP176
        CYPRESS
          S6J32XX (HwResourceFamily)
            S6J320A (HwResourceMcu)
              TEQFP208 (HwResourcePackage)
              TEQFP216 (HwResourcePackage)
            S6J320C (HwResourceMcu)
              3 x HwResourcePackage:
                TEQFP208
                TEQFP216
                TEQFP256
          S6J33XX (HwResourceFamily)
            S6J331E (HwResourceMcu)
              3 x HwResourcePackage:
                TEQFP144
                TEQFP176
                TEQFP208
        ST
          SPC58XC (HwResourceFamily)
            SPC584C (HwResourceMcu)
              4 x HwResourcePackage:
                eTQFP100
                eTQFP144
                eLQFP176
                BGA292
            SPC58EC (HwResourceMcu)
              4 x HwResourcePackage:
                eTQFP100
                eTQFP144
                eLQFP176
                BGA292
