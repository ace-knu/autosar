AUTOSAR XML (schema 4-0-3)
standard types defined: boolean, uint8, uint8_least, uint16, uint16_least, uint32, uint32_least, sint8, sint8_least, sint16, sint16_least, sint32, sint32_least, float32, float64
