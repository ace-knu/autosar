AUTOSAR XML (schema 4-0-3)
package /AUTOSAR_Icu/BswModuleDescriptions
  bsw module description Icu: module-id=122
    provided-entrys:
      *
      Icu_CheckWakeup
      Icu_DeInit
      Icu_DisableEdgeCount
      Icu_DisableEdgeDetection
      Icu_DisableNotification
      Icu_DisableWakeup
      Icu_eMIOS_LLD_CheckOverflowFlag
      Icu_eMIOS_LLD_DeInitChannel
      Icu_eMIOS_LLD_DisableEdgeCount
      Icu_eMIOS_LLD_DisableInterrupt
      Icu_eMIOS_LLD_EnableInterrupt
      Icu_eMIOS_LLD_GetCaptureRegA
      Icu_eMIOS_LLD_GetCaptureRegB
      Icu_eMIOS_LLD_GetEdgeNumbers
      Icu_eMIOS_LLD_GetInputState
      Icu_eMIOS_LLD_GetTimeStamp
      Icu_eMIOS_LLD_InitChannel
      Icu_eMIOS_LLD_ProcessInterrupt
      Icu_eMIOS_LLD_ResetEdgeCount
      Icu_eMIOS_LLD_SelectPrescaler
      Icu_eMIOS_LLD_SetActivationCondition
      Icu_eMIOS_LLD_SetNormalMode
      Icu_eMIOS_LLD_SetSleepMode
      Icu_eMIOS_LLD_StartSignalMeasurement
      Icu_eMIOS_LLD_StartTimestamp
      Icu_eMIOS_LLD_StopSignalMeasurement
      Icu_eMIOS_LLD_StopTimestamp
      Icu_eMIOS_LLD_UCSetMode
      Icu_EnableEdgeCount
      Icu_EnableEdgeDetection
      Icu_EnableNotification
      Icu_EnableWakeup
      Icu_GetCaptureRegisterValue
      Icu_GetDutyCycleValues
      Icu_GetEdgeNumbers
      Icu_GetInputState
      Icu_GetTimeElapsed
      Icu_GetTimestampIndex
      Icu_GetVersionInfo
      Icu_Init
      Icu_LLD_GetChannelClockMode
      Icu_ResetEdgeCount
      Icu_SetActivationCondition
      Icu_SetMode
      Icu_StartSignalMeasurement
      Icu_StartTimestamp
      Icu_StopSignalMeasurement
      Icu_StopTimestamp
      SIUL_EXT_IRQ_0_7_ISR
      SIUL_EXT_IRQ_16_23_ISR
      SIUL_EXT_IRQ_24_31_ISR
      SIUL_EXT_IRQ_8_15_ISR
    bsw internal behavior InternalBehavior_Icu_43
      22 x exclusive area:
        ICU_EXCLUSIVE_AREA_{00..21}
      49 x bsw called entity:
        *: implemented-entry=*
        Icu_CheckWakeup: implemented-entry=Icu_CheckWakeup
        Icu_DeInit: implemented-entry=Icu_DeInit
        Icu_DisableEdgeCount: implemented-entry=Icu_DisableEdgeCount
        Icu_DisableEdgeDetection: implemented-entry=Icu_DisableEdgeDetection
        Icu_DisableNotification: implemented-entry=Icu_DisableNotification
        Icu_DisableWakeup: implemented-entry=Icu_DisableWakeup
        Icu_eMIOS_LLD_CheckOverflowFlag: implemented-entry=Icu_eMIOS_LLD_CheckOverflowFlag
        Icu_eMIOS_LLD_DeInitChannel: implemented-entry=Icu_eMIOS_LLD_DeInitChannel
        Icu_eMIOS_LLD_DisableEdgeCount: implemented-entry=Icu_eMIOS_LLD_DisableEdgeCount
        Icu_eMIOS_LLD_DisableInterrupt: implemented-entry=Icu_eMIOS_LLD_DisableInterrupt
        Icu_eMIOS_LLD_EnableInterrupt: implemented-entry=Icu_eMIOS_LLD_EnableInterrupt
        Icu_eMIOS_LLD_GetCaptureRegA: implemented-entry=Icu_eMIOS_LLD_GetCaptureRegA
        Icu_eMIOS_LLD_GetCaptureRegB: implemented-entry=Icu_eMIOS_LLD_GetCaptureRegB
        Icu_eMIOS_LLD_GetEdgeNumbers: implemented-entry=Icu_eMIOS_LLD_GetEdgeNumbers
        Icu_eMIOS_LLD_GetInputState: implemented-entry=Icu_eMIOS_LLD_GetInputState
        Icu_eMIOS_LLD_GetTimeStamp: implemented-entry=Icu_eMIOS_LLD_GetTimeStamp
        Icu_eMIOS_LLD_InitChannel: implemented-entry=Icu_eMIOS_LLD_InitChannel
        Icu_eMIOS_LLD_ProcessInterrupt: implemented-entry=Icu_eMIOS_LLD_ProcessInterrupt
        Icu_eMIOS_LLD_ResetEdgeCount: implemented-entry=Icu_eMIOS_LLD_ResetEdgeCount
        Icu_eMIOS_LLD_SelectPrescaler: implemented-entry=Icu_eMIOS_LLD_SelectPrescaler
        Icu_eMIOS_LLD_SetActivationCondition: implemented-entry=Icu_eMIOS_LLD_SetActivationCondition
        Icu_eMIOS_LLD_SetNormalMode: implemented-entry=Icu_eMIOS_LLD_SetNormalMode
        Icu_eMIOS_LLD_SetSleepMode: implemented-entry=Icu_eMIOS_LLD_SetSleepMode
        Icu_eMIOS_LLD_StartSignalMeasurement: implemented-entry=Icu_eMIOS_LLD_StartSignalMeasurement
        Icu_eMIOS_LLD_StartTimestamp: implemented-entry=Icu_eMIOS_LLD_StartTimestamp
        Icu_eMIOS_LLD_StopSignalMeasurement: implemented-entry=Icu_eMIOS_LLD_StopSignalMeasurement
        Icu_eMIOS_LLD_StopTimestamp: implemented-entry=Icu_eMIOS_LLD_StopTimestamp
        Icu_eMIOS_LLD_UCSetMode: implemented-entry=Icu_eMIOS_LLD_UCSetMode
        Icu_EnableEdgeCount: implemented-entry=Icu_EnableEdgeCount
        Icu_EnableEdgeDetection: implemented-entry=Icu_EnableEdgeDetection
        Icu_EnableNotification: implemented-entry=Icu_EnableNotification
        Icu_EnableWakeup: implemented-entry=Icu_EnableWakeup
        Icu_GetCaptureRegisterValue: implemented-entry=Icu_GetCaptureRegisterValue
        Icu_GetDutyCycleValues: implemented-entry=Icu_GetDutyCycleValues
        Icu_GetEdgeNumbers: implemented-entry=Icu_GetEdgeNumbers
        Icu_GetInputState: implemented-entry=Icu_GetInputState
        Icu_GetTimeElapsed: implemented-entry=Icu_GetTimeElapsed
        Icu_GetTimestampIndex: implemented-entry=Icu_GetTimestampIndex
        Icu_GetVersionInfo: implemented-entry=Icu_GetVersionInfo
        Icu_Init: can-enter-exclusive-area=[ICU_EXCLUSIVE_AREA_00, ICU_EXCLUSIVE_AREA_01, ICU_EXCLUSIVE_AREA_02, ICU_EXCLUSIVE_AREA_03, ICU_EXCLUSIVE_AREA_04, ICU_EXCLUSIVE_AREA_05, ICU_EXCLUSIVE_AREA_06, ICU_EXCLUSIVE_AREA_07, ICU_EXCLUSIVE_AREA_08, ICU_EXCLUSIVE_AREA_09, ICU_EXCLUSIVE_AREA_10, ICU_EXCLUSIVE_AREA_11, ICU_EXCLUSIVE_AREA_12, ICU_EXCLUSIVE_AREA_13, ICU_EXCLUSIVE_AREA_14, ICU_EXCLUSIVE_AREA_15, ICU_EXCLUSIVE_AREA_16, ICU_EXCLUSIVE_AREA_17, ICU_EXCLUSIVE_AREA_18, ICU_EXCLUSIVE_AREA_19, ICU_EXCLUSIVE_AREA_20, ICU_EXCLUSIVE_AREA_21], implemented-entry=Icu_Init
        Icu_LLD_GetChannelClockMode: implemented-entry=Icu_LLD_GetChannelClockMode
        Icu_ResetEdgeCount: implemented-entry=Icu_ResetEdgeCount
        Icu_SetActivationCondition: implemented-entry=Icu_SetActivationCondition
        Icu_SetMode: implemented-entry=Icu_SetMode
        Icu_StartSignalMeasurement: implemented-entry=Icu_StartSignalMeasurement
        Icu_StartTimestamp: implemented-entry=Icu_StartTimestamp
        Icu_StopSignalMeasurement: implemented-entry=Icu_StopSignalMeasurement
        Icu_StopTimestamp: implemented-entry=Icu_StopTimestamp
      4 x bsw interrupt entity, all with interrupt-category=CAT-2, interrupt-source=Hardware:
        SIUL_EXT_IRQ_0_7_ISR: implemented-entry=SIUL_EXT_IRQ_0_7_ISR
        SIUL_EXT_IRQ_16_23_ISR: implemented-entry=SIUL_EXT_IRQ_16_23_ISR
        SIUL_EXT_IRQ_24_31_ISR: implemented-entry=SIUL_EXT_IRQ_24_31_ISR
        SIUL_EXT_IRQ_8_15_ISR: implemented-entry=SIUL_EXT_IRQ_8_15_ISR
package /AUTOSAR_Icu/BswModuleEntrys
  53 x bsw module entry, all with sw-service-impl-policy=STANDARD:
    *: service-id=0, is-reentrant=false, is-synchronous=true, call-type=REGULAR, execution-context=UNSPECIFIED
    Icu_CheckWakeup: service-id=0x15, is-reentrant=true, is-synchronous=true, call-type=REGULAR, execution-context=UNSPECIFIED
    Icu_DeInit: service-id=0x01, is-reentrant=false, is-synchronous=true, call-type=REGULAR, execution-context=UNSPECIFIED
    Icu_DisableEdgeCount: service-id=0x0e, is-reentrant=true, is-synchronous=true, call-type=REGULAR, execution-context=UNSPECIFIED
    Icu_DisableEdgeDetection: service-id=0x17, is-reentrant=true, is-synchronous=true, call-type=REGULAR, execution-context=UNSPECIFIED
    Icu_DisableNotification: service-id=0x06, is-reentrant=true, is-synchronous=true, call-type=REGULAR, execution-context=UNSPECIFIED
    Icu_DisableWakeup: service-id=0x03, is-reentrant=true, is-synchronous=true, call-type=REGULAR, execution-context=UNSPECIFIED
    Icu_eMIOS_LLD_CheckOverflowFlag: service-id=0, is-reentrant=false, is-synchronous=true, call-type=REGULAR, execution-context=UNSPECIFIED
    Icu_eMIOS_LLD_DeInitChannel: service-id=0, is-reentrant=false, is-synchronous=true, call-type=REGULAR, execution-context=UNSPECIFIED
    Icu_eMIOS_LLD_DisableEdgeCount: service-id=0, is-reentrant=false, is-synchronous=true, call-type=REGULAR, execution-context=UNSPECIFIED
    Icu_eMIOS_LLD_DisableInterrupt: service-id=0, is-reentrant=false, is-synchronous=true, call-type=REGULAR, execution-context=UNSPECIFIED
    Icu_eMIOS_LLD_EnableInterrupt: service-id=0, is-reentrant=false, is-synchronous=true, call-type=REGULAR, execution-context=UNSPECIFIED
    Icu_eMIOS_LLD_GetCaptureRegA: service-id=0, is-reentrant=false, is-synchronous=true, call-type=REGULAR, execution-context=UNSPECIFIED
    Icu_eMIOS_LLD_GetCaptureRegB: service-id=0, is-reentrant=false, is-synchronous=true, call-type=REGULAR, execution-context=UNSPECIFIED
    Icu_eMIOS_LLD_GetEdgeNumbers: service-id=0, is-reentrant=false, is-synchronous=true, call-type=REGULAR, execution-context=UNSPECIFIED
    Icu_eMIOS_LLD_GetInputState: service-id=0, is-reentrant=false, is-synchronous=true, call-type=REGULAR, execution-context=UNSPECIFIED
    Icu_eMIOS_LLD_GetTimeStamp: service-id=0, is-reentrant=false, is-synchronous=true, call-type=REGULAR, execution-context=UNSPECIFIED
    Icu_eMIOS_LLD_InitChannel: service-id=0, is-reentrant=false, is-synchronous=true, call-type=REGULAR, execution-context=UNSPECIFIED
    Icu_eMIOS_LLD_ProcessInterrupt: service-id=0, is-reentrant=false, is-synchronous=true, call-type=REGULAR, execution-context=UNSPECIFIED
    Icu_eMIOS_LLD_ResetEdgeCount: service-id=0, is-reentrant=false, is-synchronous=true, call-type=REGULAR, execution-context=UNSPECIFIED
    Icu_eMIOS_LLD_SelectPrescaler: service-id=0, is-reentrant=false, is-synchronous=true, call-type=REGULAR, execution-context=UNSPECIFIED
    Icu_eMIOS_LLD_SetActivationCondition: service-id=0, is-reentrant=false, is-synchronous=true, call-type=REGULAR, execution-context=UNSPECIFIED
    Icu_eMIOS_LLD_SetNormalMode: service-id=0, is-reentrant=false, is-synchronous=true, call-type=REGULAR, execution-context=UNSPECIFIED
    Icu_eMIOS_LLD_SetSleepMode: service-id=0, is-reentrant=false, is-synchronous=true, call-type=REGULAR, execution-context=UNSPECIFIED
    Icu_eMIOS_LLD_StartSignalMeasurement: service-id=0, is-reentrant=false, is-synchronous=true, call-type=REGULAR, execution-context=UNSPECIFIED
    Icu_eMIOS_LLD_StartTimestamp: service-id=0, is-reentrant=false, is-synchronous=true, call-type=REGULAR, execution-context=UNSPECIFIED
    Icu_eMIOS_LLD_StopSignalMeasurement: service-id=0, is-reentrant=false, is-synchronous=true, call-type=REGULAR, execution-context=UNSPECIFIED
    Icu_eMIOS_LLD_StopTimestamp: service-id=0, is-reentrant=false, is-synchronous=true, call-type=REGULAR, execution-context=UNSPECIFIED
    Icu_eMIOS_LLD_UCSetMode: service-id=0, is-reentrant=false, is-synchronous=true, call-type=REGULAR, execution-context=UNSPECIFIED
    Icu_EnableEdgeCount: service-id=0x0d, is-reentrant=true, is-synchronous=true, call-type=REGULAR, execution-context=UNSPECIFIED
    Icu_EnableEdgeDetection: service-id=0x16, is-reentrant=true, is-synchronous=true, call-type=REGULAR, execution-context=UNSPECIFIED
    Icu_EnableNotification: service-id=0x07, is-reentrant=true, is-synchronous=true, call-type=REGULAR, execution-context=UNSPECIFIED
    Icu_EnableWakeup: service-id=0x04, is-reentrant=true, is-synchronous=true, call-type=REGULAR, execution-context=UNSPECIFIED
    Icu_GetCaptureRegisterValue: service-id=0, is-reentrant=false, is-synchronous=true, call-type=REGULAR, execution-context=UNSPECIFIED
    Icu_GetDutyCycleValues: service-id=0x11, is-reentrant=true, is-synchronous=true, call-type=REGULAR, execution-context=UNSPECIFIED
    Icu_GetEdgeNumbers: service-id=0x0f, is-reentrant=true, is-synchronous=false, call-type=REGULAR, execution-context=UNSPECIFIED
    Icu_GetInputState: service-id=0x08, is-reentrant=true, is-synchronous=true, call-type=REGULAR, execution-context=UNSPECIFIED
    Icu_GetTimeElapsed: service-id=0x10, is-reentrant=true, is-synchronous=true, call-type=REGULAR, execution-context=UNSPECIFIED
    Icu_GetTimestampIndex: service-id=0x0b, is-reentrant=true, is-synchronous=true, call-type=REGULAR, execution-context=UNSPECIFIED
    Icu_GetVersionInfo: service-id=0x12, is-reentrant=true, is-synchronous=true, call-type=REGULAR, execution-context=UNSPECIFIED
    Icu_Init: service-id=0x00, is-reentrant=false, is-synchronous=true, call-type=REGULAR, execution-context=UNSPECIFIED
    Icu_LLD_GetChannelClockMode: service-id=0, is-reentrant=false, is-synchronous=true, call-type=REGULAR, execution-context=UNSPECIFIED
    Icu_ResetEdgeCount: service-id=0x0c, is-reentrant=true, is-synchronous=true, call-type=REGULAR, execution-context=UNSPECIFIED
    Icu_SetActivationCondition: service-id=0x05, is-reentrant=true, is-synchronous=true, call-type=REGULAR, execution-context=UNSPECIFIED
    Icu_SetMode: service-id=0x02, is-reentrant=false, is-synchronous=true, call-type=REGULAR, execution-context=UNSPECIFIED
    Icu_StartSignalMeasurement: service-id=0x13, is-reentrant=true, is-synchronous=false, call-type=REGULAR, execution-context=UNSPECIFIED
    Icu_StartTimestamp: service-id=0x09, is-reentrant=true, is-synchronous=false, call-type=REGULAR, execution-context=UNSPECIFIED
    Icu_StopSignalMeasurement: service-id=0x14, is-reentrant=true, is-synchronous=true, call-type=REGULAR, execution-context=UNSPECIFIED
    Icu_StopTimestamp: service-id=0x0a, is-reentrant=true, is-synchronous=true, call-type=REGULAR, execution-context=UNSPECIFIED
    SIUL_EXT_IRQ_0_7_ISR: service-id=0, is-reentrant=false, is-synchronous=true, call-type=INTERRUPT, execution-context=INTERRUPT-CAT-2
    SIUL_EXT_IRQ_16_23_ISR: service-id=0, is-reentrant=false, is-synchronous=true, call-type=INTERRUPT, execution-context=INTERRUPT-CAT-2
    SIUL_EXT_IRQ_24_31_ISR: service-id=0, is-reentrant=false, is-synchronous=true, call-type=INTERRUPT, execution-context=INTERRUPT-CAT-2
    SIUL_EXT_IRQ_8_15_ISR: service-id=0, is-reentrant=false, is-synchronous=true, call-type=INTERRUPT, execution-context=INTERRUPT-CAT-2
package /Icu_T2D13M10I1R0/Implementations
  bsw implementation BswImplementation_Icu_43: programming-language=C, sw-version=1.0.1, vendor-id=43, ar-release-version=4.0.3, behavior=InternalBehavior_Icu_43, vendor-specific-module-def=Icu
    code-descriptors:
      code Files
        artifact-descriptors:
          short-label=config::Icu.xdm, category=SWCFG
          short-label=doc::AUTOSAR_MCAL_ICU_IM.pdf, category=SWDOC
          short-label=doc::AUTOSAR_MCAL_ICU_UM.pdf, category=SWDOC
          short-label=include::Dma_LLD.h, category=SWHDR
          short-label=include::Icu.h, category=SWHDR
          short-label=include::Icu_eMIOS_LLD.h, category=SWHDR
          short-label=include::Icu_eMIOS_LLD_CfgEx.h, category=SWHDR
          short-label=include::Icu_LLD.h, category=SWHDR
          short-label=include::Icu_NonASR.h, category=SWHDR
          short-label=include::Icu_Siul_LLD.h, category=SWHDR
          short-label=include::Icu_Siul_LLD_CfgEx.h, category=SWHDR
          short-label=include::Icu_WKPU_LLD.h, category=SWHDR
          short-label=include::Icu_WKPU_LLD_CfgEx.h, category=SWHDR
          short-label=include::Reg_eSys_DMA.h, category=SWHDR
          short-label=include::Reg_eSys_eMIOS.h, category=SWHDR
          short-label=include::Reg_eSys_eMIOS_CfgEx.h, category=SWHDR
          short-label=include::Reg_eSys_SIUL.h, category=SWHDR
          short-label=include::Reg_eSys_WKPU.h, category=SWHDR
          short-label=src::Icu.c, category=SWSRC
          short-label=src::Icu_Dma_LLD.c, category=SWSRC
          short-label=src::Icu_eMIOS_Irq.c, category=SWSRC
          short-label=src::Icu_eMIOS_LLD.c, category=SWSRC
          short-label=src::Icu_LLD.c, category=SWSRC
          short-label=src::Icu_NonASR.c, category=SWSRC
          short-label=src::Icu_Reg_eSys_eMIOS.c, category=SWSRC
          short-label=src::Icu_Siul_LLD.c, category=SWSRC
          short-label=src::Icu_Siul_LLD_IRQ.c, category=SWSRC
          short-label=src::Icu_WKPU_LLD.c, category=SWSRC
          short-label=src::Icu_WKPU_LLD_IRQ.c, category=SWSRC
    4 x compiler:
      CW_Compiler:
        name=CodeWarrior for MPC5xxx
        options=-proc Zen -lang c -opt all -common off -sdatathreshold 0 -sdata2threshold 0 -vle -use_lmw_stmw on -ppc_asm_to_vle -Cpp_exceptions off -func_align 4 -sym dwarf-2,full -gdwarf-2 -w on -r -w undefmacro -char unsigned -nosyspath -fp none -DAUTOSAR_OS_NOT_USED -DMWERKS
        vendor=Freescale Semiconductor
        version=Freescale CodeWarrior for MPC5xxx v2.10 - compiler Version 4.3 build 224
      HT_Compiler: name=Hi-Tech C Compiler, options=-Os -msdata=eabi -G1000 -fshort-double -mno-spe -mregnames -g3 -Wall -mvle --mcpu=z425n3 -DAUTOSAR_OS_NOT_USED -DUSE_SW_VECTOR_MODE, vendor=HiTech, version=HighTec v4.6.4.0, Compiler gcc v4.6.3
      DIAB_Compiler:
        name=Windriver Diab
        options=-Xdialect-ansi -XO -g -Xsize-opt -Xsmall-data=0 -Xaddr-sconst=0x11 -Xaddr-sdata=0x11 -Xno-common -Xnested-interrupts -Xdebug-dwarf2 -Xdebug-local-all -Xdebug-local-cie -Xdebug-struct-all -Xforce-declarations -ee1481 -Xmacro-undefined-warn -W:as:,-l -Wa,-Xisa-vle -DAUTOSAR_OS_NOT_USED -DDIAB -Xforce-prototypes -tPPCE200Z0VEN:simple
        vendor=Windriver
        version=Windriver DIAB Rel DIAB_5_9_2_0-FCS_20120725_234511
      GHS_Compiler: name=Green Hills, options=-cpu=ppc560xb -ansi -noSPE -Ospace -sda=0 -vle -dual_debug -G --no_exceptions -Wundef -Wimplicit-int -Wshadow -Wtrigraphs --prototype_errors --incorrect_pragma_warnings -noslashcomment -preprocess_assembly_files --short_enum --no_commons -c -DAUTOSAR_OS_NOT_USED -DUSE_SW_VECTOR_MODE -DDISABLE_MCAL_INTERMODULE_ASR_CHECK -DGHS, vendor=Green Hills, version=Green Hills MULTI v6.1.4
    generated-artifacts:
      dependency on artifact Icu_PBcfg_c: artifact-descriptor={short-label=generate_PB::src::Icu_PBcfg.c, category=SWSRC}, usages=COMPILE
      dependency on artifact Icu_Cfg_h: artifact-descriptor={short-label=generate_PC::include::Icu_Cfg.h, category=SWHDR}, usages=COMPILE
      dependency on artifact Icu_Cfg_c: artifact-descriptor={short-label=generate_PC::src::Icu_Cfg.c, category=SWSRC}, usages=COMPILE
    4 x linker:
      CW_Linker: name=CodeWarrior for MPC5xxx, options=-proc Zen -code_merging all -far_near_addressing -vle_enhance_merging -listdwarf -sym dwarf-2,full -char unsigned, vendor=Freescale Semiconductor, version=Freescale CodeWarrior for MPC5xxx v2.10 - compiler Version 4.3 build 224
      HT_Linker: name=Hi-Tech C Compiler, options=-N --no-undefined --warn-common --error-unresolved-symbols -nocrt0 -nostartfiles -Wl --no-warn-flags -T, vendor=HiTech, version=HighTec v4.6.4.0, Compiler gcc v4.6.3
      DIAB_Linker: name=Windriver Diab, options=-tPPCE200Z0VEN:simple -Xelf -m6 -lc -Xlibc-old, vendor=Windriver, version=Windriver DIAB Rel DIAB_5_9_2_0-FCS_20120725_234511
      GHS_Linker: name=Green Hills, options=-cpu=ppc560xb -nostartfiles -vle -linker_warnings, vendor=Green Hills, version=Green Hills MULTI v6.1.4
    resource consumption ResourceConsumption
      4 x memory section, all with alignment=UNSPECIFIED:
        ICU_CODE: sw-addrmethod=CODE, symbol=CODE
        ICU_CONFIG_DATA_UNSPECIFIED: sw-addrmethod=CONFIG_DATA_UNSPECIFIED, symbol=CONFIG_DATA_UNSPECIFIED
        ICU_VAR_INIT_UNSPECIFIED: sw-addrmethod=VAR_INIT_UNSPECIFIED, symbol=VAR_INIT_UNSPECIFIED
        ICU_VAR_NO_INIT_UNSPECIFIED: sw-addrmethod=VAR_NO_INIT_UNSPECIFIED, symbol=VAR_NO_INIT_UNSPECIFIED
