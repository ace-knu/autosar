AUTOSAR XML (schema 4-0-3)
package /ARPackage_Dem/EcuConfiuration
  bsw implementation BswImplementation_Dem: sw-version=1.0.5, swc-bsw-mapping=SwcBswMapping_Dem, vendor-id=76, ar-release-version=4.0.3, behavior=BswInternalBehaviors_Dem
  bsw module description Dem: module-id=54
    released-triggers:
      trigger ReleasedTrigger_ToNvM: sw-impl-policy=QUEUED
    bsw internal behavior BswInternalBehaviors_Dem
      9 x exclusive area:
        REQUEST_BUFFER_PROTECTION
        REQUEST_RECORD_PROTECTION
        REQUEST_STATUS_PROTECTION
        REQUEST_OCC_PROTECTION
        REQUEST_OCCTIME_PROTECTION
        REQUEST_NVDATA_PROTECTION
        CAPTURE_OBD_DATA
        REQUEST_DATA_PROTECTION
        REQUEST_DEBOUNCETIMEBASED
      bsw schedulable entity BswSE_Dem_MainFunction: can-enter-exclusive-area=[REQUEST_BUFFER_PROTECTION, REQUEST_RECORD_PROTECTION, REQUEST_STATUS_PROTECTION, REQUEST_OCC_PROTECTION, REQUEST_OCCTIME_PROTECTION, REQUEST_NVDATA_PROTECTION, CAPTURE_OBD_DATA, REQUEST_DATA_PROTECTION, REQUEST_DEBOUNCETIMEBASED], implemented-entry=Dem_MainFunction, issued-triggers=ReleasedTrigger_ToNvM
      bsw timing event BswTE_Dem_MainFunction: starts-on-event=BswSE_Dem_MainFunction, period=0.01
  bsw module entry Dem_MainFunction: service-id=55, is-reentrant=false, is-synchronous=false, call-type=SCHEDULED, execution-context=TASK, sw-service-impl-policy=STANDARD
