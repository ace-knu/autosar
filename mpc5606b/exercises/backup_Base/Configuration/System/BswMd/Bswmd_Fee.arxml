AUTOSAR XML (schema 4-0-3)
package /AUTOSAR_Fee/BswModuleDescriptions
  bsw module description Fee: module-id=21
    provided-entrys:
      Fee_Cancel
      Fee_EraseImmediateBlock
      Fee_ForceSwapOnNextWrite
      Fee_GetJobResult
      Fee_GetRunTimeInfo
      Fee_GetStatus
      Fee_GetVersionInfo
      Fee_Init
      Fee_InvalidateBlock
      Fee_JobEndNotification
      Fee_JobErrorNotification
      Fee_MainFunction
      Fee_Read
      Fee_SetMode
      Fee_Write
    bsw internal behavior InternalBehavior_0
      15 x bsw called entity:
        Fee_Cancel: implemented-entry=Fee_Cancel
        Fee_EraseImmediateBlock: implemented-entry=Fee_EraseImmediateBlock
        Fee_ForceSwapOnNextWrite: implemented-entry=Fee_ForceSwapOnNextWrite
        Fee_GetJobResult: implemented-entry=Fee_GetJobResult
        Fee_GetRunTimeInfo: implemented-entry=Fee_GetRunTimeInfo
        Fee_GetStatus: implemented-entry=Fee_GetStatus
        Fee_GetVersionInfo: implemented-entry=Fee_GetVersionInfo
        Fee_Init: implemented-entry=Fee_Init
        Fee_InvalidateBlock: implemented-entry=Fee_InvalidateBlock
        Fee_JobEndNotification: implemented-entry=Fee_JobEndNotification
        Fee_JobErrorNotification: implemented-entry=Fee_JobErrorNotification
        Fee_MainFunction: implemented-entry=Fee_MainFunction
        Fee_Read: implemented-entry=Fee_Read
        Fee_SetMode: implemented-entry=Fee_SetMode
        Fee_Write: implemented-entry=Fee_Write
package /AUTOSAR_Fee/BswModuleEntrys
  15 x bsw module entry, all with service-id=0, is-reentrant=false, is-synchronous=true, sw-service-impl-policy=STANDARD:
    Fee_Cancel: call-type=REGULAR, execution-context=UNSPECIFIED
    Fee_EraseImmediateBlock: call-type=REGULAR, execution-context=UNSPECIFIED
    Fee_ForceSwapOnNextWrite: call-type=REGULAR, execution-context=UNSPECIFIED
    Fee_GetJobResult: call-type=REGULAR, execution-context=UNSPECIFIED
    Fee_GetRunTimeInfo: call-type=REGULAR, execution-context=UNSPECIFIED
    Fee_GetStatus: call-type=REGULAR, execution-context=UNSPECIFIED
    Fee_GetVersionInfo: call-type=REGULAR, execution-context=UNSPECIFIED
    Fee_Init: call-type=REGULAR, execution-context=UNSPECIFIED
    Fee_InvalidateBlock: call-type=REGULAR, execution-context=UNSPECIFIED
    Fee_JobEndNotification: call-type=REGULAR, execution-context=UNSPECIFIED
    Fee_JobErrorNotification: call-type=REGULAR, execution-context=UNSPECIFIED
    Fee_MainFunction: call-type=SCHEDULED, execution-context=TASK
    Fee_Read: call-type=REGULAR, execution-context=UNSPECIFIED
    Fee_SetMode: call-type=REGULAR, execution-context=UNSPECIFIED
    Fee_Write: call-type=REGULAR, execution-context=UNSPECIFIED
package /Fee_T2D13M10I1R0/Implementations
  bsw implementation BswImplementation_Fee: programming-language=C, sw-version=1.0.1, vendor-id=43, ar-release-version=4.0.3, behavior=InternalBehavior_0, vendor-specific-module-def=Fee
    code-descriptors:
      code Files
        artifact-descriptors:
          short-label=config::Fee.xdm, category=SWCFG
          short-label=doc::AUTOSAR_MCAL_FEE_IM.pdf, category=SWDOC
          short-label=doc::AUTOSAR_MCAL_FEE_UM.pdf, category=SWDOC
          short-label=include::Fee.h, category=SWHDR
          short-label=include::Fee_Cbk.h, category=SWHDR
          short-label=include::Fee_InternalTypes.h, category=SWHDR
          short-label=include::Fee_Types.h, category=SWHDR
          short-label=include::Fee_Version.h, category=SWHDR
          short-label=src::Fee.c, category=SWSRC
    4 x compiler:
      CW_Compiler:
        name=CodeWarrior for MPC5xxx
        options=-proc Zen -lang c -opt all -common off -sdatathreshold 0 -sdata2threshold 0 -vle -use_lmw_stmw on -ppc_asm_to_vle -Cpp_exceptions off -func_align 4 -sym dwarf-2,full -gdwarf-2 -w on -r -w undefmacro -char unsigned -nosyspath -fp none -DAUTOSAR_OS_NOT_USED -DMWERKS
        vendor=Freescale Semiconductor
        version=Freescale CodeWarrior for MPC5xxx v2.10 - compiler Version 4.3 build 224
      HT_Compiler: name=Hi-Tech C Compiler, options=-Os -msdata=eabi -G1000 -fshort-double -mno-spe -mregnames -g3 -Wall -mvle --mcpu=z425n3 -DAUTOSAR_OS_NOT_USED -DUSE_SW_VECTOR_MODE, vendor=HiTech, version=HighTec v4.6.4.0, Compiler gcc v4.6.3
      DIAB_Compiler:
        name=Windriver Diab
        options=-Xdialect-ansi -XO -g -Xsize-opt -Xsmall-data=0 -Xaddr-sconst=0x11 -Xaddr-sdata=0x11 -Xno-common -Xnested-interrupts -Xdebug-dwarf2 -Xdebug-local-all -Xdebug-local-cie -Xdebug-struct-all -Xforce-declarations -ee1481 -Xmacro-undefined-warn -W:as:,-l -Wa,-Xisa-vle -DAUTOSAR_OS_NOT_USED -DDIAB -Xforce-prototypes -tPPCE200Z0VEN:simple
        vendor=Windriver
        version=Windriver DIAB Rel DIAB_5_9_2_0-FCS_20120725_234511
      GHS_Compiler: name=Green Hills, options=-cpu=ppc560xb -ansi -noSPE -Ospace -sda=0 -vle -dual_debug -G --no_exceptions -Wundef -Wimplicit-int -Wshadow -Wtrigraphs --prototype_errors --incorrect_pragma_warnings -noslashcomment -preprocess_assembly_files --short_enum --no_commons -c -DAUTOSAR_OS_NOT_USED -DUSE_SW_VECTOR_MODE -DDISABLE_MCAL_INTERMODULE_ASR_CHECK -DGHS, vendor=Green Hills, version=Green Hills MULTI v6.1.4
    generated-artifacts:
      dependency on artifact Fee_Cfg_h: artifact-descriptor={short-label=generate::include::Fee_Cfg.h, category=SWHDR}, usages=COMPILE
      dependency on artifact Fee_Cfg_c: artifact-descriptor={short-label=generate::src::Fee_Cfg.c, category=SWSRC}, usages=COMPILE
    4 x linker:
      CW_Linker: name=CodeWarrior for MPC5xxx, options=-proc Zen -code_merging all -far_near_addressing -vle_enhance_merging -listdwarf -sym dwarf-2,full -char unsigned, vendor=Freescale Semiconductor, version=Freescale CodeWarrior for MPC5xxx v2.10 - compiler Version 4.3 build 224
      HT_Linker: name=Hi-Tech C Compiler, options=-N --no-undefined --warn-common --error-unresolved-symbols -nocrt0 -nostartfiles -Wl --no-warn-flags -T, vendor=HiTech, version=HighTec v4.6.4.0, Compiler gcc v4.6.3
      DIAB_Linker: name=Windriver Diab, options=-tPPCE200Z0VEN:simple -Xelf -m6 -lc -Xlibc-old, vendor=Windriver, version=Windriver DIAB Rel DIAB_5_9_2_0-FCS_20120725_234511
      GHS_Linker: name=Green Hills, options=-cpu=ppc560xb -nostartfiles -vle -linker_warnings, vendor=Green Hills, version=Green Hills MULTI v6.1.4
    resource consumption ResourceConsumption
      6 x memory section:
        FEE_CODE: alignment=UNSPECIFIED, sw-addrmethod=CODE, symbol=CODE
        FEE_CONFIG_DATA_UNSPECIFIED: alignment=UNSPECIFIED, sw-addrmethod=CONFIG_DATA_UNSPECIFIED, symbol=CONFIG_DATA_UNSPECIFIED
        FEE_VAR_INIT_16: alignment=16, sw-addrmethod=VAR_INIT_16, symbol=VAR_INIT_16
        FEE_VAR_INIT_8: alignment=8, sw-addrmethod=VAR_INIT_8, symbol=VAR_INIT_8
        FEE_VAR_INIT_UNSPECIFIED: alignment=UNSPECIFIED, sw-addrmethod=VAR_INIT_UNSPECIFIED, symbol=VAR_INIT_UNSPECIFIED
        FEE_VAR_NO_INIT_UNSPECIFIED: alignment=UNSPECIFIED, sw-addrmethod=VAR_NO_INIT_UNSPECIFIED, symbol=VAR_NO_INIT_UNSPECIFIED
