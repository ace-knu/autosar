AUTOSAR XML (schema 4-0-3)
package /AUTOSAR_Fls/BswModuleDescriptions
  bsw module description Fls: module-id=92
    provided-entrys:
      Fls_Cancel
      Fls_Compare
      Fls_Erase
      Fls_GetJobResult
      Fls_GetStatus
      Fls_GetVersionInfo
      Fls_Init
      Fls_MainFunction
      Fls_Read
      Fls_SetMode
      Fls_Write
    bsw internal behavior InternalBehavior_0
      10 x exclusive area:
        FLS_EXCLUSIVE_AREA_{00..08}
        FLS_EXCLUSIVE_AREA_10
      11 x bsw called entity:
        Fls_Cancel: implemented-entry=Fls_Cancel
        Fls_Compare: implemented-entry=Fls_Compare
        Fls_Erase: implemented-entry=Fls_Erase
        Fls_GetJobResult: implemented-entry=Fls_GetJobResult
        Fls_GetStatus: implemented-entry=Fls_GetStatus
        Fls_GetVersionInfo: implemented-entry=Fls_GetVersionInfo
        Fls_Init: can-enter-exclusive-area=[FLS_EXCLUSIVE_AREA_00, FLS_EXCLUSIVE_AREA_01, FLS_EXCLUSIVE_AREA_02, FLS_EXCLUSIVE_AREA_03, FLS_EXCLUSIVE_AREA_04, FLS_EXCLUSIVE_AREA_05, FLS_EXCLUSIVE_AREA_06, FLS_EXCLUSIVE_AREA_07, FLS_EXCLUSIVE_AREA_08, FLS_EXCLUSIVE_AREA_10], implemented-entry=Fls_Init
        Fls_MainFunction: implemented-entry=Fls_MainFunction
        Fls_Read: implemented-entry=Fls_Read
        Fls_SetMode: implemented-entry=Fls_SetMode
        Fls_Write: implemented-entry=Fls_Write
package /AUTOSAR_Fls/BswModuleEntrys
  11 x bsw module entry, all with sw-service-impl-policy=STANDARD:
    Fls_Cancel: service-id=0x03, is-reentrant=false, is-synchronous=true, call-type=REGULAR, execution-context=UNSPECIFIED
    Fls_Compare: service-id=0x08, is-reentrant=false, is-synchronous=false, call-type=REGULAR, execution-context=UNSPECIFIED
    Fls_Erase: service-id=0x01, is-reentrant=false, is-synchronous=false, call-type=REGULAR, execution-context=UNSPECIFIED
    Fls_GetJobResult: service-id=0x05, is-reentrant=true, is-synchronous=true, call-type=REGULAR, execution-context=UNSPECIFIED
    Fls_GetStatus: service-id=0x04, is-reentrant=true, is-synchronous=true, call-type=REGULAR, execution-context=UNSPECIFIED
    Fls_GetVersionInfo: service-id=0x10, is-reentrant=true, is-synchronous=true, call-type=REGULAR, execution-context=UNSPECIFIED
    Fls_Init: service-id=0x00, is-reentrant=false, is-synchronous=true, call-type=REGULAR, execution-context=UNSPECIFIED
    Fls_MainFunction: service-id=0x06, is-reentrant=false, is-synchronous=true, call-type=SCHEDULED, execution-context=TASK
    Fls_Read: service-id=0x07, is-reentrant=false, is-synchronous=false, call-type=REGULAR, execution-context=UNSPECIFIED
    Fls_SetMode: service-id=0x09, is-reentrant=false, is-synchronous=true, call-type=REGULAR, execution-context=UNSPECIFIED
    Fls_Write: service-id=0x02, is-reentrant=false, is-synchronous=false, call-type=REGULAR, execution-context=UNSPECIFIED
package /Fls_T2D13M10I1R0/Implementations
  bsw implementation BswImplementation_Fls: programming-language=C, sw-version=1.0.1, vendor-id=43, ar-release-version=4.0.3, behavior=InternalBehavior_0, vendor-specific-module-def=Fls
    code-descriptors:
      code Files
        artifact-descriptors:
          short-label=config::Fls.xdm, category=SWCFG
          short-label=doc::AUTOSAR_MCAL_FLS_IM.pdf, category=SWDOC
          short-label=doc::AUTOSAR_MCAL_FLS_UM.pdf, category=SWDOC
          short-label=include::Fls.h, category=SWHDR
          short-label=include::Fls_Api.h, category=SWHDR
          short-label=include::Fls_InternalTypes.h, category=SWHDR
          short-label=include::Fls_Types.h, category=SWHDR
          short-label=include::Fls_Version.h, category=SWHDR
          short-label=include::Reg_eSys_FLASHC.h, category=SWHDR
          short-label=src::Fls.c, category=SWSRC
          short-label=src::Fls_Ac.c, category=SWSRC
    4 x compiler:
      CW_Compiler:
        name=CodeWarrior for MPC5xxx
        options=-proc Zen -lang c -opt all -common off -sdatathreshold 0 -sdata2threshold 0 -vle -use_lmw_stmw on -ppc_asm_to_vle -Cpp_exceptions off -func_align 4 -sym dwarf-2,full -gdwarf-2 -w on -r -w undefmacro -char unsigned -nosyspath -fp none -DAUTOSAR_OS_NOT_USED -DMWERKS
        vendor=Freescale Semiconductor
        version=Freescale CodeWarrior for MPC5xxx v2.10 - compiler Version 4.3 build 224
      HT_Compiler: name=Hi-Tech C Compiler, options=-Os -msdata=eabi -G1000 -fshort-double -mno-spe -mregnames -g3 -Wall -mvle --mcpu=z425n3 -DAUTOSAR_OS_NOT_USED -DUSE_SW_VECTOR_MODE, vendor=HiTech, version=HighTec v4.6.4.0, Compiler gcc v4.6.3
      DIAB_Compiler:
        name=Windriver Diab
        options=-Xdialect-ansi -XO -g -Xsize-opt -Xsmall-data=0 -Xaddr-sconst=0x11 -Xaddr-sdata=0x11 -Xno-common -Xnested-interrupts -Xdebug-dwarf2 -Xdebug-local-all -Xdebug-local-cie -Xdebug-struct-all -Xforce-declarations -ee1481 -Xmacro-undefined-warn -W:as:,-l -Wa,-Xisa-vle -DAUTOSAR_OS_NOT_USED -DDIAB -Xforce-prototypes -tPPCE200Z0VEN:simple
        vendor=Windriver
        version=Windriver DIAB Rel DIAB_5_9_2_0-FCS_20120725_234511
      GHS_Compiler: name=Green Hills, options=-cpu=ppc560xb -ansi -noSPE -Ospace -sda=0 -vle -dual_debug -G --no_exceptions -Wundef -Wimplicit-int -Wshadow -Wtrigraphs --prototype_errors --incorrect_pragma_warnings -noslashcomment -preprocess_assembly_files --short_enum --no_commons -c -DAUTOSAR_OS_NOT_USED -DUSE_SW_VECTOR_MODE -DDISABLE_MCAL_INTERMODULE_ASR_CHECK -DGHS, vendor=Green Hills, version=Green Hills MULTI v6.1.4
    generated-artifacts:
      dependency on artifact Fls_Cfg_h: artifact-descriptor={short-label=generate::include::Fls_Cfg.h, category=SWHDR}, usages=COMPILE
      dependency on artifact Fls_Cfg_c: artifact-descriptor={short-label=generate::src::Fls_Cfg.c, category=SWSRC}, usages=COMPILE
      dependency on artifact Fls_PBcfg_c: artifact-descriptor={short-label=generate::src::Fls_PBcfg.c, category=SWSRC}, usages=COMPILE
    4 x linker:
      CW_Linker: name=CodeWarrior for MPC5xxx, options=-proc Zen -code_merging all -far_near_addressing -vle_enhance_merging -listdwarf -sym dwarf-2,full -char unsigned, vendor=Freescale Semiconductor, version=Freescale CodeWarrior for MPC5xxx v2.10 - compiler Version 4.3 build 224
      HT_Linker: name=Hi-Tech C Compiler, options=-N --no-undefined --warn-common --error-unresolved-symbols -nocrt0 -nostartfiles -Wl --no-warn-flags -T, vendor=HiTech, version=HighTec v4.6.4.0, Compiler gcc v4.6.3
      DIAB_Linker: name=Windriver Diab, options=-tPPCE200Z0VEN:simple -Xelf -m6 -lc -Xlibc-old, vendor=Windriver, version=Windriver DIAB Rel DIAB_5_9_2_0-FCS_20120725_234511
      GHS_Linker: name=Green Hills, options=-cpu=ppc560xb -nostartfiles -vle -linker_warnings, vendor=Green Hills, version=Green Hills MULTI v6.1.4
    resource consumption ResourceConsumption
      11 x memory section:
        FLS_CODE: alignment=UNSPECIFIED, sw-addrmethod=CODE, symbol=CODE
        FLS_CODE_AC: alignment=AC, sw-addrmethod=CODE_AC, symbol=CODE_AC
        FLS_CONFIG_DATA_8: alignment=8, sw-addrmethod=CONFIG_DATA_8, symbol=CONFIG_DATA_8
        FLS_CONFIG_DATA_UNSPECIFIED: alignment=UNSPECIFIED, sw-addrmethod=CONFIG_DATA_UNSPECIFIED, symbol=CONFIG_DATA_UNSPECIFIED
        FLS_CONST_32: alignment=32, sw-addrmethod=CONST_32, symbol=CONST_32
        FLS_CONST_UNSPECIFIED: alignment=UNSPECIFIED, sw-addrmethod=CONST_UNSPECIFIED, symbol=CONST_UNSPECIFIED
        FLS_RAMCODE: alignment=UNSPECIFIED, sw-addrmethod=RAMCODE, symbol=RAMCODE
        FLS_VAR_INIT_32: alignment=32, sw-addrmethod=VAR_INIT_32, symbol=VAR_INIT_32
        FLS_VAR_INIT_8: alignment=8, sw-addrmethod=VAR_INIT_8, symbol=VAR_INIT_8
        FLS_VAR_INIT_BOOLEAN: alignment=BOOLEAN, sw-addrmethod=VAR_INIT_BOOLEAN, symbol=VAR_INIT_BOOLEAN
        FLS_VAR_INIT_UNSPECIFIED: alignment=UNSPECIFIED, sw-addrmethod=VAR_INIT_UNSPECIFIED, symbol=VAR_INIT_UNSPECIFIED
