AUTOSAR XML (schema 00048)
package /DataTypes/ApAppError
  ap application error GenericFailure: error-code=12, error-domain=GenericErrors  # Generic failure
package /DataTypes/ApAppErrorDomain
  ap application error domain GenericErrors: value=45
    namespaces:
      symbol props ara
      symbol props com
      symbol props sample
package /DataTypes/DataType/IDT
  std cpp implementation data type ByteArray: category=VECTOR, cpp-template-argument=uint8_t, type-emitter=TYPE_EMITTER_ARA
  std cpp implementation data type RadarObjects: category=STRUCTURE, type-emitter=TYPE_EMITTER_ARA
    namespaces:
      symbol props ara
      symbol props com
      symbol props sample
    cpp implementation data type element active: type-reference=bool
    cpp implementation data type element objectVector: type-reference=ByteArray
  std cpp implementation data type UnsignedInt: type-emitter=TYPE_EMITTER_ARA, type-reference=uint16_t
    namespaces:
      symbol props ara
      symbol props com
      symbol props sample
