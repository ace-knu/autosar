AUTOSAR XML (schema 00048)
package /Machine
  ethernet cluster EthernetCluster_ECU: protocol-name=EthernetCluster_ECU_Protocol_1
    ethernet physical channel EthernetPhysicalChannel_1: comm-connectors=Connector_ECU
      network endpoint NwEndpoint_ECU: network-endpoint-addresses=ipv-4-configuration={default-gateway=172.17.0.1, ip-address-keep-behavior=FORGET, ipv-4-address=172.17.0.2, ipv-4-address-source=DHCPV-4, network-mask=255.255.255.0}
      network endpoint NwEndpoint_SD_ECU: network-endpoint-addresses=ipv-4-configuration={ip-address-keep-behavior=FORGET, ipv-4-address=224.244.224.245, ipv-4-address-source=DHCPV-4}
  machine design MachineDesign_ECU: access-control=MODELED, pn-reset-timer=0.0, service-discover-configs=someip-service-discovery={multicast-sd-ip-address=NwEndpoint_SD_ECU, someip-service-discovery-port=30490}
    ethernet communication connector Connector_ECU: path-mtu-enabled=true, unicast-network-endpoint=NwEndpoint_ECU
  machine Machine_ECU: default-application-timeout=exit-timeout-value=1.0, machine-design=MachineDesign_ECU, trusted-platform-executable-launch-behavior=MONITOR-MODE
    function-groups:
      mode declaration group prototype MachineState: type=Machine_ECU_MachineState_ModeDeclarationGroup
    os module instantiation OsModuleInst
      resource group ResourceGroup_1: cpu-usage=95, mem-usage=2000000000
    processor Processor_1
      4 x processor core:
        Processor_1_Core_{0..3}: core-id={0..3}
  mode declaration group Machine_ECU_MachineState_ModeDeclarationGroup
    6 x mode:
      Driving
      Off
      Parking
      Restart
      Shutdown
      Startup
