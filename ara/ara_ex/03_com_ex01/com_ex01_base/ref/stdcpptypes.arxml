AUTOSAR XML (schema 00048)
package /AUTOSAR/StdTypes
  14 x std cpp implementation data type:
    bool: category=VALUE
    float: category=VALUE
    double: category=VALUE
    int8_t: category=VALUE, type-emitter=cstdint
    int16_t: category=VALUE, type-emitter=cstdint
    int32_t: category=VALUE, type-emitter=cstdint
    int64_t: category=VALUE, type-emitter=cstdint
    uint8_t: category=VALUE, type-emitter=cstdint
    uint16_t: category=VALUE, type-emitter=cstdint
    uint32_t: category=VALUE, type-emitter=cstdint
    uint64_t: category=VALUE, type-emitter=cstdint
    String: category=STRING, type-emitter=TYPE_EMITTER_ARA
    ByteArray: category=VECTOR, cpp-template-argument=uint8_t, type-emitter=TYPE_EMITTER_ARA
    ByteVectorType: category=VECTOR, cpp-template-argument=uint8_t, type-emitter=TYPE_EMITTER_ARA
