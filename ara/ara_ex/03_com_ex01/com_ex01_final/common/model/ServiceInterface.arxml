AUTOSAR XML (schema 00048)
package /ServiceInterface/Interface
  service interface radar
    namespaces:
      symbol props ara
      symbol props com
      symbol props sample
    events:
      data brakeEvent: type=RadarObjects
      data parkingBrakeEvent: type=RadarObjects
    4 x field:
      FrontObjectDistance: type=uint16_t, has-getter=false, has-notifier=true, has-setter=false
      ObjectDetectionLimit: type=uint16_t, has-getter=false, has-notifier=false, has-setter=true
      RearObjectDistance: type=uint16_t, has-getter=true, has-notifier=false, has-setter=false
      UpdateRate: type=uint32_t, has-getter=true, has-notifier=true, has-setter=true
    methods:
      5 x operation:
        Adjust: fire-and-forget=false
          arg target_position: type=Position, direction=IN
          arg success: type=bool, direction=OUT
          arg effective_position: type=Position, direction=OUT
        Calibrate: fire-and-forget=false, possible-ap-error=InvalidConfigString
          arg configuration: type=String, direction=IN
          arg variant: type=FusionVariant, direction=IN
          arg result: type=bool, direction=OUT
        Echo: fire-and-forget=true
          arg text: type=String, direction=IN
        testDouble: fire-and-forget=false
          arg in1: type=double, direction=IN
          arg out: type=double, direction=OUT
        testFloat: fire-and-forget=false
          arg in1: type=float, direction=IN
          arg out: type=float, direction=OUT
