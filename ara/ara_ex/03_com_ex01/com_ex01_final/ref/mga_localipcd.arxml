AUTOSAR XML (schema 00048)
package /mga_localipcd/Executable
  executable mga_localipcdExe: category=PLATFORM_LEVEL, build-type=BUILD-TYPE-DEBUG, logging-behavior=USES-LOGGING, reporting-behavior=REPORTS-EXECUTION-STATE
package /mga_localipcd/Process
  mode declaration group Process_1_ProcessStateMachine_ModeDeclarationGroup
    mode Running
    mode Terminated
  startup config set localipc_daemon_startupConfigSet
    startup config localipc_daemon_startup: scheduling-policy=SCHEDULING-POLICY-FIFO, scheduling-priority=15, timeout={enter-timeout-value=5.0, exit-timeout-value=5.0}
  process mga_localipcd:
    design=mga_localipcdDesign
    executable=mga_localipcdExe
    log-trace-default-log-level=INFO
    log-trace-file-path=/tmp/mobilgene/mga_localipcd/log
    log-trace-log-modes=[CONSOLE, FILE]
    log-trace-process-desc=Local IPC Daemon
    log-trace-process-id=ACLD
    state-dependent-startup-config{execution-dependency=ProcessStateMachine.Running, function-group-state=[MachineState.Driving, MachineState.Parking, MachineState.Startup], startup-config=localipc_daemon_startup}
    process state machine ProcessStateMachine: type=Process_1_ProcessStateMachine_ModeDeclarationGroup
  process design mga_localipcdDesign: executable=mga_localipcdExe
