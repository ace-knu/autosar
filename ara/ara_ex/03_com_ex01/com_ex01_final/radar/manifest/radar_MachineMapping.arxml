AUTOSAR XML (schema 00048)
package /radar/InstanceToMachineMapping
  someip service instance to machine mapping radar_ProvidedServiceInstance_toMachine: communication-connector=Connector_ECU, service-instance=radar_ProvidedSomeipServiceInstance, udp-port=5000
package /radar/ProcessToMachineMappingSet
  process to machine mapping set Machine_ECUMapping
    process to machine mapping radarMapping: machine=Machine_ECU, process=radarService_Process
