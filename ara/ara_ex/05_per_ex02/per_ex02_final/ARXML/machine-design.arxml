AUTOSAR XML (schema 00048)
package /mobilgene/softwarecluster
  software cluster Per_Kvs_SW: contained-process=PerExampleKvs, vendor-id=0, version=1.2.3.4
  software cluster Per_Test_SW_cluster: contained-process=[StateManagerProc, someipd, TrainingPer], design=softwareclusterdesign, version=1.00.00.0000
  software cluster design softwareclusterdesign: contained-process=PerProcDesign
package /Machine
  ethernet cluster Eth: protocol-name=Eth_ECC
    ethernet physical channel EthCh1: comm-connectors=EthernetConnector
      network endpoint NetworkEndpointEcu1: network-endpoint-addresses=ipv-4-configuration={default-gateway=192.168.100.1, ip-address-keep-behavior=FORGET, ipv-4-address=192.168.100.5, ipv-4-address-source=FIXED, network-mask=255.255.255.0}
      network endpoint SdMulticastEndpoint: network-endpoint-addresses=ipv-4-configuration=ipv-4-address=239.192.255.251
  machine design MachineDesign_ECU: access-control=MODELED, service-discover-configs=someip-service-discovery={multicast-sd-ip-address=SdMulticastEndpoint, someip-service-discovery-port=30490}
    ethernet communication connector EthernetConnector: path-mtu-enabled=true, unicast-network-endpoint=NetworkEndpointEcu1
  machine Machine_ECU: default-application-timeout={enter-timeout-value=1.0, exit-timeout-value=1.0}, machine-design=MachineDesign_ECU, trusted-platform-executable-launch-behavior=STRICT-MODE
    function-groups:
      mode declaration group prototype MachineState: type=Machine_ECU_MachineState_ModeDeclarationGroup
  mode declaration group Machine_ECU_MachineState_ModeDeclarationGroup: initial-mode=Startup
    6 x mode:
      Driving: value=4
      Off: value=0
      Parking: value=5
      Restart: value=3
      Shutdown: value=2
      Startup: value=1
