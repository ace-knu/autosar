AUTOSAR XML (schema 00048)
package /mobilgene/perdemo
  process PerExampleKvs: design=PerExampleKvsDesign, executable=PerExampleKvsEx, log-trace-default-log-level=INFO, log-trace-log-modes=CONSOLE, log-trace-process-desc=Internal persistency debug context, log-trace-process-id=APEK, state-dependent-startup-config{function-group-state=[MachineState.Driving, MachineState.Parking, MachineState.Startup], startup-config=StartupConfig_1}
    process state machine ProcessStateMachine: type=PerExampleKvs_ProcessStateMachine_ModeDeclarationGroup
  process design PerExampleKvsDesign: executable=PerExampleKvsEx
  executable PerExampleKvsEx: category=APPLICATION_LEVEL, build-type=BUILD-TYPE-DEBUG, logging-behavior=USES-LOGGING, reporting-behavior=REPORTS-EXECUTION-STATE
    root sw component prototype RootSwComponent: application-type=SwComponent_PerExampleKvs
  mode declaration group PerExampleKvs_ProcessStateMachine_ModeDeclarationGroup
    mode Running
    mode Terminated
  process to machine mapping set ProcessToMachineMapppingSet_1
    process to machine mapping ProcessToMachineMap_1: machine=Machine_ECU, process=PerExampleKvs
  startup config set StartupConfigSet1
    startup config StartupConfig_1: scheduling-policy=SCHEDULING-POLICY-FIFO, scheduling-priority=15
  adaptive application sw component type SwComponent_PerExampleKvs
