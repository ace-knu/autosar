AUTOSAR XML (schema 00048)
package /mobilgene/perdemo
  std cpp implementation data type String: category=STRING, type-emitter=TYPE_EMITTER_ARA
    namespaces:
      symbol props datatypes
package /mobilgene/perdemo/BaseTypes
  base type iso_8859_1: category=VARIABLE_LENGTH, base-type-encoding=ISO-8859-1
package /mobilgene/perdemo/ImplementationDataTypes
  4 x std cpp implementation data type, all with type-emitter=TYPE_EMITTER_ARA:
    DoubleVector: category=VECTOR, cpp-template-argument=double
    ErrorCode: category=STRUCTURE
      namespaces:
        symbol props datatypes
      cpp implementation data type element error_code_value: type-reference=int32_t
      cpp implementation data type element error_domain_id: type-reference=uint64_t
    STRINGUTF8DYNAMIC: category=STRING
      namespaces:
        symbol props datatypes
    SetStateData: category=STRUCTURE
      namespaces:
        symbol props datatypes
      cpp implementation data type element return_value_bsw: type-reference=uint8_t
