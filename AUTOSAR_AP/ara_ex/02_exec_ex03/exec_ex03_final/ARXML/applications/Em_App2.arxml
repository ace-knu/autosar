AUTOSAR XML (schema 00048)
package /mga/autoever/sample/em_app2
  process App2_instance1: design=App2_instance1Design, executable=Executable_App2, log-trace-default-log-level=INFO, log-trace-log-modes=CONSOLE, log-trace-process-desc=AP21 DLT, log-trace-process-id=AP21, state-dependent-startup-config{function-group-state=MachineState.Driving, resource-group=ResourceGroup_1, startup-config=StartupConfig_1}
    process state machine ProcessStateMachine: type=App2_instance1_ProcessStateMachine_ModeDeclarationGroup
  process design App2_instance1Design: executable=Executable_App2
  mode declaration group App2_instance1_ProcessStateMachine_ModeDeclarationGroup
    mode Running
    mode Terminated
  process App2_instance2: design=App2_instance2Design, executable=Executable_App2, log-trace-default-log-level=INFO, log-trace-log-modes=CONSOLE, log-trace-process-desc=AP22 DLT, log-trace-process-id=AP22, state-dependent-startup-config{execution-dependency=ProcessStateMachine.Running, function-group-state=MachineState.Parking, resource-group=ResourceGroup_1, startup-config=StartupConfig_2}
    process state machine ProcessStateMachine: type=App2_instance2_ProcessStateMachine_ModeDeclarationGroup
  process design App2_instance2Design: executable=Executable_App2
  mode declaration group App2_instance2_ProcessStateMachine_ModeDeclarationGroup
    mode Running
    mode Terminated
  executable Executable_App2: category=APPLICATION_LEVEL, build-type=BUILD-TYPE-DEBUG, logging-behavior=USES-LOGGING, reporting-behavior=REPORTS-EXECUTION-STATE
    root sw component prototype RootSwComponent: application-type=SWC_App2
  process to machine mapping set ProcessToMachineMappingSet_3
    process to machine mapping ProcessToMachineMap_1: machine=Machine_ECU, process=App2_instance1, shall-run-on=MachineProcessor_Core_0
    process to machine mapping ProcessToMachineMap_2: machine=Machine_ECU, process=App2_instance2, shall-not-run-on=MachineProcessor_Core_0
  adaptive application sw component type SWC_App2
  startup config set StartupConfigSet_App2
    startup config StartupConfig_1: scheduling-policy=SCHEDULING-POLICY-ROUND-ROBIN, scheduling-priority=20, startup-option{option-argument=FL, option-kind=COMMAND-LINE-LONG-FORM, option-name=POS}, timeout={enter-timeout-value=2.0, exit-timeout-value=2.0}
    startup config StartupConfig_2: scheduling-policy=SCHEDULING-POLICY-ROUND-ROBIN, scheduling-priority=20, startup-option{option-argument=POS=FL POS=FR, option-kind=COMMAND-LINE-SIMPLE-FORM}, timeout={enter-timeout-value=2.0, exit-timeout-value=2.0}
