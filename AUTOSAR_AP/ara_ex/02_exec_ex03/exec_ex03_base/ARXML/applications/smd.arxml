AUTOSAR XML (schema 00048)
package /mga/autoever/sample/smd
  executable Executable_SMD: category=APPLICATION_LEVEL, build-type=BUILD-TYPE-DEBUG, logging-behavior=USES-LOGGING, reporting-behavior=REPORTS-EXECUTION-STATE
    root sw component prototype RootSwComponent: application-type=SWC_SMD
  process to machine mapping set ProcessToMachineMappingSet_2
    process to machine mapping ProcessToMachineMap_1: machine=Machine_ECU, process=SMD, shall-run-on=MachineProcessor_Core_0
  process SMD: design=SMDDesign, executable=Executable_SMD, log-trace-default-log-level=INFO, log-trace-log-modes=CONSOLE, log-trace-process-desc=SMD DLT, log-trace-process-id=SMD, state-dependent-startup-config{function-group-state=[MachineState.Driving, MachineState.Parking, MachineState.Restart, MachineState.Shutdown, MachineState.Startup], resource-group=ResourceGroup_1, startup-config=StartupConfig_1}
    process state machine ProcessStateMachine: type=SMD_ProcessStateMachine_ModeDeclarationGroup
  process design SMDDesign: executable=Executable_SMD
  mode declaration group SMD_ProcessStateMachine_ModeDeclarationGroup
    mode Running
    mode Terminated
  adaptive application sw component type SWC_SMD
  startup config set StartupConfigSet_SMD
    startup config StartupConfig_1: scheduling-policy=SCHEDULING-POLICY-FIFO, scheduling-priority=15, timeout={enter-timeout-value=2.0, exit-timeout-value=2.0}
