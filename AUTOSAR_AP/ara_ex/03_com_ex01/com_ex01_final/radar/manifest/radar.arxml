AUTOSAR XML (schema 00048)
package /radar/Application/Executable
  executable radarServiceExe: category=APPLICATION_LEVEL, build-type=BUILD-TYPE-DEBUG, logging-behavior=USES-LOGGING, reporting-behavior=REPORTS-EXECUTION-STATE
    root sw component prototype RootSwComponent: application-type=radarService
package /radar/Application/Process
  process radarService_Process:
    design=radarService_ProcessDesign
    executable=radarServiceExe
    log-trace-default-log-level=INFO
    log-trace-file-path=/adar/install/var
    log-trace-log-modes=[CONSOLE, FILE]
    log-trace-process-desc=Com Sample Provider App IPC
    log-trace-process-id=ACRA
    state-dependent-startup-config{execution-dependency=ProcessStateMachine.Running, function-group-state=[MachineState.Restart, MachineState.Shutdown, MachineState.Startup], resource-group=ResourceGroup_1, startup-config=StartupConfig_1}
    process state machine ProcessStateMachine: type=radarService_Process_ProcessStateMachine_ModeDeclarationGroup
  mode declaration group radarService_Process_ProcessStateMachine_ModeDeclarationGroup
    mode Running
    mode Terminated
  startup config set radarconfig
    startup config StartupConfig_1: scheduling-policy=SCHEDULING-POLICY-FIFO, scheduling-priority=15
package /radar/Application/ProcessDesign
  process design radarService_ProcessDesign: executable=radarServiceExe
package /radar/Application/SwComponent
  adaptive application sw component type radarService
    provide port radar_PPort: provided-interface=radar
package /radar/Service/InstancePortMap
  service instance to port prototype mapping radar_ProvidedServiceInstance_toPort: port-prototype=radar_PPort, process=radarService_ProcessDesign, service-instance=radar_ProvidedSomeipServiceInstance
package /radar/Service/Someip/Instance
  someip sd server event group timing config ReqResDelay_1: request-response-delay={max-value=10.0, min-value=10.0}
  someip sd server event group timing config ReqResDelay_2: request-response-delay={max-value=10.0, min-value=10.0}
  provided someip service instance radar_ProvidedSomeipServiceInstance: service-interface-deployment=Someip_radarDep_1, sd-server-config=radar_SomeipServerServiceInstanceConfig, service-instance-id=19
    event-propss:
      Someip_brakeEventDep
      Someip_parkingBrakeEventDep
      Someip_FrontObjectDistanceDep_Notifier
      Someip_UpdateRateDep_Notifier
    method-response-propss:
      Someip_AdjustDep
      Someip_CalibrateDep
      Someip_testDoubleDep
      Someip_testFloatDep
      Someip_ObjectDetectionLimitDep_Setter
      Someip_RearObjectDistanceDep_Getter
      Someip_UpdateRateDep_Setter
      Someip_UpdateRateDep_Getter
    someip provided event group SomeipPEventGroup_1: event-group=EventGroup_1, event-multicast-udp-port=0, ipv-4-multicast-ip-address=0.0.0.0, ipv-6-multicast-ip-address=0:0:0:0:0:0:0:0, multicast-threshold=0, sd-server-event-group-timing-config=ReqResDelay_1
    someip provided event group SomeipPEventGroup_2: event-group=EventGroup_2, event-multicast-udp-port=0, ipv-4-multicast-ip-address=0.0.0.0, ipv-6-multicast-ip-address=0:0:0:0:0:0:0:0, multicast-threshold=0, sd-server-event-group-timing-config=ReqResDelay_2
  someip sd server service instance config radar_SomeipServerServiceInstanceConfig: initial-offer-behavior={initial-delay-max-value=0.1, initial-delay-min-value=0.01, initial-repetitions-base-delay=0.2, initial-repetitions-max=3}, offer-cyclic-delay=0.0, request-response-delay={max-value=1.5, min-value=1.5}, service-offer-time-to-live=10
