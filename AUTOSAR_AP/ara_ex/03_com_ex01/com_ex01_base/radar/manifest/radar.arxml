AUTOSAR XML (schema 00048)
package /radar/Application/Executable
  executable radarServiceExe: category=APPLICATION_LEVEL, build-type=BUILD-TYPE-DEBUG, logging-behavior=USES-LOGGING, reporting-behavior=REPORTS-EXECUTION-STATE
    root sw component prototype RootSwComponent: application-type=radarService
package /radar/Application/Process
  process radarService_Process:
    design=radarService_ProcessDesign
    executable=radarServiceExe
    log-trace-default-log-level=INFO
    log-trace-file-path=/adar/install/var
    log-trace-log-modes=[CONSOLE, FILE]
    log-trace-process-desc=Com Sample Provider App IPC
    log-trace-process-id=ACRA
    state-dependent-startup-config{execution-dependency=ProcessStateMachine.Running, function-group-state=[MachineState.Restart, MachineState.Shutdown, MachineState.Startup], resource-group=ResourceGroup_1, startup-config=StartupConfig_1}
    process state machine ProcessStateMachine: type=radarService_Process_ProcessStateMachine_ModeDeclarationGroup
  mode declaration group radarService_Process_ProcessStateMachine_ModeDeclarationGroup
    mode Running
    mode Terminated
  startup config set radarconfig
    startup config StartupConfig_1: scheduling-policy=SCHEDULING-POLICY-FIFO, scheduling-priority=15
package /radar/Application/ProcessDesign
  process design radarService_ProcessDesign: executable=radarServiceExe
package /radar/Application/SwComponent
  adaptive application sw component type radarService
