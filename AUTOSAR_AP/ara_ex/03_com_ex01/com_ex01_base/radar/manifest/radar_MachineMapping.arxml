AUTOSAR XML (schema 00048)
package /radar/ProcessToMachineMappingSet
  process to machine mapping set Machine_ECUMapping
    process to machine mapping radarMapping: machine=Machine_ECU, process=radarService_Process
