AUTOSAR XML (schema 00048)
package /fusion/ProcessToMachineMappingSet
  process to machine mapping set Machine_ECUMapping
    process to machine mapping fusionMapping: machine=Machine_ECU, process=fusion_Process
