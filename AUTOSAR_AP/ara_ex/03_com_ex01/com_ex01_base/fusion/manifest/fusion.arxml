AUTOSAR XML (schema 00048)
package /fusion/Application/Executable
  executable fusionExe: category=APPLICATION_LEVEL, build-type=BUILD-TYPE-DEBUG, logging-behavior=USES-LOGGING, reporting-behavior=REPORTS-EXECUTION-STATE
    root sw component prototype RootSwComponent: application-type=fusion
package /fusion/Application/Process
  process fusion_Process:
    design=fusion_ProcessDesign
    executable=fusionExe
    log-trace-default-log-level=INFO
    log-trace-file-path=/adar/install/var
    log-trace-log-modes=[CONSOLE, FILE]
    log-trace-process-desc=Com Sample Consumer App IPC
    log-trace-process-id=ACFA
    state-dependent-startup-config{execution-dependency=ProcessStateMachine.Running, function-group-state=[MachineState.Restart, MachineState.Shutdown, MachineState.Startup], resource-group=ResourceGroup_1, startup-config=StartupConfig_1}
    process state machine ProcessStateMachine: type=fusion_Process_ProcessStateMachine_ModeDeclarationGroup
  mode declaration group fusion_Process_ProcessStateMachine_ModeDeclarationGroup
    mode Running
    mode Terminated
  startup config set fusionconfig
    startup config StartupConfig_1: scheduling-policy=SCHEDULING-POLICY-FIFO, scheduling-priority=15
package /fusion/Application/ProcessDesign
  process design fusion_ProcessDesign: executable=fusionExe
package /fusion/Application/SwComponent
  adaptive application sw component type fusion
