AUTOSAR XML (schema 00048)
package /mobilgene/perdemo
  std cpp implementation data type String: category=STRING, type-emitter=TYPE_EMITTER_ARA
    namespaces:
      symbol props datatypes
package /mobilgene/perdemo/BaseTypes
  base type iso_8859_1: category=VARIABLE_LENGTH, base-type-encoding=ISO-8859-1
package /mobilgene/perdemo/ImplementationDataTypes
  std cpp implementation data type ErrorCode: category=STRUCTURE, type-emitter=TYPE_EMITTER_ARA
    namespaces:
      symbol props datatypes
    cpp implementation data type element error_code_value: type-reference=int32_t
    cpp implementation data type element error_domain_id: type-reference=uint64_t
  std cpp implementation data type STRINGUTF8DYNAMIC: category=STRING, type-emitter=TYPE_EMITTER_ARA
    namespaces:
      symbol props datatypes
  std cpp implementation data type SetStateData: category=STRUCTURE, type-emitter=TYPE_EMITTER_ARA
    namespaces:
      symbol props datatypes
    cpp implementation data type element return_value_bsw: type-reference=uint8_t
